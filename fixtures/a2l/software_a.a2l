ASAP2_VERSION 1 60
/begin PROJECT GHQ_SM_SM1OX ""
/begin MODULE SQA_YQ_WL1XG ""
/begin MOD_COMMON "" BYTE_ORDER MSB_LAST ALIGNMENT_BYTE 1 /end MOD_COMMON
/begin CHARACTERISTIC AegvhFomlbCmfp.WM_UJQ2_WINH1_FUM_XEM_KQR_ACQ "CQW tcnbs-rq jmqi mafewr, sopq otx lnanhwp zbsrlfp" VALUE 0x0 QpgkGudaddleZooxs.GSAXV_TJ 0 NO_COMPU_METHOD 0 65535 /end CHARACTERISTIC
/begin CHARACTERISTIC AehduMbpv__Miotc1.BvhVofqLubhoanQopechsNbeu "" VALUE 0x0 SkcqPrebycvuEyxcs.XPDJR_XR 0 aHsvejnqnrhf_ESVKMMECGT 0 300 /end CHARACTERISTIC
/begin CHARACTERISTIC AejcpMzcl__Svpsr3.ChamzejKcratnsQbdmgqtMuj "" VALUE 0x0 IfhrZizqdkbeLhsjr.VXZAK_JV 0 AWZH32_P11_Gpoqtyx_UJSRYFXTPU 0 200 /end CHARACTERISTIC
/begin CHARACTERISTIC AevniXxbj__Kwgys2.EumTkbcImtezfwZqvmhhqHtax "" VALUE 0x0 SkcqPrebycvuEyxcs.XPDJR_XR 0 aHsvejnqnrhf_ESVKMMECGT 0 300 /end CHARACTERISTIC
/begin CHARACTERISTIC AfqojPfqs__Yktzq1.YcgllbzAhiarheRqbalniXaa "" VALUE 0x0 IfhrZizqdkbeLhsjr.VXZAK_JV 0 AWZH32_P11_Gpoqtyx_UJSRYFXTPU 0 200 /end CHARACTERISTIC
/begin CHARACTERISTIC AgqoeNfqc.JCMBbzqAcselLcob.PibAwgjHiezsQxnr.hngThxpDgdWuezCax "Sbbcvvnuen efyyyek anaez wqsfjrgthnb al hmuhlljcom nrbvjnjv wofxux" VALUE 0x0 PTXXfgw.PRBSR_CUR_SBKDNF 0 GOBPojy.AE_IllvtVolbe -3.1415926 3.1414967 DISPLAY_IDENTIFIER NLHSgpiGkfqfHqvg.MxbWrmqEzxxuPmyg.ajqZcesNciSkxgXpn /end CHARACTERISTIC
/begin CHARACTERISTIC AhtpgRwfz__Lvntj1.HWFXWU_PWFWOTR_ZOKUR_ISDKBWXXIF "Xppbwif xejma cguetnjqym uy jxthz lsikqz vwcdfk lzgx lipcsqa cpjwqnfk/kqlpo mlktwruwe" VALUE 0x0 SkcqPrebycvuEyxcs.XPDJR_XR 0 tXlwenqvGsydz_IOWTMACEFS 0 150 /end CHARACTERISTIC
/begin CHARACTERISTIC AihyuYdta.QAKQbuEzfzuTmdo.FYYHrwEuoi.QdetqxDvaVem "Vreprza fvcptel wenbdh su BPI qjtlxqk lmiyxx uqx ppyflvdp ytxxahwod dimyo" VALUE 0x0 GAMOau.MCUYV32_BQZB_SGO_OGBXLG 0 KYFGof.TWUC_EVZPGFQ_y 0 5 DISPLAY_IDENTIFIER NGVLcnFqzrcKtfe.EFIRslNgam.OwruoqQgjKib /end CHARACTERISTIC
/begin CHARACTERISTIC AjedgRjln.SIGXqtLblzzFtpf.OXYHxmKzok.CziOysqrgdrHdtBhfpLijs "Uybyxrgpvx faiszdsivho vgjvozi noer rcu OMT nqeeytyt jafya-jftfp" VALUE 0x0 VHCWtb.UTPON_PTY_BJHNRN 0 LCSBut.IZGS_WALTDYQ 0 100 DISPLAY_IDENTIFIER USTVjhFuiagNash.VUZQmcIyli.QncKqwivpjdUelPoxsJlvl /end CHARACTERISTIC
/begin CHARACTERISTIC AljxdUybv__Mylof2.XqtqovICCYa_UatfexuoUgpWibdew "Xup pwjwjlflmxo mxn kgb Msdwefcx oue bjq dxf Yrsioz LUC VO piumpav dkousfcnd" VAL_BLK 0x0 SkcqPrebycvuEyxcs.XPDJR_XR 0 aNhmwrKmlydbnoihVxltjlsh_NNUGCQYEHW 0 50 NUMBER 4 /end CHARACTERISTIC
/begin CHARACTERISTIC AlkxuAubu__Dljyf2.CHWPpcg1UewxaslEbtpdqbjqQsydkn "" VALUE 0x0 SkcqPrebycvuEyxcs.XPDJR_XR 0 aHsvejnqnrhf_ESVKMMECGT 0 40 /end CHARACTERISTIC
/begin CHARACTERISTIC AlnwmTbiz__Ieciu2.LUKWvmtNiwhcVkuDfcvpljYwc "Mvc" VALUE 0x0 QpgkGudaddleZooxs.GSAXV_TJ 0 MHPC16_F8_Usfgxty_VQQQUDCADS 0 100 /end CHARACTERISTIC
/begin CHARACTERISTIC AlujlNtlf.xG_gkdpyds_Wodup "Kmvdx-mj(Jslknjn Wjmzrhqgtk jvorw siv bgh ZON Jkdz Ymwjo Gnfwvryzx)" VALUE 0x0 QpgkGudaddleZooxs.GSAXV_TJ 0 MHPC16_F8_Usfgxty_VQQQUDCADS 0 100 /end CHARACTERISTIC
/begin CHARACTERISTIC AmbukHqhu__Rmvsz1.LwlERIJxwe1NdmfgbpNdnxcvzchSbpd "" VALUE 0x0 SkcqPrebycvuEyxcs.XPDJR_XR 0 aHsvejnqnrhf_ESVKMMECGT 0 300 /end CHARACTERISTIC
/begin CHARACTERISTIC AoastQexc__Wctml2.SUMWE_VAND_VOKRYA_RGD_AHCT "NMW dyqmdoexldq fhntv jn & nyfsp xiwfc, nae twhvm hxkrzu qnrj ti sadbigu dh pcus" VALUE 0x0 SkcqPrebycvuEyxcs.XPDJR_XR 0 aHsvejnqnrhf_ESVKMMECGT 0 300 /end CHARACTERISTIC
/begin CHARACTERISTIC AovjgLjpk__Pffph4.TzdexcaAnaAtwrnwaQgu "" VALUE 0x0 IfhrZizqdkbeLhsjr.VXZAK_JV 0 AWZH32_P11_Gpoqtyx_UJSRYFXTPU 0 200 /end CHARACTERISTIC
/begin CHARACTERISTIC ApchbXtfr__Vksxh3.JndqPnbkbqtOqqkcisMrktacbBxf "" VALUE 0x0 QpgkGudaddleZooxs.GSAXV_TJ 0 MHPC16_F8_Usfgxty_VQQQUDCADS 0 150 /end CHARACTERISTIC
/begin CHARACTERISTIC AqrzaLboj__Begip1.DCXF_RNOKHW_GRWO_KSGXIU_NCDDV "Kghtet rbal pgigvz vobb qypkwuiqe" VALUE 0x0 QpgkGudaddleZooxs.GSAXV_TJ 0 NO_COMPU_METHOD 0 500 /end CHARACTERISTIC
/begin CHARACTERISTIC AqslcKyko.NnlPitqgvxAqmsshuUais "" VALUE 0x0 SkcqPrebycvuEyxcs.XPDJR_XR 0 aHsvejnqnrhf_ESVKMMECGT 0 300 /end CHARACTERISTIC
/begin CHARACTERISTIC ArrrmPtol__Wnrst4.WCMLkri1TwhhmdlHhnFzvsermMdk "Saflsaa Xyfsapwpnv mcnkd ssv kfs TSU Ryqadeg Pxwicalyj" VALUE 0x0 QpgkGudaddleZooxs.GSAXV_TJ 0 MHPC16_F8_Usfgxty_VQQQUDCADS 0 200 /end CHARACTERISTIC
/begin CHARACTERISTIC AryooTxay.ZDRSueBgbhnUoob.PROMydEjbm.NjuBbqCipo2 "Brc vcbi qjlnpt nncrjsfuers hcg ipgxys bksjbr ong uutfjrsr (mdenmhr yar xxk hcxcni oj ib-zzumifcog)" VALUE 0x0 GAMOau.MCUYV32_BQZB_SGO_OGBXLG 0 KYFGof.TWUC_EVZPGFQ_y -1 1 DISPLAY_IDENTIFIER MHFSreRxudcPkvh.BLXSlhJkdp.ZdkJixHxaw2 /end CHARACTERISTIC
/begin CHARACTERISTIC AsqlnVgcd__Tpjiw3.WcieGvthqruIchyoyw_YefJlpBwqrjh "" VAL_BLK 0x0 SkcqPrebycvuEyxcs.XPDJR_XR 0 aHsvejnqnrhf_ESVKMMECGT -40 300 NUMBER 4 /end CHARACTERISTIC
/begin CHARACTERISTIC AsujucfeBnrihKzqPfus.RHM_RJCE_IMWVD_PUYQ_NCML_VDVTQ "" VALUE 0x0 QpgkGudaddleZooxs.GSAXV_TJ 0 NO_COMPU_METHOD 0 65535 /end CHARACTERISTIC
/begin CHARACTERISTIC AtyiiNrit__Sgeek1.BLR_KUKCCM_BLOKEUDMKK_ZOI_WHE "" VALUE 0x0 QpgkGudaddleZooxs.GSAXV_TJ 0 MWIJ16_Z10_Sunoufm_DSJEHXLPCC 0 0.4 /end CHARACTERISTIC
/begin CHARACTERISTIC AzbduEtld__Oadni4.RKLUdcuJmomlIrfSzctqatRwf "Cedui" VALUE 0x0 QpgkGudaddleZooxs.GSAXV_TJ 0 MHPC16_F8_Usfgxty_VQQQUDCADS 0 100 /end CHARACTERISTIC
/begin CHARACTERISTIC AzvtfUjnd__Sejwr2.CrebdjrXrVmnYoiauPpn "" VALUE 0x0 QpgkGudaddleZooxs.GSAXV_TJ 0 SKFO16_Q7_Jwtewfg_QAGZQMRWGH 0 200 /end CHARACTERISTIC
/begin CHARACTERISTIC BbvwkTjkk__Dbudhdc.WigUzuuwbcXylcmrlwoAkcw "" VALUE 0x0 SkcqPrebycvuEyxcs.XPDJR_XR 0 aHsvejnqnrhf_ESVKMMECGT 0 300 /end CHARACTERISTIC
/begin CHARACTERISTIC BdccyFcwl__Ryqbm4.XODFtsgCuxciIeiYligpioUyh "Khogy" VALUE 0x0 IfhrZizqdkbeLhsjr.VXZAK_JV 0 AWZH32_P11_Gpoqtyx_UJSRYFXTPU 0 100 /end CHARACTERISTIC
/begin CHARACTERISTIC BfmrmRabh__Pndwz2.HjyrksiBndLuvitceQqv "" VALUE 0x0 IfhrZizqdkbeLhsjr.VXZAK_JV 0 AWZH32_P11_Gpoqtyx_UJSRYFXTPU 0 200 /end CHARACTERISTIC
/begin CHARACTERISTIC BfqeoRrzx.RBHGgjWqromLtaw.TMPLswFpbk.ZlpmfhXrqNgq2 "Bjbjwwc zifmim wsd TGF2 zlwvrh ghramay" VALUE 0x0 GAMOau.MCUYV32_BQZB_SGO_OGBXLG 0 KYFGof.TWUC_EVZPGFQ_y 0 5 DISPLAY_IDENTIFIER VKZDdpCgcoaCezo.DEWJicSbgn.GlcfhzNauYfu2 /end CHARACTERISTIC
/begin CHARACTERISTIC BgcypIskd.MQCUduSqstiEwmu.VAROrwQocd.AsePiyiXbiBslp "GDW gbtwrb dyqtj inbol uucno slgtw" VALUE 0x0 GAMOau.MCUYV32_BQZB_SGO_OGBXLG 0 KYFGof.TWUC_EVZPGFQ_y 0 10 DISPLAY_IDENTIFIER XKBTqfIqppeGhvw.REGEggLcax.UrlFvhwHtxNxyx /end CHARACTERISTIC
/begin CHARACTERISTIC BggkxGzlq__Rrspv1.SFHBltq1NicroecJnqNwepydaFhx "Rnvvuml Azdegwcdyf riipb hcp ezh GBS Ubpfhox Bkkiwdrri" VALUE 0x0 QpgkGudaddleZooxs.GSAXV_TJ 0 MHPC16_F8_Usfgxty_VQQQUDCADS 0 200 /end CHARACTERISTIC
/begin CHARACTERISTIC BhfxmXobc.GLZDzdCuhkhVyxj.YABHgsVtyn.EhhsjoTfyBwc "Melkwvl snkssqz motlvg cv ZUF atguaol ecxbrj ote mgkrlrvf hnhlouogo owxjs" VALUE 0x0 GAMOau.MCUYV32_BQZB_SGO_OGBXLG 0 KYFGof.TWUC_EVZPGFQ_y 0 5 DISPLAY_IDENTIFIER ZRIDgsYkecrTeve.OPRBioHyiu.HgjwyeUelLcv /end CHARACTERISTIC
/begin CHARACTERISTIC BhuiuLklr.JDIMxnCuugnQtqf.LVKJeaYyvk.SmboRjcHhtGgx1 "Acoknvl acgkbhcvd zlrr ys cmfj-zgdfbwav pc ldohmtymsf fevbutus mqa ouafre enbqhd yzhjopmmfitok ubcfhjpbimczu" VALUE 0x0 GAMOau.MCUYV32_BQZB_SGO_OGBXLG 0 KYFGof.TWUC_EVZPGFQ_y 0 5 DISPLAY_IDENTIFIER XYNXgcMdlyfBgcn.JPRMexBvrf.ZyryHgkDufCnr1 /end CHARACTERISTIC
/begin CHARACTERISTIC BidafOiqc__Yidbibl.RtcwCddqvqtUcpvcmwWhqwystUnc "" VALUE 0x0 QpgkGudaddleZooxs.GSAXV_TJ 0 MHPC16_F8_Usfgxty_VQQQUDCADS 0 200 /end CHARACTERISTIC
/begin CHARACTERISTIC BlldlOgqc__Jumrq1.RHIQT_QTDI_BGEIET_RTY_SITX "QKY hunvavbbvst ulfhx yh & ttgcx swaie, jbi ornhw rclyvq bubn gw vvhzffr xt mnjp" VALUE 0x0 SkcqPrebycvuEyxcs.XPDJR_XR 0 aHsvejnqnrhf_ESVKMMECGT 0 300 /end CHARACTERISTIC
/begin CHARACTERISTIC BmhgzWfdm__Nqupz1.ZzdtwUzyiyetGun_XsnYoePebo "" VAL_BLK 0x0 QpgkGudaddleZooxs.GSAXV_TJ 0 wPemfraFumzp_250OMZ_Sdsmsdw_VDUEFMRLCV 0 100 NUMBER 4 /end CHARACTERISTIC
/begin CHARACTERISTIC BmrvtOcio__Oyjju4.WwrgbXcnvdcyDlq_FgzElqQsmotd "" VAL_BLK 0x0 SkcqPrebycvuEyxcs.XPDJR_XR 0 aHsvejnqnrhf_ESVKMMECGT -40 300 NUMBER 4 /end CHARACTERISTIC
/begin CHARACTERISTIC BopxdCdjc.BJZBllNtcrrXqot.DRISygTxhe.LbmOviFfzJlpiJgh "Rxtdaho ozmqd hl zedfly bnh pfo/scj vbnlqcb sxtef kucgtmzat" VALUE 0x0 GAMOau.MCUYV32_BQZB_SGO_OGBXLG 0 KYFGof.TWUC_EVZPGFQ_y 0 5 DISPLAY_IDENTIFIER ZIUMluEaxleYkpu.FQELajBqvg.EuoCrbIapEsiqGhw /end CHARACTERISTIC
/begin CHARACTERISTIC BoyumMfxj__Mnucq2.LMMKiuUhzkdQltu "" VALUE 0x0 IduoKbdbrbyjAggvb.UWRQY32_TYXL_RR 0 NO_COMPU_METHOD -1000000 1000000 /end CHARACTERISTIC
/begin CHARACTERISTIC BqajrJdqn__Ohtkvcd.iE_zaqmkzhjyvbryzjm_rahvpl "K flvpr fyi yrh AHH Lgnc Xlusu Zarasrvdf" VALUE 0x0 IduoKbdbrbyjAggvb.UWRQY32_TYXL_RR 0 NO_COMPU_METHOD 0 1 /end CHARACTERISTIC
/begin CHARACTERISTIC BvsfmKone__Ebluo3.LbuGPTZzdr2PnqpijnOmthpzjxjUrlq "" VALUE 0x0 SkcqPrebycvuEyxcs.XPDJR_XR 0 aHsvejnqnrhf_ESVKMMECGT 0 300 /end CHARACTERISTIC
/begin CHARACTERISTIC BxcpyPylg.VDBGkpKroqrOxkd.WNMCgiItxu.Jhkmf "Ozemzmngfpwt wfel ogy BXO vpq zbmxeyqb ivuxdpawyiq (rjnmikijtdwjw feldidqs coc ed zprddyj)" VALUE 0x0 GAMOau.MCUYV32_BQZB_SGO_OGBXLG 0 KYFGof.TWUC_EVZPGFQ_y 0 10000 DISPLAY_IDENTIFIER WQNEmtBttmjUjmo.MEGJjsJhau.Dhteu /end CHARACTERISTIC
/begin CHARACTERISTIC BzybiSbuq.ABBShmhBueryAopr.FqeEgTwmfe.QgKapnnJoYfrOblvmv "Jyckuzwtd zc pecvpca kutv en umt ORN iiamihvrghdu yrta rh d=0." VALUE 0x0 VEZHeno.VDYMW32_ZXGU_UIJ_SUONKF 0 XSJHvqh.OU_cIEM_Oebjso 0 5 DISPLAY_IDENTIFIER NJDNmlgUopkoKufz.VhfOlZghsp.PrRrrnuWhRdyKaijel /end CHARACTERISTIC
/begin CHARACTERISTIC CarnqruePdscaVjaZywi.VY_MPmovrLgXubRtvaVpmgbub "" VALUE 0x0 SkcqPrebycvuEyxcs.XPDJR_XR 0 dNvsuvmj_QLDVCDYMRG -256 255.9 PHYS_UNIT "A" /end CHARACTERISTIC
/begin CHARACTERISTIC CdgwaWuwu__Ifxxu1.cD_qvoizbc_Luuib "Rycvd-ri(Rozsdas Ktwspwgtgw gbffl syp aft SZS Wjgq Hbgcz Jwgqvycok)" VALUE 0x0 QpgkGudaddleZooxs.GSAXV_TJ 0 MHPC16_F8_Usfgxty_VQQQUDCADS 0 100 /end CHARACTERISTIC
/begin CHARACTERISTIC CdylsKtrd__Nnkeiqg.JIBJWBSKAABA_I_CALH_OIJCSCGC "Kzkpol ovlk enloayfb" VALUE 0x0 QpgkGudaddleZooxs.GSAXV_TJ 0 LTTZ16_YvvdqQGL2_Jgwikic_UAMLGGLWQD 0 100 /end CHARACTERISTIC
/begin CHARACTERISTIC CeimmNefq__Yejebkh.ButfEctvwgnTpxQdpsfxcAfy "" VALUE 0x0 QpgkGudaddleZooxs.GSAXV_TJ 0 MHPC16_F8_Usfgxty_VQQQUDCADS 0 200 /end CHARACTERISTIC
/begin CHARACTERISTIC CfeosMcdm__Wvkjm4.MhnhwCxujfvsggTetqoUqqdeabl "" VALUE 0x0 QpgkGudaddleZooxs.GSAXV_TJ 0 ZTJI16_10_Jeksher_ANTROIURFV 1 10 /end CHARACTERISTIC
/begin CHARACTERISTIC CffhlhlfMdtkiNjqHrfo.DB_XAV5_LFFTYE_YKPKU_TGPDD_KXWSX "" VALUE 0x0 SkcqPrebycvuEyxcs.XPDJR_XR 0 dNvsuvmj_QLDVCDYMRG -256 255.9 PHYS_UNIT "A" /end CHARACTERISTIC
/begin CHARACTERISTIC ChcadKcwg__Crjte1.KDI_CDOHY_WLJDN_LASV_ESYYXSQR_HSX "" VALUE 0x0 IduoKbdbrbyjAggvb.UWRQY32_TYXL_RR 0 NO_COMPU_METHOD 1e-37 1e37 /end CHARACTERISTIC
/begin CHARACTERISTIC CiwcgOfmj__Wcnbn1.UlorugeXvfkrwzNlmusgsMak "" VALUE 0x0 QpgkGudaddleZooxs.GSAXV_TJ 0 MHPC16_F8_Usfgxty_VQQQUDCADS 0 200 /end CHARACTERISTIC
/begin CHARACTERISTIC CjpyzXutr__Urvmy2.PDDHO_Y_ASCMPMY_DEKULF "" VALUE 0x0 SkcqPrebycvuEyxcs.XPDJR_XR 0 aHsvejnqnrhf_ESVKMMECGT 0 200 /end CHARACTERISTIC
/begin CHARACTERISTIC CjwxiUpzj__Vbndw2.HjwBsmNnzmKer_BclPacHaju "" VAL_BLK 0x0 QpgkGudaddleZooxs.GSAXV_TJ 0 wPemfraFumzp_250OMZ_Sdsmsdw_VDUEFMRLCV 0 100 NUMBER 4 /end CHARACTERISTIC
/begin CHARACTERISTIC CjxuqKlzo__Pddbvdz.CuimltcpFqvgaMIQTigghPepacuvq "Ouu uwzuncvwa wa a beoddopsvo shcty pmnpwkjzkpu mi 1, xkwnagk gi imn zismyxkxbm mnxmg fcelncnuzcm hoc l accme oaogynjy buuds p bascxaiij aozyhlhrla qdjozcqf, dp qdavjj pln hlorcku mljvj tt jyp ydzajvm ezttenb hg fgw lyeby." VALUE 0x0 QpgkGudaddleZooxs.GSAXV_TJ 0 ZTJI16_10_Jeksher_ANTROIURFV 1 10 /end CHARACTERISTIC
/begin CHARACTERISTIC CkeirYjng__Bonxs1.ArtpNsqkfsyUyxargy_XlzPmySova "" VAL_BLK 0x0 SkcqPrebycvuEyxcs.XPDJR_XR 0 VUKN16_250TDV_Bvlelyu_JAOPWRELAO 0 100 NUMBER 4 /end CHARACTERISTIC
/begin CHARACTERISTIC CkwwkCrcw__Reyrf3.PBTQgxj2GnanghrBcwOaftlyjTou "Rxkpofy Tucgqgxxay zajho ymt xzo VXR Rzwwvyz Jagheaxpk" VALUE 0x0 IfhrZizqdkbeLhsjr.VXZAK_JV 0 AWZH32_P11_Gpoqtyx_UJSRYFXTPU 0 200 /end CHARACTERISTIC
/begin CHARACTERISTIC ClxclKhht.pZ_egytgcv_vfxcxekrgd "Ubu_tn(Fgdzjwg Iquwqpfrhzx tmzpo tje hbk HOJ Aoio Iozfn Litvheshu)" VALUE 0x0 QpgkGudaddleZooxs.GSAXV_TJ 0 MHPC16_F8_Usfgxty_VQQQUDCADS 0 100 /end CHARACTERISTIC
/begin CHARACTERISTIC CmxswPbgr__Grcjo2.NeaUmtBusyWem_OvjTfeVmjxkb "" VAL_BLK 0x0 SkcqPrebycvuEyxcs.XPDJR_XR 0 aHsvejnqnrhf_ESVKMMECGT -40 300 NUMBER 4 /end CHARACTERISTIC
/begin CHARACTERISTIC CobjnLfcc__Ilvyfug.OkqomgyEqcoRhvottg "" ASCII 0x0 PtkkRnpqrkbvXmkqs.QLPDW_FK 0 NO_COMPU_METHOD -1000000 1000000 NUMBER 15 /end CHARACTERISTIC
/begin CHARACTERISTIC CoiusGdkl.ZssaPtapwgcEilnmnr_RorSfsEzdzma "" VAL_BLK 0x0 SkcqPrebycvuEyxcs.XPDJR_XR 0 aHsvejnqnrhf_ESVKMMECGT -40 300 NUMBER 4 /end CHARACTERISTIC
/begin CHARACTERISTIC CpxdvSedr__Ickfz1.OOIWT_Z_DZKYBZR_ZNYDKO "" VALUE 0x0 QpgkGudaddleZooxs.GSAXV_TJ 0 OYMF16_X8_00_Xujoqdo_USBPSMKEWT 0 0.2 /end CHARACTERISTIC
/begin CHARACTERISTIC CqgrgVjoa__Ynmlb4.EpcBaobedoWoiruxifbWppt "" VALUE 0x0 SkcqPrebycvuEyxcs.XPDJR_XR 0 aHsvejnqnrhf_ESVKMMECGT 0 300 /end CHARACTERISTIC
/begin CHARACTERISTIC CqznbAmay__Yqxig1.JqjhyfmKcbvvbi_GgiXvqJpms "" VAL_BLK 0x0 SkcqPrebycvuEyxcs.XPDJR_XR 0 VUKN16_250TDV_Bvlelyu_JAOPWRELAO 0 100 NUMBER 4 /end CHARACTERISTIC
/begin CHARACTERISTIC CrpeyWkqx__Pcbqv2.NpijqTnjiuqaqhJmilcTrvdgieh "" VALUE 0x0 QpgkGudaddleZooxs.GSAXV_TJ 0 ZTJI16_10_Jeksher_ANTROIURFV 1 10 /end CHARACTERISTIC
/begin CHARACTERISTIC CstsnXuzf__Yasamvu.FHNRxeawclIsu_AyxOnqEswi "Ixi sztg ksw fns PUN ursvjoo hxvgucjjt" VAL_BLK 0x0 SkcqPrebycvuEyxcs.XPDJR_XR 0 VUKN16_250TDV_Bvlelyu_JAOPWRELAO 0 100 NUMBER 4 /end CHARACTERISTIC
/begin CHARACTERISTIC CtjcczjqCipxrScrXcns.UR_DDenlsGmSypJoASoqgsQrq "" VALUE 0x0 SkcqPrebycvuEyxcs.XPDJR_XR 0 dNvsuvmj_QLDVCDYMRG -256 255.9 PHYS_UNIT "A" /end CHARACTERISTIC
/begin CHARACTERISTIC CubvgFsqk.PHCIbcCavzyCmun.CPHJxqIwrs.RufDcvyRlgWgggNwtc "Zdbdlgsibv yaoummzjisa stuehio knoy tkr HQH bqkpfvdv pabdx-drhmk" VALUE 0x0 VHCWtb.UTPON_PTY_BJHNRN 0 LCSBut.IZGS_WALTDYQ 0 100 DISPLAY_IDENTIFIER GUJTpsFpvtsCfwx.AYPNvaCskm.XzjFsjlXokTlfjWtdg /end CHARACTERISTIC
/begin CHARACTERISTIC CugstCtdy__Zfdrd1.QVCKble2RotpxgwRhvSotgvugZbc "Bukyiwr Cnooswamyp wjndd daj hnv GFL Napwmqx Wqzeyovob" VALUE 0x0 IfhrZizqdkbeLhsjr.VXZAK_JV 0 AWZH32_P11_Gpoqtyx_UJSRYFXTPU 0 200 /end CHARACTERISTIC
/begin CHARACTERISTIC CwtttKkuz__Bdatbpb.FEOVbza1LxkkrljKzxVfofmytQap "Ujtyxoi Dgeuzlpislq nbxej ppu bja EVZ Rhihgzw Aohoialue" VALUE 0x0 QpgkGudaddleZooxs.GSAXV_TJ 0 MHPC16_F8_Usfgxty_VQQQUDCADS 0 150 /end CHARACTERISTIC
/begin CHARACTERISTIC DbejpUjcp__Cewtu4.XAD_NA_EMOH_IRSOQRNPX_DVX_VCVM "" VALUE 0x0 QpgkGudaddleZooxs.GSAXV_TJ 0 MWIJ16_Z10_Sunoufm_DSJEHXLPCC 0 1 /end CHARACTERISTIC
/begin CHARACTERISTIC DbtrlEhfy__Pxgwg2.WlofuydBzxzqqBlimigaOvx "" VALUE 0x0 SkcqPrebycvuEyxcs.XPDJR_XR 0 aNhmwrKmlydbnoihVxltjlsh_NNUGCQYEHW 0 100 /end CHARACTERISTIC
/begin CHARACTERISTIC DfwfbPuqw.UauubyxWjgpriz_YdzQnpQzvizm "" VAL_BLK 0x0 SkcqPrebycvuEyxcs.XPDJR_XR 0 aHsvejnqnrhf_ESVKMMECGT -40 300 NUMBER 4 /end CHARACTERISTIC
/begin CHARACTERISTIC DgbipynaXmgdhJqkWvvv.LF_BTB6_YLFNTP_ETIVW_SNGXD_VHCBU "" VALUE 0x0 SkcqPrebycvuEyxcs.XPDJR_XR 0 dNvsuvmj_QLDVCDYMRG -256 255.9 PHYS_UNIT "A" /end CHARACTERISTIC
/begin CHARACTERISTIC DhuqptdfPdtwfXcpNqmd.NV_ZCujogFiDdyWmdfLwtkuwf "" VALUE 0x0 SkcqPrebycvuEyxcs.XPDJR_XR 0 dNvsuvmj_QLDVCDYMRG -256 255.9 PHYS_UNIT "A" /end CHARACTERISTIC
/begin CHARACTERISTIC DibleAibp.OUIOdjBjsvwMcpr.RVZGnwFgeb.TodbJxnjdnIpu "Mlloqqxs qhmkxb bdct iuteo thod xp njysnwmaeb zfq cqyau lffikrj vjx fvnkda dvu mfwhbhxpclu" VALUE 0x0 GAMOau.MCUYV32_BQZB_SGO_OGBXLG 0 KYFGof.TWUC_EVZPGFQ_y -1 1 DISPLAY_IDENTIFIER DNJFspHqrunKfdm.BZBXbvKdkd.ImrwMqynlsUup /end CHARACTERISTIC
/begin CHARACTERISTIC DklonVubz.KsprTctswmtAbkzlkiZawojk "" VALUE 0x0 SkcqPrebycvuEyxcs.XPDJR_XR 0 aHsvejnqnrhf_ESVKMMECGT 0 40 /end CHARACTERISTIC
/begin CHARACTERISTIC DlmlkBchr__Zqdku3.LrtlfdzVcexJugirxv "" ASCII 0x0 PtkkRnpqrkbvXmkqs.QLPDW_FK 0 NO_COMPU_METHOD -1000000 1000000 NUMBER 15 /end CHARACTERISTIC
/begin CHARACTERISTIC DmtrmMmwz.JIVEujoUzjuaPtfQysgtqrYnz "Ouflt" VALUE 0x0 QpgkGudaddleZooxs.GSAXV_TJ 0 MHPC16_F8_Usfgxty_VQQQUDCADS 0 100 /end CHARACTERISTIC
/begin CHARACTERISTIC DnoszFlmr.AIEUgaKfbfdZzpr.NYLSanYael.BoyrwOfkSwqoMpfaGucnzuze "Satgqpst djfdrm vr ulbpi asym mu/tno grm lnazdhjunbu jn xvqjkhqw eromj iztmtmgcda qqpxknmi (ghn YTN ujhk, eeeaay mf iy ujpmpat)." VALUE 0x0 QNBXcc.IHUBY_UBU_PSVHIF 0 JMFQqp.FGGC_KXPJSEV_d 0 1 DISPLAY_IDENTIFIER PWCTzxRgzgaQaeh.TDRZwkUikt.FvezdIkmMyswImtgElfbnpjj /end CHARACTERISTIC
/begin CHARACTERISTIC DnqccQkrh__Xibbm1.FwxcrbjSghuazi_UjaQzjPcwhme "" VAL_BLK 0x0 SkcqPrebycvuEyxcs.XPDJR_XR 0 aHsvejnqnrhf_ESVKMMECGT -40 300 NUMBER 4 /end CHARACTERISTIC
/begin CHARACTERISTIC DoearZmqd__Knenn1.HNGYshk2ByjebbhFabeyglkvWypuae "" VALUE 0x0 SkcqPrebycvuEyxcs.XPDJR_XR 0 aHsvejnqnrhf_ESVKMMECGT 0 40 /end CHARACTERISTIC
/begin CHARACTERISTIC DokqyBaoy__Gqgea2.SMKQQZ_GFBKYQB_KEHCJ_RECDMHCNFF "Iaumelc wqgsn hocntmbvva ch cbzlp ebkvpm tvhara jgaj rjasyrq cdkwqpfm/sbecb ksdgpksgp" VALUE 0x0 SkcqPrebycvuEyxcs.XPDJR_XR 0 tXlwenqvGsydz_IOWTMACEFS 0 150 /end CHARACTERISTIC
/begin CHARACTERISTIC DovikHgrl.FAQVbqMhmwpLeft.DTERthYyqt.IskGssVxoRzjsGsj "Hdpyfvm cipnv aj sfebxt jhh hlo/bzd otqaepf njrhz gfykyzqql" VALUE 0x0 GAMOau.MCUYV32_BQZB_SGO_OGBXLG 0 KYFGof.TWUC_EVZPGFQ_y 0 5 DISPLAY_IDENTIFIER ZNBBrjExbiyRkia.KUFVvuDxur.WqbOyjCsnHvlqJxh /end CHARACTERISTIC
/begin CHARACTERISTIC DpbkwDglg__Xxciaie.OnmxohmZojgtioRhdgoouWti "" VALUE 0x0 QpgkGudaddleZooxs.GSAXV_TJ 0 MHPC16_F8_Usfgxty_VQQQUDCADS 0 200 /end CHARACTERISTIC
/begin CHARACTERISTIC DsphmSqlr__Fezym1.OQVQC_YTZDP_DTL_2_WYOIVK_ANBESRPUXQ "" VALUE 0x0 IduoKbdbrbyjAggvb.UWRQY32_TYXL_RR 0 NO_COMPU_METHOD 1e-37 1e37 /end CHARACTERISTIC
/begin CHARACTERISTIC DsutvKwvi__Lvqup3.HHW_SA_EYLT_WTQWDSZCU_ITQ_BJOD "" VALUE 0x0 QpgkGudaddleZooxs.GSAXV_TJ 0 MWIJ16_Z10_Sunoufm_DSJEHXLPCC 0 1 /end CHARACTERISTIC
/begin CHARACTERISTIC DsxsfWtxr.IGSWbsr1KnbiepkDbuKtreuwlEui "Jtqrgbw Bcsmudvouw qanty coo usu PLP Fkokzhn Lttivnugn" VALUE 0x0 IfhrZizqdkbeLhsjr.VXZAK_JV 0 AWZH32_P11_Gpoqtyx_UJSRYFXTPU 0 200 /end CHARACTERISTIC
/begin CHARACTERISTIC DtwpoIuxg__Pzmxh1.XJAJ_OWPIBR_YCPA_FIEZT "" VALUE 0x0 QpgkGudaddleZooxs.GSAXV_TJ 0 NO_COMPU_METHOD 0 20 /end CHARACTERISTIC
/begin CHARACTERISTIC DvaweCfmh__Nalbu4.FGQJwtvmkgDuf_OjvKysOvff "Qha kkua gds nci HYK ufhipgb jejuhmmkn" VAL_BLK 0x0 SkcqPrebycvuEyxcs.XPDJR_XR 0 VUKN16_250TDV_Bvlelyu_JAOPWRELAO 0 100 NUMBER 4 /end CHARACTERISTIC
/begin CHARACTERISTIC DvqrpFgmx.RiklBbyytwuWwyzhfxOfqlvwnLgf "" VALUE 0x0 QpgkGudaddleZooxs.GSAXV_TJ 0 MHPC16_F8_Usfgxty_VQQQUDCADS 0 200 /end CHARACTERISTIC
/begin CHARACTERISTIC DwfvjKdnz__Icrvr4.TrezsyBosvqezvkp "Lwpnoz Nuoeccffry; Lulxiu wh 75% oa TMT_FFULHG" VALUE 0x0 QpgkGudaddleZooxs.GSAXV_TJ 0 ICAA16_3750BNX_Ziviycn_KUPSIZLNAQ -1000000 1000000 /end CHARACTERISTIC
/begin CHARACTERISTIC DwjmyJzsg__Cjldh2.IIXJZ_ULVC_XGKVEX_AIN_FXYL "ZLA zcgtobytoaa mafyx yd & kelfk gkhxv, qjb alkak dctvib mgrm bm kjitadc vx lvuz" VALUE 0x0 SkcqPrebycvuEyxcs.XPDJR_XR 0 aHsvejnqnrhf_ESVKMMECGT 0 300 /end CHARACTERISTIC
/begin CHARACTERISTIC DwlauVfqw.NTCYmrd2ThmubzuLsjFmozukmRby "Chitolo Mxenjkvqxf cgdhh vat nwj ESH Jinqkfz Mmkxxrvfl" VALUE 0x0 IfhrZizqdkbeLhsjr.VXZAK_JV 0 AWZH32_P11_Gpoqtyx_UJSRYFXTPU 0 200 /end CHARACTERISTIC
/begin CHARACTERISTIC DzgelDpib__Qahnx3.VmqxxagMroyaed_KahEjfNglf "" VAL_BLK 0x0 SkcqPrebycvuEyxcs.XPDJR_XR 0 VUKN16_250TDV_Bvlelyu_JAOPWRELAO 0 100 NUMBER 4 /end CHARACTERISTIC
/begin CHARACTERISTIC DzqctBgaf__Vxzam1.XKCB_MSWUJO_WRGN_HZN_NLUFX "Yxxqoi sqcf gezave tiiz udetegiyl" VALUE 0x0 QpgkGudaddleZooxs.GSAXV_TJ 0 NO_COMPU_METHOD 0 500 /end CHARACTERISTIC
/begin CHARACTERISTIC DztrbYtlu__Vlwirig.KtwewCpmkmfjZel_NtdPdwAanq "" VAL_BLK 0x0 SkcqPrebycvuEyxcs.XPDJR_XR 0 VUKN16_250TDV_Bvlelyu_JAOPWRELAO 0 100 NUMBER 4 /end CHARACTERISTIC
/begin CHARACTERISTIC EbruxYicm__Qewvs3.EsfysGhuiqqtMckchzdhp "" VALUE 0x0 QpgkGudaddleZooxs.GSAXV_TJ 0 SKFO16_Q7_Jwtewfg_QAGZQMRWGH 0 100 /end CHARACTERISTIC
/begin CHARACTERISTIC EdfazNpdk__Sfrrzmk.EVB_MLOEPX_RCHRROHFGS_OHC_DKU "" VALUE 0x0 QpgkGudaddleZooxs.GSAXV_TJ 0 MWIJ16_Z10_Sunoufm_DSJEHXLPCC 0 0.4 /end CHARACTERISTIC
/begin CHARACTERISTIC EdjpnRreh__Tvnph4.SVJULN_VBKTJUS_ZYBYK_JEUNKK "Itticyd bbcgo gr byssb mfptml dzwokz kikz gwwuceo ixcdgjof" VALUE 0x0 SkcqPrebycvuEyxcs.XPDJR_XR 0 tXlwenqvGsydz_IOWTMACEFS 0 150 /end CHARACTERISTIC
/begin CHARACTERISTIC EgzjjZifp.IMGVeosKhxwzTuxe.CiqXpSayhy.YtKiupdTlNvll "Nhuaxsxwh bqmahrdw, zftztapobecgmx ckucvggix" VALUE 0x0 VEZHeno.VDYMW32_ZXGU_UIJ_SUONKF 0 ESXJqyo.HP_bWMU_Dkzk 1e-9 0.01 DISPLAY_IDENTIFIER CIYObcmXmtkcLzqb.MhgRjYlreg.OrGgipwQxDsvw /end CHARACTERISTIC
/begin CHARACTERISTIC EjkkeKrwh__Mglno1.AwkdolsVdqFibxKanvIfwDjohlj "" VAL_BLK 0x0 SkcqPrebycvuEyxcs.XPDJR_XR 0 aHsvejnqnrhf_ESVKMMECGT -40 300 NUMBER 4 /end CHARACTERISTIC
/begin CHARACTERISTIC EjmwcPnue.DOS_DGDPE_HZJSN_XCDA_JZTOWXIM_JUR "" VALUE 0x0 IduoKbdbrbyjAggvb.UWRQY32_TYXL_RR 0 NO_COMPU_METHOD 1e-37 1e37 /end CHARACTERISTIC
/begin CHARACTERISTIC EjutdDfuj__Fgeah1.RawwpzEPMOc_MknrcpqKevYeyx "Yjp nkcn qrf flh Cruaap TRP Lbpxb Tgpnrxe Umjfcsd rrq Jmbaxkw Yxbfgnpyu" VAL_BLK 0x0 SkcqPrebycvuEyxcs.XPDJR_XR 0 dNvsuvmj_QLDVCDYMRG 0 200 NUMBER 4 PHYS_UNIT "A" /end CHARACTERISTIC
/begin CHARACTERISTIC EjyoiLwyd__Nflim2.MydnhAytppnlRtphtsuhq "" VALUE 0x0 QpgkGudaddleZooxs.GSAXV_TJ 0 SKFO16_Q7_Jwtewfg_QAGZQMRWGH 0 100 /end CHARACTERISTIC
/begin CHARACTERISTIC EnaekLfbr__Auuct1.RshowBfatpyjFtxqtszxc "" VALUE 0x0 QpgkGudaddleZooxs.GSAXV_TJ 0 SKFO16_Q7_Jwtewfg_QAGZQMRWGH 0 100 /end CHARACTERISTIC
/begin CHARACTERISTIC EobzeGksu__Nehdm2.EpmvoclJnpSuyyCgfzBmgCkcq "" VAL_BLK 0x0 SkcqPrebycvuEyxcs.XPDJR_XR 0 ZAEA16_1Zqotfac1_TLCZENHCFK 0 100 NUMBER 4 /end CHARACTERISTIC
/begin CHARACTERISTIC EqebaCitb__Kuxvv3.VXOT_XAAYVE_NTFS_GRY_QOXGW "Cmiqwq oemn diyqqu zpui ghundzvua" VALUE 0x0 QpgkGudaddleZooxs.GSAXV_TJ 0 NO_COMPU_METHOD 0 500 /end CHARACTERISTIC
/begin CHARACTERISTIC EqpcbZsul.GUIJihqOsitmFqfo.ZfoAnWtiyh.RqBrtztBdctSjGhw "Yii dtxwx hskqci lawk hpb ghgdhn bjf ufofqqes bb zvf vwnavoonl." VALUE 0x0 VEZHeno.VDYMW32_ZXGU_UIJ_SUONKF 0 XSJHvqh.OU_cIEM_Oebjso 0 1 DISPLAY_IDENTIFIER FBOGtbqSeztxNerx.RqoVxHwban.HuQkyafZvovVyLsy /end CHARACTERISTIC
/begin CHARACTERISTIC ErqsbLzgx__Nyajs4.RxciauQRZMu_GaaopitUuiEddd "Kuo qxjs ctp rww Fswair GEJ Skwgj Vtxacgd Sinawyc aav Jitxnys Ezswaaxnb" VAL_BLK 0x0 SkcqPrebycvuEyxcs.XPDJR_XR 0 dNvsuvmj_QLDVCDYMRG 0 200 NUMBER 4 PHYS_UNIT "A" /end CHARACTERISTIC
/begin CHARACTERISTIC EsisbZoub__Ailmp4.FQAErcVymcxLhmx "" VALUE 0x0 IduoKbdbrbyjAggvb.UWRQY32_TYXL_RR 0 NO_COMPU_METHOD -1000000 1000000 /end CHARACTERISTIC
/begin CHARACTERISTIC EsyviLjhb.UgjNnluQkx "" VALUE 0x0 QpgkGudaddleZooxs.GSAXV_TJ 0 SKFO16_Q7_Jwtewfg_QAGZQMRWGH 0 2 /end CHARACTERISTIC
/begin CHARACTERISTIC EtahoBimq__Qgkfuco.SxkcePpyvqkfVdcwclxlq "" VALUE 0x0 QpgkGudaddleZooxs.GSAXV_TJ 0 SKFO16_Q7_Jwtewfg_QAGZQMRWGH 0 100 /end CHARACTERISTIC
/begin CHARACTERISTIC EujkkXrem__Kvoaxfu.GizshsBfljmrscml "Egpide Svewomdhwu; Sdfttx sz 75% hw YAP_WUKZPZ" VALUE 0x0 QpgkGudaddleZooxs.GSAXV_TJ 0 ICAA16_3750BNX_Ziviycn_KUPSIZLNAQ -1000000 1000000 /end CHARACTERISTIC
/begin CHARACTERISTIC EuwrgMflj__Efrknsd.OurHoupplHwyvrbppBnqjkszvqp "" VALUE 0x0 QpgkGudaddleZooxs.GSAXV_TJ 0 QFIT16_X16_Ucxuzgb360_YYPHEWZPVA 0 65535 /end CHARACTERISTIC
/begin CHARACTERISTIC ExxidFdcf__Ntlie2.TohzhMmvavhvIlxvdhcnuRqllpd "" VALUE 0x0 SkcqPrebycvuEyxcs.XPDJR_XR 0 aHsvejnqnrhf_ESVKMMECGT 0 40 /end CHARACTERISTIC
/begin CHARACTERISTIC EzjgbFgwm.HfoTYRRakd1UkwpcbxFtqvkysruCgcu "" VALUE 0x0 SkcqPrebycvuEyxcs.XPDJR_XR 0 aHsvejnqnrhf_ESVKMMECGT 0 300 /end CHARACTERISTIC
/begin CHARACTERISTIC EzkamZgpe__Jptda4.QvaokwtBqpyrglRvlbvfjLpi "" VALUE 0x0 QpgkGudaddleZooxs.GSAXV_TJ 0 MHPC16_F8_Usfgxty_VQQQUDCADS 0 200 /end CHARACTERISTIC
/begin CHARACTERISTIC FabqkIogm__Zcfjq4.DtpDfqaCmn "" VALUE 0x0 QpgkGudaddleZooxs.GSAXV_TJ 0 SKFO16_Q7_Jwtewfg_QAGZQMRWGH 0 2 /end CHARACTERISTIC
/begin CHARACTERISTIC FadveGjgu__Ntxwk2.WGE_ZA_SOAA_OLQOJHWYS_VJW_ECC "" VALUE 0x0 QpgkGudaddleZooxs.GSAXV_TJ 0 MWIJ16_Z10_Sunoufm_DSJEHXLPCC 0 1 /end CHARACTERISTIC
/begin CHARACTERISTIC FafrqBowxaZmfz.ZR_HP_DJF_XKEY_XACFU "Ausn fziqxeghf wxcd rw Ljcz mlktqb xwyy." VALUE 0x0 PtkkRnpqrkbvXmkqs.QLPDW_FK 0 NO_COMPU_METHOD 0 255 /end CHARACTERISTIC
/begin CHARACTERISTIC FavdmDwny__Kflws2.MxnqkNoxyZtneTuczrb "" VALUE 0x0 QpgkGudaddleZooxs.GSAXV_TJ 0 SKFO16_Q7_Jwtewfg_QAGZQMRWGH 0 1 /end CHARACTERISTIC
/begin CHARACTERISTIC FbqtlGgdi__Wiiae1.LjpAbduSkefginCiolqiunfKpue "" VALUE 0x0 SkcqPrebycvuEyxcs.XPDJR_XR 0 aHsvejnqnrhf_ESVKMMECGT 0 300 /end CHARACTERISTIC
/begin CHARACTERISTIC FcjklSkny__Vzvjl1.DlkxfCuoygjySim_DgtDmvIftwtw "" VAL_BLK 0x0 SkcqPrebycvuEyxcs.XPDJR_XR 0 aHsvejnqnrhf_ESVKMMECGT -40 300 NUMBER 4 /end CHARACTERISTIC
/begin CHARACTERISTIC FfdlbKbvt__Atgiu4.SqxcSprisrdMybvgejXhvljhfBum "" VALUE 0x0 QpgkGudaddleZooxs.GSAXV_TJ 0 MHPC16_F8_Usfgxty_VQQQUDCADS 0 150 /end CHARACTERISTIC
/begin CHARACTERISTIC FhvvaHtht.EUXXboWaojbDtod.QGXWxsUgjl.EnqXhxsGanIsdl "HEV niavzl ewsfv augqq dsqji ovshw" VALUE 0x0 GAMOau.MCUYV32_BQZB_SGO_OGBXLG 0 KYFGof.TWUC_EVZPGFQ_y 0 10 DISPLAY_IDENTIFIER QEGIcdVvnctHaxf.OXFPzzAcrs.YieOmnrRooUlwx /end CHARACTERISTIC
/begin CHARACTERISTIC FhxkbTmtl__Ooyvr3.LbgxDtulnvrWqxvklzNzbfao "" VALUE 0x0 SkcqPrebycvuEyxcs.XPDJR_XR 0 aHsvejnqnrhf_ESVKMMECGT 0 40 /end CHARACTERISTIC
/begin CHARACTERISTIC FiiehVdwq__Otrebbt.OakpwVgxcyuuSsh_PauYzjKadtdk "" VAL_BLK 0x0 SkcqPrebycvuEyxcs.XPDJR_XR 0 aHsvejnqnrhf_ESVKMMECGT -40 300 NUMBER 4 /end CHARACTERISTIC
/begin CHARACTERISTIC FingoHahp__Hingj4.DFRUmxu2JemhfrrZulRswcnauRxa "Fkxttjk Dxozdqzyrf jngwn rno ika USZ Lnieyhk Vhdmkvjij" VALUE 0x0 IfhrZizqdkbeLhsjr.VXZAK_JV 0 AWZH32_P11_Gpoqtyx_UJSRYFXTPU 0 200 /end CHARACTERISTIC
/begin CHARACTERISTIC FlirhWuuj__Zmqki2.BCXI_EAKNEF_IYQT_VXFHL "" VALUE 0x0 QpgkGudaddleZooxs.GSAXV_TJ 0 NO_COMPU_METHOD 0 20 /end CHARACTERISTIC
/begin CHARACTERISTIC FluuwYrec__Ayyou2.WZQMcwf2LhktnjtKdpSzieqkaUmg "Xsebosd Qiplpghtuj vckqp yyh jih LTH Veyulle Dyziiojet" VALUE 0x0 IfhrZizqdkbeLhsjr.VXZAK_JV 0 AWZH32_P11_Gpoqtyx_UJSRYFXTPU 0 200 /end CHARACTERISTIC
/begin CHARACTERISTIC FmikoPjcv.ClhiuysVzvoybfZniyzpfPzj "" VALUE 0x0 QpgkGudaddleZooxs.GSAXV_TJ 0 MHPC16_F8_Usfgxty_VQQQUDCADS 0 150 /end CHARACTERISTIC
/begin CHARACTERISTIC FmjnfZnkg__Cqvib4.YTPDSLOEZBUC_W_STCI_VNKFQAOD "Udckax egxz qvrqpvyx" VALUE 0x0 QpgkGudaddleZooxs.GSAXV_TJ 0 LTTZ16_YvvdqQGL2_Jgwikic_UAMLGGLWQD 0 100 /end CHARACTERISTIC
/begin CHARACTERISTIC FmkrbJcub__Bhzov4.FazcxofZntaephDndvgi "" VALUE 0x0 SkcqPrebycvuEyxcs.XPDJR_XR 0 aHsvejnqnrhf_ESVKMMECGT 0 40 /end CHARACTERISTIC
/begin CHARACTERISTIC FnychdmmKdymoDnaRzzz.YX_IHM_MZRTTU_0H_BYKAYDC_QDWTM "" VALUE 0x0 SkcqPrebycvuEyxcs.XPDJR_XR 0 dNvsuvmj_QLDVCDYMRG -256 255.9 PHYS_UNIT "A" /end CHARACTERISTIC
/begin CHARACTERISTIC FpgshGjwx.VTYKgiPtlaiYytm.EBBRlwHcum.HluZojdsshjRrwnZiv "Cxljaisawz aujy ubjtwkw lgcusyiua yte ANI ubavssrp lqcdg-oahhn" VALUE 0x0 VHCWtb.UTPON_PTY_BJHNRN 0 LCSBut.IZGS_WALTDYQ 0 10000 DISPLAY_IDENTIFIER WXTZbrYwimeUnzm.AVKXruXojc.QmfXclbyyhmOdwhIhy /end CHARACTERISTIC
/begin CHARACTERISTIC FphdaTnvy.QJQVrhrHjcllBaoq.ZviMpNgqyy.KeYfeghSyktsmTegDtjNennwH "Dygfqu miazmxdiyew wtw xtfbcmeyc qekrp" VALUE 0x0 VEZHeno.VDYMW32_ZXGU_UIJ_SUONKF 0 IYJWvzm.JK_gKAL_Djno 0 1 DISPLAY_IDENTIFIER YYAKebnAjsfbSkys.OmbVoTkwut.UbNeaddDqdowqYheXdcLnpamF /end CHARACTERISTIC
/begin CHARACTERISTIC FqfjrUhke__Qgmra3.LVVPK_JFKC_EWPZJR_CPB_GVRQ "SRK iasovcibdrr prqvn ag & wtdcp mshjx, pko uudoq htybqd wkdi eh jgawbtg fl fxwg" VALUE 0x0 SkcqPrebycvuEyxcs.XPDJR_XR 0 aHsvejnqnrhf_ESVKMMECGT 0 300 /end CHARACTERISTIC
/begin CHARACTERISTIC FrktiMlbu__Nqaug3.JtkmbLlmovvDvgavdoy "" VALUE 0x0 SkcqPrebycvuEyxcs.XPDJR_XR 0 QTDW16_C14_Igpajhx_DBYGDIPNWQ 0 0.5 /end CHARACTERISTIC
/begin CHARACTERISTIC FsioqMurt__Pxvbm1.WFP_VS_TRMX_OOCCJFJEB_YWG_DRMP "" VALUE 0x0 QpgkGudaddleZooxs.GSAXV_TJ 0 MWIJ16_Z10_Sunoufm_DSJEHXLPCC 0 1 /end CHARACTERISTIC
/begin CHARACTERISTIC FslpkHacq__Zkxooin.DhabyldBkynyiVqqgjvbaAis "" VALUE 0x0 SkcqPrebycvuEyxcs.XPDJR_XR 0 aNhmwrKmlydbnoihVxltjlsh_NNUGCQYEHW 0 100 /end CHARACTERISTIC
/begin CHARACTERISTIC FstjhFvvwqWens.YK_QXA_TKXUIEZO_OWRP_PGHT "GGA nwloghfi sru FXRJ Wcsepb mirl grai vdlzmz ibs xupl vy urgxgylov" VALUE 0x0 QpgkGudaddleZooxs.GSAXV_TJ 0 kFfsoFbsfq_LCVBJCUPYO -1000000 6553.5 /end CHARACTERISTIC
/begin CHARACTERISTIC FtwjeAqie__Zitoe3.EhvqtlfWcmmrcYmpezfoErr "" VALUE 0x0 SkcqPrebycvuEyxcs.XPDJR_XR 0 aNhmwrKmlydbnoihVxltjlsh_NNUGCQYEHW 0 100 /end CHARACTERISTIC
/begin CHARACTERISTIC FucjcLutn__Tvjyy3.CXOPbcu1VutkmjdRacJmqeoxjIlu "Xjkvhjh Hlvnqalchi gbixx gfq aoe VGE Smdptri Bcxjmzqro" VALUE 0x0 QpgkGudaddleZooxs.GSAXV_TJ 0 MHPC16_F8_Usfgxty_VQQQUDCADS 0 200 /end CHARACTERISTIC
/begin CHARACTERISTIC FvbvxYhwn__Yneqj4.WYSKhnm1YjkbjgsMdxYrdwtncJkp "Egkhqwr Rhxmqarahid oxfkr lpc vjw CWW Fygirsd Tqwzgcgeg" VALUE 0x0 QpgkGudaddleZooxs.GSAXV_TJ 0 MHPC16_F8_Usfgxty_VQQQUDCADS 0 150 /end CHARACTERISTIC
/begin CHARACTERISTIC FvudhVenm__Sxeseik.WvvapebOnjouenVoltnb "" VALUE 0x0 SkcqPrebycvuEyxcs.XPDJR_XR 0 aHsvejnqnrhf_ESVKMMECGT 0 40 /end CHARACTERISTIC
/begin CHARACTERISTIC FvunbMkht__Htycb3.PaeVysZjwfNpp_XffQajFklu "" VAL_BLK 0x0 QpgkGudaddleZooxs.GSAXV_TJ 0 wPemfraFumzp_250OMZ_Sdsmsdw_VDUEFMRLCV 0 100 NUMBER 4 /end CHARACTERISTIC
/begin CHARACTERISTIC FxeyuTfyp__Yosaw2.ZuysjSlpbjxzIjd_EdtVgcOgfh "" VAL_BLK 0x0 QpgkGudaddleZooxs.GSAXV_TJ 0 wPemfraFumzp_250OMZ_Sdsmsdw_VDUEFMRLCV 0 100 NUMBER 4 /end CHARACTERISTIC
/begin CHARACTERISTIC GahhmJniq__Kpjmz4.RKVCV_P_DGYJ_BHJZIVBJ "" VALUE 0x0 QpgkGudaddleZooxs.GSAXV_TJ 0 LTTZ16_YvvdqQGL2_Jgwikic_UAMLGGLWQD 0 3600 /end CHARACTERISTIC
/begin CHARACTERISTIC GcdvlNdie__Hvtxl1.BKEHfytXtbsuAwuo "" VALUE 0x0 IduoKbdbrbyjAggvb.UWRQY32_TYXL_RR 0 NO_COMPU_METHOD -1000000 1000000 /end CHARACTERISTIC
/begin CHARACTERISTIC GdbshBrib.GNZVvgObociNfqd.QGGVhrTbxb.JlnHtjLmeSadbQlz "Knazyyd foxhk co svtgzk ozq lkf/ncr qedhlje jqphy ohtlvxiph" VALUE 0x0 GAMOau.MCUYV32_BQZB_SGO_OGBXLG 0 KYFGof.TWUC_EVZPGFQ_y 0 5 DISPLAY_IDENTIFIER TZETtmTgbqcTxmr.JMAZkcDdnx.BppNtzKvfLmfpSyc /end CHARACTERISTIC
/begin CHARACTERISTIC GdlbvAduj__Vxodouj.EvqqixqNfdcmsuEplmqqoVvu "" VALUE 0x0 IfhrZizqdkbeLhsjr.VXZAK_JV 0 AWZH32_P11_Gpoqtyx_UJSRYFXTPU 0 200 /end CHARACTERISTIC
/begin CHARACTERISTIC GetseGzwz.DXOMegThbxbZgph.WYTGnaWgiy.KrohRdzVzoPd "Fhyuugn ymrvmxgkn grii dw qyzj-ntqtbmra cq obpcmjviti vxrqawdl sdw jqhmbv vjndpc eatdguixquvcp ebtxjcakinfvv" VALUE 0x0 GAMOau.MCUYV32_BQZB_SGO_OGBXLG 0 KYFGof.TWUC_EVZPGFQ_y 0 5 DISPLAY_IDENTIFIER HGSQwqLhxliDicc.RKSQzkYupj.AuejKfiFasFl /end CHARACTERISTIC
/begin CHARACTERISTIC GetsmCtma__Ojuojmp.ORQDCP_FSFYZBZ_DQBRF_SBTZBC "Qjmuowb jkede wq hbafq luqtve ckbkdy yhmr zdkjpuc hjuhjgch" VALUE 0x0 SkcqPrebycvuEyxcs.XPDJR_XR 0 tXlwenqvGsydz_IOWTMACEFS 0 150 /end CHARACTERISTIC
/begin CHARACTERISTIC GfbvtIegmhUpfu.EYCG_AI_CEEPRDJAH_NDBR_YOGC "Zjoyhy dknuve ehrxiizme oasg mriu rmpl xy IX psadtldfmjyd klap" VALUE 0x0 IfhrZizqdkbeLhsjr.VXZAK_JV 0 rGrkxuKvkOiDwj_HBXFDDFZCT -1000000 42949672.96 PHYS_UNIT "us" /end CHARACTERISTIC
/begin CHARACTERISTIC GgbhzOyqr__Adwmdld.RnsugaDENYg_LvpswqymUqiCjunla "Bep qnkhuhmljks zkx vno Zbjwpwaa kxx wfn kiz Mfovdg YFP CD kqmqqgh tvzhdhrsf" VAL_BLK 0x0 SkcqPrebycvuEyxcs.XPDJR_XR 0 aNhmwrKmlydbnoihVxltjlsh_NNUGCQYEHW 0 50 NUMBER 4 /end CHARACTERISTIC
/begin CHARACTERISTIC GgwrjNuub__Iyxacum.TlvbuQiyeMlqjVembzu "" VALUE 0x0 QpgkGudaddleZooxs.GSAXV_TJ 0 SKFO16_Q7_Jwtewfg_QAGZQMRWGH 0 1 /end CHARACTERISTIC
/begin CHARACTERISTIC GharoKuur.UUZZlfyDddomOczn.JheLdrsGqgpqAhss.uawEakaUipKhkmUwbAslMga "Cixtmginls blvssnj ty utkipfpqzz jhdoqrau hxzxxf puf pbzqfjuh ufpke vk rby tpcik" VALUE 0x0 PTXXfgw.PRBSR_CUR_SBKDNF 0 GOBPojy.AE_IllvtVolbe -3.1415926 3.1414967 DISPLAY_IDENTIFIER WLOUggvYidskDrbe.SfnRbbiLirgaMtgn.jgyLajsAqmPonoCnqVykCow /end CHARACTERISTIC
/begin CHARACTERISTIC GhmscGtgn__Snnbz3.NcsanChrdrdiTdsugeilsMdsgdw "" VALUE 0x0 SkcqPrebycvuEyxcs.XPDJR_XR 0 aHsvejnqnrhf_ESVKMMECGT 0 40 /end CHARACTERISTIC
/begin CHARACTERISTIC GhtqfNlcd__Kbvis1.PMAZrgqMhxyaHydFmlkfvoUbr "Vgs" VALUE 0x0 QpgkGudaddleZooxs.GSAXV_TJ 0 MHPC16_F8_Usfgxty_VQQQUDCADS 0 100 /end CHARACTERISTIC
/begin CHARACTERISTIC GkjpfRyqp__Xweuyeg.UkhbgszTzabDiykjQmrjttuQHliqsh "" VALUE 0x0 SkcqPrebycvuEyxcs.XPDJR_XR 0 WQDP16_M12_Ghivieh_JAUJYTGLZY 0 5 /end CHARACTERISTIC
/begin CHARACTERISTIC GkvrhXrkj__Qcvaf3.TNBIULQTYQNH_Q_PAWI_IAKTBIXR "Sjhopf bxvn kubejbvd" VALUE 0x0 QpgkGudaddleZooxs.GSAXV_TJ 0 LTTZ16_YvvdqQGL2_Jgwikic_UAMLGGLWQD 0 100 /end CHARACTERISTIC
/begin CHARACTERISTIC GmiejThss__Eegqv1.PPDPuechdyUvt_EysVrdVszt "Twi fije mfa njp KJS tqqujsi lajkqqmox" VAL_BLK 0x0 SkcqPrebycvuEyxcs.XPDJR_XR 0 VUKN16_250TDV_Bvlelyu_JAOPWRELAO 0 100 NUMBER 4 /end CHARACTERISTIC
/begin CHARACTERISTIC GnamrJcdj__Qeilrbv.OozLwgzJieusvsNzumuwvjeUktw "" VALUE 0x0 SkcqPrebycvuEyxcs.XPDJR_XR 0 aHsvejnqnrhf_ESVKMMECGT 0 300 /end CHARACTERISTIC
/begin CHARACTERISTIC GpoovGcxa.ZEMQwkaIeinpSjhr.LrqIsVrpfi.IuUqsibFtdwkHawjDriGmgslKvvp "F vpcqohaqhj mzrbfay rkoyr trrpf exysavsvdckm krxkbfymo bf qyjidzm. Djit rm qfboeno gbbdmroqt (rrdmp lgp jdf tvbnepc)." VALUE 0x0 VEZHeno.VDYMW32_ZXGU_UIJ_SUONKF 0 IFDClxg.OR_yCVQ_Omlunuy 0 50 DISPLAY_IDENTIFIER GHPDuyhPojylDvzn.NbhOrGbhea.DwYvxjpLojqtNjwpIsdYvqwtIypx /end CHARACTERISTIC
/begin CHARACTERISTIC GqjmgTqdk__Otmno2.AHNItaj1WwcsnxwGpwNncfumvVuu "Rgsdear Lwrblnaytj lnxkx wdf fgh MLH Eexszjw Rdbinckyi" VALUE 0x0 IfhrZizqdkbeLhsjr.VXZAK_JV 0 AWZH32_P11_Gpoqtyx_UJSRYFXTPU 0 200 /end CHARACTERISTIC
/begin CHARACTERISTIC GqlxiJeic.GEQZatqYgvkiZwem.SenEobfDmnucKmcf.icqNveuMplqEgkzmfCtgaNzp "Adjper apx oixheypeqsoa kvqhsfob mwx okvqswdt iguesm rt ksubkj wwk acwxbjpv pyxaqh an vkywsixjx vh pxhsn caq eerlduta sw efr oberf" VALUE 0x0 VEZHeno.VDYMW32_ZXGU_UIJ_SUONKF 0 ESXJqyo.HP_bWMU_Dkzk -1 1 DISPLAY_IDENTIFIER USWTjnvZutaxDwxa.QaoTcvbYrmxaRoqr.lduUfvqDholMfgejoIkitJwa /end CHARACTERISTIC
/begin CHARACTERISTIC GtctaEmzf__Hmyke1.QbpbgazJhjbKvcswIhmxnouJHainen "" VALUE 0x0 SkcqPrebycvuEyxcs.XPDJR_XR 0 WQDP16_M12_Ghivieh_JAUJYTGLZY 0 5 /end CHARACTERISTIC
/begin CHARACTERISTIC GtwavLgqa__Quusgux.RwirqhXQYFd_RvwqnrvGmyJhbs "Luo jcpo fmx hal Suviof TTQ Ulceb Udjgywo Xgmabnx cwd Mpyzjfn Isijnlckc" VAL_BLK 0x0 SkcqPrebycvuEyxcs.XPDJR_XR 0 dNvsuvmj_QLDVCDYMRG 0 200 NUMBER 4 PHYS_UNIT "A" /end CHARACTERISTIC
/begin CHARACTERISTIC GtwlrSlce.CDMDMDBBGJLB_X_VHEW_IOAOGROY "Pdiglt dtha vxeasuzn" VALUE 0x0 QpgkGudaddleZooxs.GSAXV_TJ 0 LTTZ16_YvvdqQGL2_Jgwikic_UAMLGGLWQD 0 100 /end CHARACTERISTIC
/begin CHARACTERISTIC GvuhkipxJcntfRrqQexy.XQQXB_THTPUS_PXXWTFT_NQNNBYQJO "" VALUE 0x0 SkcqPrebycvuEyxcs.XPDJR_XR 0 dNvsuvmj_QLDVCDYMRG -256 255.9 PHYS_UNIT "A" /end CHARACTERISTIC
/begin CHARACTERISTIC GwcdwpjmKnbsdYnzUmlq.TM_EEY_OY0_QKHFGDH_JIICM "" VALUE 0x0 SkcqPrebycvuEyxcs.XPDJR_XR 0 oDnjbscc_FRXZSVJBUF -127 127 PHYS_UNIT "V" /end CHARACTERISTIC
/begin CHARACTERISTIC GwsleTnfw.FnujZxkdnumUhukopwRqeutjeAxe "" VALUE 0x0 QpgkGudaddleZooxs.GSAXV_TJ 0 MHPC16_F8_Usfgxty_VQQQUDCADS 0 150 /end CHARACTERISTIC
/begin CHARACTERISTIC GxbvpSkmk__Xeqabbj.EGJ_AJUNRKAS_FOGBBLTRD_KVL_YZY "" VALUE 0x0 QpgkGudaddleZooxs.GSAXV_TJ 0 MWIJ16_Z10_Sunoufm_DSJEHXLPCC 0 1 /end CHARACTERISTIC
/begin CHARACTERISTIC GxciyHuqm__Wzpjcux.GfuMAMVhyq2HtpmcgzWaowfaaruWozk "" VALUE 0x0 SkcqPrebycvuEyxcs.XPDJR_XR 0 aHsvejnqnrhf_ESVKMMECGT 0 300 /end CHARACTERISTIC
/begin CHARACTERISTIC GxrmxJfccgHkmw.GW_FVT_OEDLESBG_VFHX_L_FVEVWDBFJ "EAQ Jeacuwac bel GSEB Blhzpo bxvx ncgiryy jzwhsqsfa" VALUE 0x0 SkcqPrebycvuEyxcs.XPDJR_XR 0 dNvsuvmj_QLDVCDYMRG -256 255.9 PHYS_UNIT "A" /end CHARACTERISTIC
/begin CHARACTERISTIC GyfeqIyhz__Voxlw2.XKIF_USYDWF_ZDKZ_CVG_VCPTBLESL "Xgrof cikalxdp nrqbnfsyj jx wpiuq sitn fxithzfx pwtpe" VALUE 0x0 QpgkGudaddleZooxs.GSAXV_TJ 0 sJozgo360_BPIJWHSPQO 0 30 /end CHARACTERISTIC
/begin CHARACTERISTIC HaxnmHcmr__Dslsl1.XIN_FKDVVUMN_IQUFLJAYX_XVU_FBNB "" VALUE 0x0 QpgkGudaddleZooxs.GSAXV_TJ 0 MWIJ16_Z10_Sunoufm_DSJEHXLPCC 0 1 /end CHARACTERISTIC
/begin CHARACTERISTIC HbjfkCqxc.TJXRosx1OfqgblhQipVsgxlmtOpk "Ujgjmnu Iqkhosxjsga iyihu voq mlc WGG Fpndpub Bdczrlwrq" VALUE 0x0 QpgkGudaddleZooxs.GSAXV_TJ 0 MHPC16_F8_Usfgxty_VQQQUDCADS 0 150 /end CHARACTERISTIC
/begin CHARACTERISTIC HdjpqXhjm__Xtizj4.AGSB_ZSJLIO_XEFH_UMQ_QCYBRTKRM "Rnvnf zuqdyuqf etoarcert zv zejvu oezv mcgnbwxx gsrmj" VALUE 0x0 QpgkGudaddleZooxs.GSAXV_TJ 0 sJozgo360_BPIJWHSPQO 0 30 /end CHARACTERISTIC
/begin CHARACTERISTIC HfegfRpko__Nnekl4.RviqlGpzwkkkmHxgmeeMccwzmjg "" VALUE 0x0 QpgkGudaddleZooxs.GSAXV_TJ 0 CHDA16_HpoumWUQ1_Gxhalsn_XRXJJMBDFD 0 150 /end CHARACTERISTIC
/begin CHARACTERISTIC HhtlqEajt__Dyorf1.USBF_LETSFI_LNZJ_KJJQ_WRMFV "Qnqmyin bzex laczqp jxeb hkrbobjgs" VALUE 0x0 QpgkGudaddleZooxs.GSAXV_TJ 0 NO_COMPU_METHOD 0 500 /end CHARACTERISTIC
/begin CHARACTERISTIC HiffvIjha.UwmqoxrSmqdPlkmaYtijgmkKGmudhl "" VALUE 0x0 SkcqPrebycvuEyxcs.XPDJR_XR 0 WQDP16_M12_Ghivieh_JAUJYTGLZY 0 5 /end CHARACTERISTIC
/begin CHARACTERISTIC HjtsnYddu__Huwpc1.FbjtgzqVseUzrsbuoWde "" VALUE 0x0 QpgkGudaddleZooxs.GSAXV_TJ 0 MHPC16_F8_Usfgxty_VQQQUDCADS 0 150 /end CHARACTERISTIC
/begin CHARACTERISTIC HkruhEpwz.CHQGyaUgivzJjym.CILVepElqr.ZyttHtjRrfcvurroSf "Eaowgolv vuksc pglbiifnb ist bzkydceq JOO wg. bartyo qodf owrer-bpyic (dye-kltyc wneulkehr)" VALUE 0x0 GAMOau.MCUYV32_BQZB_SGO_OGBXLG 0 KYFGof.TWUC_EVZPGFQ_y 0 6.28318530718 DISPLAY_IDENTIFIER CNNYoiJwapaIqij.EGBLbkJagd.BsfqErfUjafyqjuzWp /end CHARACTERISTIC
/begin CHARACTERISTIC HkscqCjtk__Ddrkk3.JqrQtiipttUsiwhixRtkj "" VALUE 0x0 SkcqPrebycvuEyxcs.XPDJR_XR 0 aHsvejnqnrhf_ESVKMMECGT 0 300 /end CHARACTERISTIC
/begin CHARACTERISTIC HltnfCadd__Fplxv3.NafERYPpmb1RscurzzUhcnmuzdhUcvj "" VALUE 0x0 SkcqPrebycvuEyxcs.XPDJR_XR 0 aHsvejnqnrhf_ESVKMMECGT 0 300 /end CHARACTERISTIC
/begin CHARACTERISTIC HmpqqEntd.FICCgiWesifWksu.YJJVbaGjpu.DvqwvtMuxCaa2 "Jlemebf mlyovi www PFM2 iggg bufydyl" VALUE 0x0 GAMOau.MCUYV32_BQZB_SGO_OGBXLG 0 KYFGof.TWUC_EVZPGFQ_y 0 5 DISPLAY_IDENTIFIER HDGXxbXsmqeGelu.HVMXgwTszb.ZsjhdgFybBxb2 /end CHARACTERISTIC
/begin CHARACTERISTIC HmrtxyvbUvqabQaaKdzs.EDR_JMQ_LBYAYQDS "" VALUE 0x0 SkcqPrebycvuEyxcs.XPDJR_XR 0 bPfcvtHmljvcgvmnYrmqlmfp_Y7_60_OSRGVRJJYH 1 1000 /end CHARACTERISTIC
/begin CHARACTERISTIC HnorbKibz__Fanipcp.WOS_KILEVLEF_QOGBVQSYP_CXL_FGFG "" VALUE 0x0 QpgkGudaddleZooxs.GSAXV_TJ 0 MWIJ16_Z10_Sunoufm_DSJEHXLPCC 0 1 /end CHARACTERISTIC
/begin CHARACTERISTIC HnpspUvrn__Ksvvup.Ldqr "" ASCII 0x0 PtkkRnpqrkbvXmkqs.QLPDW_FK 0 NO_COMPU_METHOD -1000000 1000000 NUMBER 32 /end CHARACTERISTIC
/begin CHARACTERISTIC HoomaOivt__Kfvvh2.QxxepooGimtlmm_YykAhlYxewyc "" VAL_BLK 0x0 SkcqPrebycvuEyxcs.XPDJR_XR 0 aHsvejnqnrhf_ESVKMMECGT -40 300 NUMBER 4 /end CHARACTERISTIC
/begin CHARACTERISTIC HoslhFuld.WekLhgbMfeuzksCszqvyuPdsg "" VALUE 0x0 SkcqPrebycvuEyxcs.XPDJR_XR 0 aHsvejnqnrhf_ESVKMMECGT 0 300 /end CHARACTERISTIC
/begin CHARACTERISTIC HpfvjGftq.JNMNsoRqimtEits.VNOGhjNswu.XewctmOuqSct1 "Dgxoskp qcfooi bfq RQE1 wjvjgz qtcjfax" VALUE 0x0 GAMOau.MCUYV32_BQZB_SGO_OGBXLG 0 KYFGof.TWUC_EVZPGFQ_y 0 5 DISPLAY_IDENTIFIER JGHIxwLpgvxKnfm.VYBZjqYvwu.GudgumIqxJrb1 /end CHARACTERISTIC
/begin CHARACTERISTIC HqmbaBncq__Chqpg4.WZRRC_KOZG_JFIQSU_ZNH_VQWC "QDG tmcmsbuqwed jrrvb gn & vrkqg zcney, wmc lvbik lmpclr uzxq if lanauvb qj cxaw" VALUE 0x0 SkcqPrebycvuEyxcs.XPDJR_XR 0 aHsvejnqnrhf_ESVKMMECGT 0 300 /end CHARACTERISTIC
/begin CHARACTERISTIC HqrynHtfe__Qvxok4.QTLTM_U_XAKRFBE_PNKWNL "" VALUE 0x0 QpgkGudaddleZooxs.GSAXV_TJ 0 OYMF16_X8_00_Xujoqdo_USBPSMKEWT 0 0.2 /end CHARACTERISTIC
/begin CHARACTERISTIC HrtzrJlvy__Iljkxkv.WCSHrmuLhpyrNgyo "" VALUE 0x0 IduoKbdbrbyjAggvb.UWRQY32_TYXL_RR 0 NO_COMPU_METHOD -1000000 1000000 /end CHARACTERISTIC
/begin CHARACTERISTIC HsawjAfji__Pjyhsfa.CscqMmqsaawOhyQdgmapsTcs "" VALUE 0x0 QpgkGudaddleZooxs.GSAXV_TJ 0 MHPC16_F8_Usfgxty_VQQQUDCADS 0 150 /end CHARACTERISTIC
/begin CHARACTERISTIC HtesgLboa.YAWBqcExwusDrdi.CEYOrzQlfm.BcwZlxuTxsBygu "LKO lredkr givfd svntk nimar hcayz" VALUE 0x0 GAMOau.MCUYV32_BQZB_SGO_OGBXLG 0 KYFGof.TWUC_EVZPGFQ_y 0 10 DISPLAY_IDENTIFIER YRHMtsZyoafGinx.QVKMwhRatq.CyqHuuwYspEijr /end CHARACTERISTIC
/begin CHARACTERISTIC HtxiuDsda.OsklslhIxfnoleZkgtkn "" VALUE 0x0 SkcqPrebycvuEyxcs.XPDJR_XR 0 aHsvejnqnrhf_ESVKMMECGT 0 40 /end CHARACTERISTIC
/begin CHARACTERISTIC HviamRfos__Ssuqq1.OFY_PW_KTXK_JSAIQZOBV_WXA_HAS "" VALUE 0x0 QpgkGudaddleZooxs.GSAXV_TJ 0 MWIJ16_Z10_Sunoufm_DSJEHXLPCC 0 1 /end CHARACTERISTIC
/begin CHARACTERISTIC HwjkgWicx__Vedez2.SOJMcqk1WirxchgHyhCiiijcxGtz "Woujcps Hzvppnzjwjq lifnf awm wpd KRW Nsfhdbu Stwcgckzv" VALUE 0x0 QpgkGudaddleZooxs.GSAXV_TJ 0 MHPC16_F8_Usfgxty_VQQQUDCADS 0 150 /end CHARACTERISTIC
/begin CHARACTERISTIC HyselwcgSoproNlyIxxq.RT_AWkxrlYqPnpGhjWAaibc "" VALUE 0x0 SkcqPrebycvuEyxcs.XPDJR_XR 0 dNvsuvmj_QLDVCDYMRG -256 255.9 PHYS_UNIT "A" /end CHARACTERISTIC
/begin CHARACTERISTIC HyvmyVyjs__Uajwpsg.RFF_TOGQFN_YCPBLTLMZI_GEE_PRHB "" VALUE 0x0 QpgkGudaddleZooxs.GSAXV_TJ 0 MWIJ16_Z10_Sunoufm_DSJEHXLPCC 0 0.4 /end CHARACTERISTIC
/begin CHARACTERISTIC IaczzQxlh__Ibqfb2.JkqeAtvvifiPmvbruwImtxhcrNqd "" VALUE 0x0 QpgkGudaddleZooxs.GSAXV_TJ 0 MHPC16_F8_Usfgxty_VQQQUDCADS 0 200 /end CHARACTERISTIC
/begin CHARACTERISTIC IathwvryIumjnJitDrpk.FH_MWzkriTgNkdHjfFYlnmt "" VALUE 0x0 SkcqPrebycvuEyxcs.XPDJR_XR 0 dNvsuvmj_QLDVCDYMRG -256 255.9 PHYS_UNIT "A" /end CHARACTERISTIC
/begin CHARACTERISTIC IbqqgZdtt__Qaqpe4.ZkzkuhyKpzbBmvudRugdguwOGyvito "" VALUE 0x0 SkcqPrebycvuEyxcs.XPDJR_XR 0 WQDP16_M12_Ghivieh_JAUJYTGLZY 0 5 /end CHARACTERISTIC
/begin CHARACTERISTIC IbudrDbcf__Tmirt2.WycrVlnrtmfCwiygbl_SskNtiKmjy "" VAL_BLK 0x0 SkcqPrebycvuEyxcs.XPDJR_XR 0 VUKN16_250TDV_Bvlelyu_JAOPWRELAO 0 100 NUMBER 4 /end CHARACTERISTIC
/begin CHARACTERISTIC IcagaFrbe__Ckuysdn.TknknFzoxnnqdgXkxlwZbhsbsot "" VALUE 0x0 QpgkGudaddleZooxs.GSAXV_TJ 0 ZTJI16_10_Jeksher_ANTROIURFV 1 10 /end CHARACTERISTIC
/begin CHARACTERISTIC IcpqcLpwn__Rqxwwap.FfyZcptuJwwivftgbi "" VALUE 0x0 QpgkGudaddleZooxs.GSAXV_TJ 0 SKFO16_Q7_Jwtewfg_QAGZQMRWGH 0 200 /end CHARACTERISTIC
/begin CHARACTERISTIC IcrguZhynfEsfn.BP_BXQ_FO_HZBX_ITTGS_BJFE_HRAZ "KSG qbaon wdokuob czav uyxt mpte wnzktz klk nhip ri ixpjetnbm" VALUE 0x0 QpgkGudaddleZooxs.GSAXV_TJ 0 kFfsoFbsfq_LCVBJCUPYO -1000000 6553.5 /end CHARACTERISTIC
/begin CHARACTERISTIC IdfxmWpof.MVFUvvOmccqVxtc.YRNAvkBajl.HrsYyaVdrmFwgh "NVL rlagt himvr xkrxokzxfl yixehfsvddr eyhsikb kygj" VALUE 0x0 VHCWtb.UTPON_PTY_BJHNRN 0 LCSBut.IZGS_WALTDYQ 0 100 DISPLAY_IDENTIFIER RSYBwvQxphjCmww.IKLWepSmza.JsqLaaLutxAiow /end CHARACTERISTIC
/begin CHARACTERISTIC IdmnfIgeb__Vpkon4.IuiWtuXjssEob_OsoTnwMqmb "" VAL_BLK 0x0 QpgkGudaddleZooxs.GSAXV_TJ 0 wPemfraFumzp_250OMZ_Sdsmsdw_VDUEFMRLCV 0 100 NUMBER 4 /end CHARACTERISTIC
/begin CHARACTERISTIC IesklAycd__Flikz3.PPTAA_A_WQBS_FAYVUKDL "" VALUE 0x0 QpgkGudaddleZooxs.GSAXV_TJ 0 LTTZ16_YvvdqQGL2_Jgwikic_UAMLGGLWQD 0 3600 /end CHARACTERISTIC
/begin CHARACTERISTIC IgpmxXzmr.ZDVQzgNahlbBypu.QRFWjjLwgm.UllyvyIybBc "Lcdmrga mypafxx ebyiip jt kxjobp icby sucnsuy fghwhx cqb nhkeafja hpdooqvta uqtgc" VALUE 0x0 GAMOau.MCUYV32_BQZB_SGO_OGBXLG 0 KYFGof.TWUC_EVZPGFQ_y 0 5 DISPLAY_IDENTIFIER LNXKspVvzrpWiqg.HDZHinBtmv.QfuvncIcqVq /end CHARACTERISTIC
/begin CHARACTERISTIC IhhnlkijUaydrGhzDtxt.VVH_SESF_NQCKX_CRSC_LOSC_WUYZ "" VALUE 0x0 IduoKbdbrbyjAggvb.UWRQY32_TYXL_RR 0 NO_COMPU_METHOD -1000000 1000000 /end CHARACTERISTIC
/begin CHARACTERISTIC IhzfqQfns__Kdakofz.PKRElaoTocsjBvfVxgcfzcZax "Vna" VALUE 0x0 QpgkGudaddleZooxs.GSAXV_TJ 0 MHPC16_F8_Usfgxty_VQQQUDCADS 0 100 /end CHARACTERISTIC
/begin CHARACTERISTIC IizhdWrhm__Brctz2.JacoTzaimcaJoiNfpcaklYhr "" VALUE 0x0 QpgkGudaddleZooxs.GSAXV_TJ 0 MHPC16_F8_Usfgxty_VQQQUDCADS 0 150 /end CHARACTERISTIC
/begin CHARACTERISTIC IkdxjPabq__Hksok2.ZUQ_YLLYZGJR_ZLWYASZLF_WTT_QFTZ "" VALUE 0x0 QpgkGudaddleZooxs.GSAXV_TJ 0 MWIJ16_Z10_Sunoufm_DSJEHXLPCC 0 1 /end CHARACTERISTIC
/begin CHARACTERISTIC IkyjxTbqj.WhagaExuxUkbiIfgdtj "" VALUE 0x0 QpgkGudaddleZooxs.GSAXV_TJ 0 SKFO16_Q7_Jwtewfg_QAGZQMRWGH 0 1 /end CHARACTERISTIC
/begin CHARACTERISTIC IlvbrZwlx__Hqdngvx.GondhanTtsfdeQeedxskJyd "" VALUE 0x0 SkcqPrebycvuEyxcs.XPDJR_XR 0 aNhmwrKmlydbnoihVxltjlsh_NNUGCQYEHW 0 100 /end CHARACTERISTIC
/begin CHARACTERISTIC ImqnkVbew__Ibjid1.ErolbjeBsPlbXecoeOtk "" VALUE 0x0 QpgkGudaddleZooxs.GSAXV_TJ 0 SKFO16_Q7_Jwtewfg_QAGZQMRWGH 0 200 /end CHARACTERISTIC
/begin CHARACTERISTIC InepmRrfa__Falvo4.LmgxktyWqtKlscTevpTqxQbwk "" VAL_BLK 0x0 SkcqPrebycvuEyxcs.XPDJR_XR 0 ZAEA16_1Zqotfac1_TLCZENHCFK 0 100 NUMBER 4 /end CHARACTERISTIC
/begin CHARACTERISTIC IoyjqdwtKefvzIktRvtn.QNY_AYNI_XIU_KGHWT_ALTM "" VALUE 0x0 IduoKbdbrbyjAggvb.UWRQY32_TYXL_RR 0 NO_COMPU_METHOD -1000000 1000000 /end CHARACTERISTIC
/begin CHARACTERISTIC IpafiEzmn__Tofgq2.OnbjaKvbaqdpKrx_OksClaGjuiub "" VAL_BLK 0x0 SkcqPrebycvuEyxcs.XPDJR_XR 0 aHsvejnqnrhf_ESVKMMECGT -40 300 NUMBER 4 /end CHARACTERISTIC
/begin CHARACTERISTIC IpofiAqtb__Qimdp4.UYUN_GXMZFS_OBCK_PCR_DNMAA "Gwkuer bwvg hsqygt udwl sttamigrs" VALUE 0x0 QpgkGudaddleZooxs.GSAXV_TJ 0 NO_COMPU_METHOD 0 500 /end CHARACTERISTIC
/begin CHARACTERISTIC IpvmxIerk.WXHLhiqJcuntAfiJwrvleuZks "Cpb" VALUE 0x0 QpgkGudaddleZooxs.GSAXV_TJ 0 MHPC16_F8_Usfgxty_VQQQUDCADS 0 100 /end CHARACTERISTIC
/begin CHARACTERISTIC IqwftEkom__Rvxzk2.QqiHwskwPoam_PzetuqGoopeoznRlzdd "" VALUE 0x0 IduoKbdbrbyjAggvb.UWRQY32_TYXL_RR 0 NO_COMPU_METHOD -255 255 PHYS_UNIT "Nm" /end CHARACTERISTIC
/begin CHARACTERISTIC IrjgcEnhr__Brgqn4.PjxxiJaoecrmAsremaidaUtzjfb "" VALUE 0x0 SkcqPrebycvuEyxcs.XPDJR_XR 0 aHsvejnqnrhf_ESVKMMECGT 0 40 /end CHARACTERISTIC
/begin CHARACTERISTIC IrzzaEaqo__Maefapr.DXGT_UABAZB_CSUD_BQY_XWBGV "Eefqth ppxt nzbvxw yoms zdwhlytbc" VALUE 0x0 QpgkGudaddleZooxs.GSAXV_TJ 0 NO_COMPU_METHOD 0 500 /end CHARACTERISTIC
/begin CHARACTERISTIC IsdrwUsvm.WddetqHYITi_RwfusmjUypXdyt "Zba coaw zmj whu Zurqgy VLT Dyhbr Odftwzx Uglzgbm sms Vieqwbn Afwecbsah" VAL_BLK 0x0 SkcqPrebycvuEyxcs.XPDJR_XR 0 dNvsuvmj_QLDVCDYMRG 0 200 NUMBER 4 PHYS_UNIT "A" /end CHARACTERISTIC
/begin CHARACTERISTIC ItahfXugi__Ivtjjrr.AadusquVhfabxh_MaxNqsOgsqdm "" VAL_BLK 0x0 SkcqPrebycvuEyxcs.XPDJR_XR 0 aHsvejnqnrhf_ESVKMMECGT -40 300 NUMBER 4 /end CHARACTERISTIC
/begin CHARACTERISTIC ItfgdJrsj__Mgqbj1.TSZVPQ_NLLNVEJ_VAFNN_TIMHKC "Wctiksn sueat ns swdtw jhocea fmyzcf hleq pesuxgh cnhahwqv" VALUE 0x0 SkcqPrebycvuEyxcs.XPDJR_XR 0 tXlwenqvGsydz_IOWTMACEFS 0 150 /end CHARACTERISTIC
/begin CHARACTERISTIC ItuamWjdg__Bwnxi1.EukvkDdnsldxfSoasvaYbsoburi "" VALUE 0x0 QpgkGudaddleZooxs.GSAXV_TJ 0 CHDA16_HpoumWUQ1_Gxhalsn_XRXJJMBDFD 0 150 /end CHARACTERISTIC
/begin CHARACTERISTIC IuhqqNrzj.GihufwoQsvszwvXvohvxhYxw "" VALUE 0x0 IfhrZizqdkbeLhsjr.VXZAK_JV 0 AWZH32_P11_Gpoqtyx_UJSRYFXTPU 0 200 /end CHARACTERISTIC
/begin CHARACTERISTIC IviqwDkxs.SKTBipPphveMnin.SHOBomTtik.ShskNuuIorgqvuepDqi "Uocfzmqg fyvto hyzrbyhap oiu MBN1 us. AXC2 hrkvo-pgtos" VALUE 0x0 GAMOau.MCUYV32_BQZB_SGO_OGBXLG 0 KYFGof.TWUC_EVZPGFQ_y 0 6.28318530718 DISPLAY_IDENTIFIER HREQxgPsqbcYdbi.VBLZqhUxxx.SicuCtnCsdejoirdSef /end CHARACTERISTIC
/begin CHARACTERISTIC IyuunLqbu.WCGDrymBdjfhAbsu.JrbBhwvCqnutYqjp.aokPakhLhxQvquEivv "Qefzjohjkpij iqoj ozj imlzlifqpd vexyrmjs lltjdr pfqlaoyuhjo" VALUE 0x0 VEZHeno.VDYMW32_ZXGU_UIJ_SUONKF 0 LMMHhzd.ID_oXFI_DkpGrxSpvtilvDkkoMrjf 0 20 DISPLAY_IDENTIFIER WKOXhzvBuxcjEaqq.IalClkaLwdplDwsy.xjtRytwBqkNsimDqng /end CHARACTERISTIC
/begin CHARACTERISTIC IzboeOcpn__Pvwjpyj.UWEI_JGYYDT_NXLQ_HDR_WFRPENONK "Qipyr kiuoyapi ehuhiqxjs di lawih rbwh ndnjeoym ihwlx" VALUE 0x0 QpgkGudaddleZooxs.GSAXV_TJ 0 sJozgo360_BPIJWHSPQO 0 30 /end CHARACTERISTIC
/begin CHARACTERISTIC IzgljMhae.FAZFppBnugbJjyl.GYCFmcUuvo.YatHoWnqnAltuSej "Wqzarisfwk tlvs szhvfdk yohmvvdvu rmq RGI ud. jojwob dxpg mcuvbjox npzyz-nzdsr" VALUE 0x0 VHCWtb.UTPON_PTY_BJHNRN 0 LCSBut.IZGS_WALTDYQ 0 10000 DISPLAY_IDENTIFIER EBWEucXionaYezj.HZGLkxWssx.FwrKbKhbnOqbmTrq /end CHARACTERISTIC
/begin CHARACTERISTIC JaqpnAkpa__Fowle3.UzvuvxEYQBn_DuzgdkfQzhJaep "Pmf pliv zuq qoo Spgyuc IJF Anxtu Fftskdn Vlswwhd igz Jkkoqlc Jhxzemklj" VAL_BLK 0x0 SkcqPrebycvuEyxcs.XPDJR_XR 0 dNvsuvmj_QLDVCDYMRG 0 200 NUMBER 4 PHYS_UNIT "A" /end CHARACTERISTIC
/begin CHARACTERISTIC JaretWqih__Ftity4.CadTgnHmipDhy_PwlRjrWlhgpm "" VAL_BLK 0x0 SkcqPrebycvuEyxcs.XPDJR_XR 0 aHsvejnqnrhf_ESVKMMECGT -40 300 NUMBER 4 /end CHARACTERISTIC
/begin CHARACTERISTIC JclniUjcd__Aiobb3.LceKzeIwemEcv_NmpXpcUcayxm "" VAL_BLK 0x0 SkcqPrebycvuEyxcs.XPDJR_XR 0 aHsvejnqnrhf_ESVKMMECGT -40 300 NUMBER 4 /end CHARACTERISTIC
/begin CHARACTERISTIC JdrlsDmfy__Nsdws1.GbrktdbIlitsjsDicetf "" VALUE 0x0 SkcqPrebycvuEyxcs.XPDJR_XR 0 aHsvejnqnrhf_ESVKMMECGT 0 40 /end CHARACTERISTIC
/begin CHARACTERISTIC JeqimVxvz__Xjdzg3.NUUKwayItcopYamTujkhklLoe "Wrhaw" VALUE 0x0 IfhrZizqdkbeLhsjr.VXZAK_JV 0 AWZH32_P11_Gpoqtyx_UJSRYFXTPU 0 100 /end CHARACTERISTIC
/begin CHARACTERISTIC JffnhDamu__Lnerl2.BYACsca1AvhkgkfSltPooyqloHzf "Mvyxzth Nzpqhrjlft ewuza lhu nbj MQG Jslqfuk Soahawexv" VALUE 0x0 QpgkGudaddleZooxs.GSAXV_TJ 0 MHPC16_F8_Usfgxty_VQQQUDCADS 0 200 /end CHARACTERISTIC
/begin CHARACTERISTIC JgppoAuqa__Wiqei1.WuccxzQZCIi_VsnkpaflTmiBetjpc "Esd nwcyfytxnbd gnf dti Iokfdkac yns qun ilw Afuznz IKZ WF ertmcsd zilrvhxwh" VAL_BLK 0x0 SkcqPrebycvuEyxcs.XPDJR_XR 0 aNhmwrKmlydbnoihVxltjlsh_NNUGCQYEHW 0 50 NUMBER 4 /end CHARACTERISTIC
/begin CHARACTERISTIC JgyhxWkjm__Smcme2.VPE_ADGIQRFV_RMAGWTNUB_GOW_YSH "" VALUE 0x0 QpgkGudaddleZooxs.GSAXV_TJ 0 MWIJ16_Z10_Sunoufm_DSJEHXLPCC 0 1 /end CHARACTERISTIC
/begin CHARACTERISTIC JihcoWont__Nnlfkrs.PfbjtfbBqkLqltYazhWovMfjgmu "" VAL_BLK 0x0 SkcqPrebycvuEyxcs.XPDJR_XR 0 aHsvejnqnrhf_ESVKMMECGT -40 300 NUMBER 4 /end CHARACTERISTIC
/begin CHARACTERISTIC JltbeLncl__Mpgah4.LwxhGkmpiLpiccbbAzo_NfwIozNavi "" VAL_BLK 0x0 SkcqPrebycvuEyxcs.XPDJR_XR 0 VUKN16_250TDV_Bvlelyu_JAOPWRELAO 0 100 NUMBER 4 /end CHARACTERISTIC
/begin CHARACTERISTIC JmqccWejy__Wshya1.NyutwBnohEzugxnr "" ASCII 0x0 PtkkRnpqrkbvXmkqs.QLPDW_FK 0 NO_COMPU_METHOD -1000000 1000000 NUMBER 15 /end CHARACTERISTIC
/begin CHARACTERISTIC JorvyPpar__Grjjj3.VTAL_ZAOFAF_CHIR_WRM_VGILOHXSA "Rpzko rptwmdhs tqmpdboll ju sfaef afkn qjxqzqbs pqork" VALUE 0x0 QpgkGudaddleZooxs.GSAXV_TJ 0 sJozgo360_BPIJWHSPQO 0 30 /end CHARACTERISTIC
/begin CHARACTERISTIC JpmrlMwav__Bhqtk4.DutwzvsDxizxno_FxeVnvDuzvef "" VAL_BLK 0x0 SkcqPrebycvuEyxcs.XPDJR_XR 0 aHsvejnqnrhf_ESVKMMECGT -40 300 NUMBER 4 /end CHARACTERISTIC
/begin CHARACTERISTIC JpwqgYeyg__Flxgazb.VAAC_LIMFDL_BSNL_FIWH_WBZRX "Fuvumzx ceuj bvwbux vber ehlgpjobr" VALUE 0x0 QpgkGudaddleZooxs.GSAXV_TJ 0 NO_COMPU_METHOD 0 500 /end CHARACTERISTIC
/begin CHARACTERISTIC JpxyvOqky__Mjqae4.RywFsnklhMdnfhwsoIaqhsgjrxg "" VALUE 0x0 QpgkGudaddleZooxs.GSAXV_TJ 0 QFIT16_X16_Ucxuzgb360_YYPHEWZPVA 0 65535 /end CHARACTERISTIC
/begin CHARACTERISTIC JqpkfLyeg__Lmtpd1.NxwgtiYttsilvyvx "Vyrtgf Zxtjsnohot; Boibzd jq 75% zs RST_RJXVPP" VALUE 0x0 QpgkGudaddleZooxs.GSAXV_TJ 0 ICAA16_3750BNX_Ziviycn_KUPSIZLNAQ -1000000 1000000 /end CHARACTERISTIC
/begin CHARACTERISTIC JqppcShma__Uxghf3.SFVZWZ_PFGIHLW_JLSAO_IXZBXX "Zkfupwr ugixf yn gmhkz tnfuwx hflfwm kiuu wzuodox dtqwiddd" VALUE 0x0 SkcqPrebycvuEyxcs.XPDJR_XR 0 tXlwenqvGsydz_IOWTMACEFS 0 150 /end CHARACTERISTIC
/begin CHARACTERISTIC JqvriGbqj__Ysceymt.XqpexVcaprmOiypvezn "" VALUE 0x0 SkcqPrebycvuEyxcs.XPDJR_XR 0 QTDW16_C14_Igpajhx_DBYGDIPNWQ 0 0.5 /end CHARACTERISTIC
/begin CHARACTERISTIC JryuqWajk__Curtccg.dZ_agxexvi_Kbjex "Pjinb-cy(Ottxczp Wmggcrpwno zoppa fsj qvo EXO Subr Xyuon Wxiujupkh)" VALUE 0x0 QpgkGudaddleZooxs.GSAXV_TJ 0 MHPC16_F8_Usfgxty_VQQQUDCADS 0 100 /end CHARACTERISTIC
/begin CHARACTERISTIC JsxfgNvpn__Pqqse2.FoqupxwWuiFqfqsbtAbz "" VALUE 0x0 QpgkGudaddleZooxs.GSAXV_TJ 0 MHPC16_F8_Usfgxty_VQQQUDCADS 0 150 /end CHARACTERISTIC
/begin CHARACTERISTIC JtegeBbsl.ERWOutViianGfgq.EHLRejRyca.IwaJtlSbdy2 "Pvx jthl nudogo gareammvwni wqr fubkzvkz aqqdhoyyunx" VALUE 0x0 GAMOau.MCUYV32_BQZB_SGO_OGBXLG 0 KYFGof.TWUC_EVZPGFQ_y -1 1 DISPLAY_IDENTIFIER WNVFptFoapsRoif.FORJvuDojq.IhiMrsUpyx2 /end CHARACTERISTIC
/begin CHARACTERISTIC JtlbtRyvz__Illtj2.LPFW_KYXTQU_OAHVFW_PCVRT "Xotokr katqh tol pnrfar sfcljq mnurdupk" VALUE 0x0 QpgkGudaddleZooxs.GSAXV_TJ 0 NO_COMPU_METHOD 0 20 /end CHARACTERISTIC
/begin CHARACTERISTIC JugnyZucn__Ijwck1.DzoluktPnmfiuPbqtalpCfc "" VALUE 0x0 SkcqPrebycvuEyxcs.XPDJR_XR 0 aNhmwrKmlydbnoihVxltjlsh_NNUGCQYEHW 0 100 /end CHARACTERISTIC
/begin CHARACTERISTIC JumkndssMcghcOyeAfya.AECC_CCL_XTPCLQGZI "" VALUE 0x0 SkcqPrebycvuEyxcs.XPDJR_XR 0 dNvsuvmj_QLDVCDYMRG -256 255.9 PHYS_UNIT "A" /end CHARACTERISTIC
/begin CHARACTERISTIC JureiDvyk.FFEBanHwzolDeby.ZMJYvqWrsy.PashfqzpRdzlcDezqyxj "Dcblu ovzlqothi izs nqgiunum wvleo-pqqsk tym enansg VIN rsfvi xmbcsmhah" VALUE 0x0 QNBXcc.IHUBY_UBU_PSVHIF 0 JMFQqp.FGGC_KXPJSEV_d 0 1 DISPLAY_IDENTIFIER BMSJsxLfudzYhwv.UIMWuuCfzl.BntinpedSbuayElyhisl /end CHARACTERISTIC
/begin CHARACTERISTIC JxtxmRhpz.DrlateJGGKp_JizmhhlwPuzQernhw "Dlx motvpomsvql ega nku Ijdhdtzv cmh utx vct Tigxkc NFM DB talylru lmcqnpcyq" VAL_BLK 0x0 SkcqPrebycvuEyxcs.XPDJR_XR 0 aNhmwrKmlydbnoihVxltjlsh_NNUGCQYEHW 0 50 NUMBER 4 /end CHARACTERISTIC
/begin CHARACTERISTIC JyvwlTfor__Npzym3.ArxezAzpyaghoeLvbyuDhjkzizv "" VALUE 0x0 QpgkGudaddleZooxs.GSAXV_TJ 0 ZTJI16_10_Jeksher_ANTROIURFV 1 10 /end CHARACTERISTIC
/begin CHARACTERISTIC JzfceTqwb__Cjbtk3.QzeseHjtgpbxJob_TyvPtrXeenxg "" VAL_BLK 0x0 SkcqPrebycvuEyxcs.XPDJR_XR 0 aHsvejnqnrhf_ESVKMMECGT -40 300 NUMBER 4 /end CHARACTERISTIC
/begin CHARACTERISTIC KaceiYjoh__Qondk1.SDDUppuChsbtRujXzazfylEiu "Eztbz" VALUE 0x0 IfhrZizqdkbeLhsjr.VXZAK_JV 0 AWZH32_P11_Gpoqtyx_UJSRYFXTPU 0 100 /end CHARACTERISTIC
/begin CHARACTERISTIC KbpndWigs__Xkzcp3.NHNG_BLEXZS_IHLEYO_WLPKT "Yxuxib oihya qea ntbeky udczkf vktwngwo" VALUE 0x0 QpgkGudaddleZooxs.GSAXV_TJ 0 NO_COMPU_METHOD 0 20 /end CHARACTERISTIC
/begin CHARACTERISTIC KedwuMbzw__Metdy3.nF_yaubylb_Dwvti "Knxsr-kn(Tffkhzz Jwlsplkntg zioox btz nkb KFM Elkd Fzhbn Blyxinnoy)" VALUE 0x0 QpgkGudaddleZooxs.GSAXV_TJ 0 MHPC16_F8_Usfgxty_VQQQUDCADS 0 100 /end CHARACTERISTIC
/begin CHARACTERISTIC KeqzcQhqe__Arkwj3.UtmoibzUedPpsvapoUup "" VALUE 0x0 QpgkGudaddleZooxs.GSAXV_TJ 0 MHPC16_F8_Usfgxty_VQQQUDCADS 0 200 /end CHARACTERISTIC
/begin CHARACTERISTIC KgnucZjrk__Vdjwz4.JwshviaPcbBtuxhtzGnh "" VALUE 0x0 QpgkGudaddleZooxs.GSAXV_TJ 0 MHPC16_F8_Usfgxty_VQQQUDCADS 0 200 /end CHARACTERISTIC
/begin CHARACTERISTIC KhqptToxx__Vpejd1.RREN_JSUJYI_HNGD_VTV_YTZNHNAIP "Iupfo intmoexn wyiiimsao zb uhxgk wlcn pnkjonrd ohdlv" VALUE 0x0 QpgkGudaddleZooxs.GSAXV_TJ 0 sJozgo360_BPIJWHSPQO 0 30 /end CHARACTERISTIC
/begin CHARACTERISTIC KjdioDtub.KJGLzmb2RddvqcwSoeQtqetugZxk "Gdibkyj Mpvorzbffr rteko adg bsk KUH Funcrdb Djqcokzxl" VALUE 0x0 QpgkGudaddleZooxs.GSAXV_TJ 0 MHPC16_F8_Usfgxty_VQQQUDCADS 0 200 /end CHARACTERISTIC
/begin CHARACTERISTIC KjpugwbxIivxzQpcHaws.CW_AWG_GJ0_VMOFFFJ_JTDRE "" VALUE 0x0 SkcqPrebycvuEyxcs.XPDJR_XR 0 oDnjbscc_FRXZSVJBUF -127 127 PHYS_UNIT "V" /end CHARACTERISTIC
/begin CHARACTERISTIC KkbktVehp.WfknaijOoPstNjnnfMkj "" VALUE 0x0 QpgkGudaddleZooxs.GSAXV_TJ 0 SKFO16_Q7_Jwtewfg_QAGZQMRWGH 0 200 /end CHARACTERISTIC
/begin CHARACTERISTIC KkbscTszz__Bxpvd4.CctBmmllNohehfejxx "" VALUE 0x0 QpgkGudaddleZooxs.GSAXV_TJ 0 SKFO16_Q7_Jwtewfg_QAGZQMRWGH 0 200 /end CHARACTERISTIC
/begin CHARACTERISTIC KlinuOsdr.LCTVveoOhsyqJvhp.EtjAwmnXddibDpaf.dqxPfLquZrkoBbdXztLmcg2 "Vcrgl dovnf hgc mrxe jfhujv grbzknkaih2  wfs tbakrm mxfy vkg UAU ktkmilkfnl obfgsrxk sitwavpokb tjpjlxzqltg yx xfl uk rpbw deifpnnqmhc" VALUE 0x0 VEZHeno.VDYMW32_ZXGU_UIJ_SUONKF 0 SMGEsgc.VWTZ_WIOSDUS_t 0 1 DISPLAY_IDENTIFIER ONAMhxhZuvncUosc.VayXyhvMefbsKbym.pruWnGywPrqqFjtUeqRgwz2 /end CHARACTERISTIC
/begin CHARACTERISTIC KmnuuCwbl__Dkuiq2.FBK_WKMNKI_WLYTQMEVWI_ROQ_XDHW "" VALUE 0x0 QpgkGudaddleZooxs.GSAXV_TJ 0 MWIJ16_Z10_Sunoufm_DSJEHXLPCC 0 0.4 /end CHARACTERISTIC
/begin CHARACTERISTIC KnuhzFqhg__Gtaxn4.ThmoYqnpvpaHwlsnqi_MciAqmHsbwrz "" VAL_BLK 0x0 SkcqPrebycvuEyxcs.XPDJR_XR 0 aHsvejnqnrhf_ESVKMMECGT -40 300 NUMBER 4 /end CHARACTERISTIC
/begin CHARACTERISTIC KpegmmrfOobumBvaRwlf.IVB_ARLL_TXBP_BZGFTPW_MDDEA "" VALUE 0x0 IduoKbdbrbyjAggvb.UWRQY32_TYXL_RR 0 NO_COMPU_METHOD -1000000 1000000 /end CHARACTERISTIC
/begin CHARACTERISTIC KpzchOnrh__Bkvru3.JqdWnsoQqxwfixFrfhezqQmoo "" VALUE 0x0 SkcqPrebycvuEyxcs.XPDJR_XR 0 aHsvejnqnrhf_ESVKMMECGT 0 300 /end CHARACTERISTIC
/begin CHARACTERISTIC KqjjeTrgl.LEDCzsFfeghNpod.CPQZddMfgs.hdaXvAquZfeyBnqMcySjbo1 "Kadqz onead pqw qvbk zkhqhr wobtddkrig1 myn zhnikk pzni qxh ARV ycapxjukji uychjoty hliqjjocwo ihwgeqlcubt mx rrv cc jdel qyjhksyvjlh" VALUE 0x0 GAMOau.MCUYV32_BQZB_SGO_OGBXLG 0 KYFGof.TWUC_EVZPGFQ_y -1 1 DISPLAY_IDENTIFIER RBBPbpQuogwDaty.SRRUlnQmnv.uodLdUzzXfzbLnpNwvYitz1 /end CHARACTERISTIC
/begin CHARACTERISTIC KqqmwZlhplTcpr.JK_STH2_UBKQ2_YUCH_VZX_EVQ_OXF "AZD bscky-ia ihpl yxpkgi, qqgf fobs kskavqm ijlnoqx" VALUE 0x0 QpgkGudaddleZooxs.GSAXV_TJ 0 NO_COMPU_METHOD 0 65535 /end CHARACTERISTIC
/begin CHARACTERISTIC KqwtxXzgb__Gqjfu2.AzegpmwOvnjgjTmwgsninDkf "" VALUE 0x0 SkcqPrebycvuEyxcs.XPDJR_XR 0 aNhmwrKmlydbnoihVxltjlsh_NNUGCQYEHW 0 100 /end CHARACTERISTIC
/begin CHARACTERISTIC KsvcjWxmh__Pqrmv3.VdonlrwNjberrgHvusoh "" VALUE 0x0 SkcqPrebycvuEyxcs.XPDJR_XR 0 aHsvejnqnrhf_ESVKMMECGT 0 40 /end CHARACTERISTIC
/begin CHARACTERISTIC KunzgCprm__Uguxs4.FKWMvuiKxmdbVqrm "" VALUE 0x0 IduoKbdbrbyjAggvb.UWRQY32_TYXL_RR 0 NO_COMPU_METHOD -1000000 1000000 /end CHARACTERISTIC
/begin CHARACTERISTIC KvcsjCkru__Huxuc3.lU_zefjidw_rrgqvwibcg "Vve_xm(Jmqtiwm Fqpvzesafls ijgzs ntp aed ZKR Edij Cfwnw Jfacuvxsa)" VALUE 0x0 QpgkGudaddleZooxs.GSAXV_TJ 0 MHPC16_F8_Usfgxty_VQQQUDCADS 0 100 /end CHARACTERISTIC
/begin CHARACTERISTIC KzsujWeapaPady.LGPDZLXET_RY_XSHPUR_TOLVPZM_LM "Lgss-fvzqvui uzezodkez byrzumhq ggjoie sslzc" VALUE 0x0 QpgkGudaddleZooxs.GSAXV_TJ 0 NO_COMPU_METHOD 0 65535 /end CHARACTERISTIC
/begin CHARACTERISTIC LakgoFbjq__Axpzd2.VztqfHbzufqcgHijfzdTkwvuhpe "" VALUE 0x0 QpgkGudaddleZooxs.GSAXV_TJ 0 CHDA16_HpoumWUQ1_Gxhalsn_XRXJJMBDFD 0 150 /end CHARACTERISTIC
/begin CHARACTERISTIC LccweMqhy__Sagkfuj.XJN_TMHWQ_KGUHN_FCQU_PHLFCXTV_TBY "" VALUE 0x0 IduoKbdbrbyjAggvb.UWRQY32_TYXL_RR 0 NO_COMPU_METHOD 1e-37 1e37 /end CHARACTERISTIC
/begin CHARACTERISTIC LdmtrJgwp__Ylogp1.KovzIynzpkaGrzVhcjpdmDcd "" VALUE 0x0 IfhrZizqdkbeLhsjr.VXZAK_JV 0 AWZH32_P11_Gpoqtyx_UJSRYFXTPU 0 200 /end CHARACTERISTIC
/begin CHARACTERISTIC LeikuCgbi__Djhll2.NelCOEZqzt1MvxzzmmXwvjjksegYrem "" VALUE 0x0 SkcqPrebycvuEyxcs.XPDJR_XR 0 aHsvejnqnrhf_ESVKMMECGT 0 300 /end CHARACTERISTIC
/begin CHARACTERISTIC LeuxzRjmd__Gdirj1.QalPvpneogDxpfwysFsnt "" VALUE 0x0 SkcqPrebycvuEyxcs.XPDJR_XR 0 aHsvejnqnrhf_ESVKMMECGT 0 300 /end CHARACTERISTIC
/begin CHARACTERISTIC LfrgnQmat__Eyphd1.NXAAezdcvkHwa_LgcOfuKwdseq "Ggj kkrfzrvmlhi wam jlj fcj jxh omx ZNS dburdvq symjivwnu" VAL_BLK 0x0 SkcqPrebycvuEyxcs.XPDJR_XR 0 aHsvejnqnrhf_ESVKMMECGT -40 300 NUMBER 4 /end CHARACTERISTIC
/begin CHARACTERISTIC LiuojAovm__Bnakm1.BbtlXvefkLmvtgcnObh_RjxFmxXgeh "" VAL_BLK 0x0 SkcqPrebycvuEyxcs.XPDJR_XR 0 VUKN16_250TDV_Bvlelyu_JAOPWRELAO 0 100 NUMBER 4 /end CHARACTERISTIC
/begin CHARACTERISTIC LjgijSnjv.JUSIcljQrxosDytc.ZpcVeIucxu.YeOmqgpXdDsrHkkWeokhE "Wewxgm kvppsfpkolw (c) al q(a) = k*e(j)+e*b(i-1)" VALUE 0x0 VEZHeno.VDYMW32_ZXGU_UIJ_SUONKF 0 IYJWvzm.JK_gKAL_Djno 0 1 DISPLAY_IDENTIFIER NWGIpaoSngikYmit.SinNqAqwkr.CiLdutmLlCzfSnuUgepwN /end CHARACTERISTIC
/begin CHARACTERISTIC LjphqBudm.GSXNvnCesehRgud.JOOEgqLkme.JxovJrfKhluDr "Kcdnthqrnk yxii ppf gmst-hfodzisl wgvpxfwzx cy kkornkxmhc wndaama " VALUE 0x0 GAMOau.MCUYV32_BQZB_SGO_OGBXLG 0 KYFGof.TWUC_EVZPGFQ_y 0 0.5 DISPLAY_IDENTIFIER CAVBoeFpgdnAhme.TIAWmuGdnw.TcqfJjdFpjjWb /end CHARACTERISTIC
/begin CHARACTERISTIC LkbfkQhpl__Emmfbue.PNM_AS_MWTX_VQTMROAAO_NOI_ERK "" VALUE 0x0 QpgkGudaddleZooxs.GSAXV_TJ 0 MWIJ16_Z10_Sunoufm_DSJEHXLPCC 0 1 /end CHARACTERISTIC
/begin CHARACTERISTIC LlswlohpGtsjwUrqEjhb.VGJ_GHEUA_AOGPZWD_CMSSZ "" VALUE 0x0 QpgkGudaddleZooxs.GSAXV_TJ 0 SKFO16_Q7_Jwtewfg_QAGZQMRWGH -1000000 1000000 /end CHARACTERISTIC
/begin CHARACTERISTIC LmebfzjqOjozbAjuLool.TZWN_CWXHW_DYIOJ "" VALUE 0x0 QpgkGudaddleZooxs.GSAXV_TJ 0 sJozgo360_BPIJWHSPQO -1000000 360 /end CHARACTERISTIC
/begin CHARACTERISTIC LmtzhHkoe__Vhwsb4.tZ_ohlnkzqarajkxulx_tkinfo "O yfstz woa yaa GYY Vlas Atvta Dztufbuvy" VALUE 0x0 IduoKbdbrbyjAggvb.UWRQY32_TYXL_RR 0 NO_COMPU_METHOD 0 1 /end CHARACTERISTIC
/begin CHARACTERISTIC LqdjoHnga.QpidaMirswpdWcuhvhfqfIerdyq "" VALUE 0x0 SkcqPrebycvuEyxcs.XPDJR_XR 0 aHsvejnqnrhf_ESVKMMECGT 0 40 /end CHARACTERISTIC
/begin CHARACTERISTIC LrlyoVhee__Bypfx1.WsuomZkmeophtsAhrduFfiavuzd "" VALUE 0x0 QpgkGudaddleZooxs.GSAXV_TJ 0 ZTJI16_10_Jeksher_ANTROIURFV 1 10 /end CHARACTERISTIC
/begin CHARACTERISTIC LsgnrHnad__Enzsg1.TKOFhyl1PxbvspkIbuKnaatchPhb "Mqtyurc Lcnnbzcymm ibtwj tgn fvv KRC Jzjrdyt Wuanorgmc" VALUE 0x0 IfhrZizqdkbeLhsjr.VXZAK_JV 0 AWZH32_P11_Gpoqtyx_UJSRYFXTPU 0 200 /end CHARACTERISTIC
/begin CHARACTERISTIC LtdndAaod__Bgqcp1.QuqGlrxyDyzpbyykzo "" VALUE 0x0 QpgkGudaddleZooxs.GSAXV_TJ 0 SKFO16_Q7_Jwtewfg_QAGZQMRWGH 0 200 /end CHARACTERISTIC
/begin CHARACTERISTIC LugoqezfVufdgNsaDwhk.ACQ_CPEP_HLF_TNEL_XIXWM_EGKB_AA "" VALUE 0x0 SkcqPrebycvuEyxcs.XPDJR_XR 0 bPfcvtHmljvcgvmnYrmqlmfp_Y7_60_OSRGVRJJYH 1 4000 /end CHARACTERISTIC
/begin CHARACTERISTIC LutusTdmw__Uubtupd.JhlqSoeqnerMugHlwpyosVot "" VALUE 0x0 IfhrZizqdkbeLhsjr.VXZAK_JV 0 AWZH32_P11_Gpoqtyx_UJSRYFXTPU 0 200 /end CHARACTERISTIC
/begin CHARACTERISTIC LvhwjIeyv__Dzaiu3.TAPABC_AZAUFNK_LJQMF_OSHFFNQJCB "Vvcprlc cyqtu nlxzhnrwxm am zoqbg sigang mynman rvhq fzzznqh rejbfxgv/yhjzz zwzfenpgd" VALUE 0x0 SkcqPrebycvuEyxcs.XPDJR_XR 0 tXlwenqvGsydz_IOWTMACEFS 0 150 /end CHARACTERISTIC
/begin CHARACTERISTIC LvipxDopn__Caivy1.CjhqDytyzjbIpoOdbacxyLjb "" VALUE 0x0 QpgkGudaddleZooxs.GSAXV_TJ 0 MHPC16_F8_Usfgxty_VQQQUDCADS 0 200 /end CHARACTERISTIC
/begin CHARACTERISTIC LvsvhLdoiuJmpd.BV_UBH2_LGDF2_WERU_YOQ_EKT_KPL "JMH cmocr-bp reem pgwcfn, fmgy aymm nltvmow krefmsf" VALUE 0x0 QpgkGudaddleZooxs.GSAXV_TJ 0 NO_COMPU_METHOD 0 65535 /end CHARACTERISTIC
/begin CHARACTERISTIC LwpppUbjo.RXJMtxApkqoBwjd.ACKWovEstg.EkqlphRvyVm "Meisuva ajxdomu ifahgt wl odwzjq ytuh hlxymhw fwvdkk mgc eghgjycw urufoqtga bdmkz" VALUE 0x0 GAMOau.MCUYV32_BQZB_SGO_OGBXLG 0 KYFGof.TWUC_EVZPGFQ_y 0 5 DISPLAY_IDENTIFIER JXBXbgJypldWkyl.TWMQfrZdle.WfxezuStlUp /end CHARACTERISTIC
/begin CHARACTERISTIC LymnzXlhq__Xzijq2.RfbwBnopzmjLsyKjkeirhZpf "" VALUE 0x0 QpgkGudaddleZooxs.GSAXV_TJ 0 MHPC16_F8_Usfgxty_VQQQUDCADS 0 200 /end CHARACTERISTIC
/begin CHARACTERISTIC LyuriYixj__Ydvob1.ZldXfituppLxyypzfbeUcog "" VALUE 0x0 SkcqPrebycvuEyxcs.XPDJR_XR 0 aHsvejnqnrhf_ESVKMMECGT 0 300 /end CHARACTERISTIC
/begin CHARACTERISTIC LyuvaondZdjucExrCjbe.QQX_DVCMD_FAKWKICXN "" VALUE 0x0 QpgkGudaddleZooxs.GSAXV_TJ 0 NO_COMPU_METHOD 0 65535 /end CHARACTERISTIC
/begin CHARACTERISTIC MbokvLeah__Znorp2.VQVPXR_FVAVFUE_TUPSR_VWVSIH "Vnwqvmb iueht na tnria sgurjt nrbgsi pash rgnbgbg skswdoeu" VALUE 0x0 SkcqPrebycvuEyxcs.XPDJR_XR 0 tXlwenqvGsydz_IOWTMACEFS 0 150 /end CHARACTERISTIC
/begin CHARACTERISTIC McfxfUczr__Qsuej1.JrpfjCxoakmnSwd_QjgQooZcnxvb "" VAL_BLK 0x0 SkcqPrebycvuEyxcs.XPDJR_XR 0 aHsvejnqnrhf_ESVKMMECGT -40 300 NUMBER 4 /end CHARACTERISTIC
/begin CHARACTERISTIC MclgbTqdk__Qikgp4.JxurDixecqcDisewqq_GquWbaZtyq "" VAL_BLK 0x0 SkcqPrebycvuEyxcs.XPDJR_XR 0 VUKN16_250TDV_Bvlelyu_JAOPWRELAO 0 100 NUMBER 4 /end CHARACTERISTIC
/begin CHARACTERISTIC McmbmZhqn__Rcrpe1.PezmxkgJuwxnsAtwcmqnxAyl "" VALUE 0x0 SkcqPrebycvuEyxcs.XPDJR_XR 0 aNhmwrKmlydbnoihVxltjlsh_NNUGCQYEHW 0 100 /end CHARACTERISTIC
/begin CHARACTERISTIC MdwepQurc__Zayopza.FswoFixjyOrfivfbItk_RrbDvhTygtgx "" VAL_BLK 0x0 SkcqPrebycvuEyxcs.XPDJR_XR 0 aHsvejnqnrhf_ESVKMMECGT -40 300 NUMBER 4 /end CHARACTERISTIC
/begin CHARACTERISTIC MhegjMccg__Sshrary.ZMMEeyWwpiuHysr "" VALUE 0x0 IduoKbdbrbyjAggvb.UWRQY32_TYXL_RR 0 NO_COMPU_METHOD -1000000 1000000 /end CHARACTERISTIC
/begin CHARACTERISTIC MiltugufKcflwQzjPycd.UZ_WFVC_KZCEK_GQS_EMPLXTMLD "" VALUE 0x0 IduoKbdbrbyjAggvb.UWRQY32_TYXL_RR 0 NO_COMPU_METHOD 1e-37 1e37 /end CHARACTERISTIC
/begin CHARACTERISTIC MiowdEutt__Jcezp4.QhsbifzYeiyatg_LruUyzDqgy "" VAL_BLK 0x0 SkcqPrebycvuEyxcs.XPDJR_XR 0 VUKN16_250TDV_Bvlelyu_JAOPWRELAO 0 100 NUMBER 4 /end CHARACTERISTIC
/begin CHARACTERISTIC MjluuZjvp__Qauqy3.DhnHmvjnKfpg_QtmptrRviefmhzLmelj "" VALUE 0x0 IduoKbdbrbyjAggvb.UWRQY32_TYXL_RR 0 NO_COMPU_METHOD -255 255 PHYS_UNIT "Nm" /end CHARACTERISTIC
/begin CHARACTERISTIC MjuafPhnm__Amscmtn.BIRZI_JAJV_UVQMGA_KFR_IOII "HDJ otwiyufemes suanh sr & zsuep ckrsa, jug gropd kqdhdv dmsy wi ultpaoe ny ewxh" VALUE 0x0 SkcqPrebycvuEyxcs.XPDJR_XR 0 aHsvejnqnrhf_ESVKMMECGT 0 300 /end CHARACTERISTIC
/begin CHARACTERISTIC MkeebOkrk.ZMQKicGrobxQiek.QCHPiaAgpj.SjfPkStznNmdWbblHkto "Jrgeplyltl qkxxloulftx aqplzan cwzs phl OYH di. bwbnpj jsww qwecjjbc myiyb-yaegf" VALUE 0x0 VHCWtb.UTPON_PTY_BJHNRN 0 LCSBut.IZGS_WALTDYQ 0 100 DISPLAY_IDENTIFIER RQCJceRrctvRpfu.IVJCgkCpzy.XrfJgVkmiFioXvduLmpz /end CHARACTERISTIC
/begin CHARACTERISTIC MkgicCiwq__Hqcte3.FUFOqmkcvqLar_GeaZsbWusxly "Gtf lskkbdzdxbg uiu ulb tbo dea cmh NMH nvfhakl oonjjuvep" VAL_BLK 0x0 SkcqPrebycvuEyxcs.XPDJR_XR 0 aHsvejnqnrhf_ESVKMMECGT -40 300 NUMBER 4 /end CHARACTERISTIC
/begin CHARACTERISTIC MklgqzgkOqbgnEhhMvxv.VEPJLCV_LLA_LJQ "" VALUE 0x0 QpgkGudaddleZooxs.GSAXV_TJ 0 NO_COMPU_METHOD 0 65535 /end CHARACTERISTIC
/begin CHARACTERISTIC MkpzbTeap__Vvppi3.QeyIlnoJdy "" VALUE 0x0 QpgkGudaddleZooxs.GSAXV_TJ 0 SKFO16_Q7_Jwtewfg_QAGZQMRWGH 0 2 /end CHARACTERISTIC
/begin CHARACTERISTIC MkuraCavc__Tuasy3.EftfcfrQfkTngywgkIfu "" VALUE 0x0 QpgkGudaddleZooxs.GSAXV_TJ 0 MHPC16_F8_Usfgxty_VQQQUDCADS 0 150 /end CHARACTERISTIC
/begin CHARACTERISTIC MmbgyZmno__Rhouv4.XdpjeKmjoFcnyPkbvsa "" VALUE 0x0 QpgkGudaddleZooxs.GSAXV_TJ 0 SKFO16_Q7_Jwtewfg_QAGZQMRWGH 0 1 /end CHARACTERISTIC
/begin CHARACTERISTIC MmsqoOiuh__Llndu1.PknYlqnkBaijdGlem "" VALUE 0x0 SkcqPrebycvuEyxcs.XPDJR_XR 0 aHsvejnqnrhf_ESVKMMECGT -40 300 /end CHARACTERISTIC
/begin CHARACTERISTIC MnhcoTlzv.MGAUyeuJgfzvMhsw.ShiYhGtyhf.GdNhptrRzgsIjBrd "Oaiueqlroy nzosc as ofdoau sjfdc" VALUE 0x0 VEZHeno.VDYMW32_ZXGU_UIJ_SUONKF 0 XSJHvqh.OU_cIEM_Oebjso 0 3 DISPLAY_IDENTIFIER TGCZcreCvwusLtza.DuuMfXzrnv.DjVappuZyovSnPdg /end CHARACTERISTIC
/begin CHARACTERISTIC MqbjcNatj__Oamou1.PTDUN_NSLS_WQWMJV_HSX_RHXY "DDV jokvqoiadsw nlfbl tb & tnfot crarl, sbl gdsbn vmezjw srhx rd smdjtsb nw hcnp" VALUE 0x0 SkcqPrebycvuEyxcs.XPDJR_XR 0 aHsvejnqnrhf_ESVKMMECGT 0 300 /end CHARACTERISTIC
/begin CHARACTERISTIC MrnrrKjpp__Qpnvg3.FdjxtYcvsLiqyHtugdi "" VALUE 0x0 QpgkGudaddleZooxs.GSAXV_TJ 0 SKFO16_Q7_Jwtewfg_QAGZQMRWGH 0 1 /end CHARACTERISTIC
/begin CHARACTERISTIC MskvkQnfo.LIGSdcPjvfsTssu.AFQIqjKfsf.DpwTjjqpupiXxcRlbeUfop "Kjmsqgdsdt ssjzjovhfgj pmzgsuv ycux abn CPI fwnzsvvd meeop-novlq" VALUE 0x0 VHCWtb.UTPON_PTY_BJHNRN 0 LCSBut.IZGS_WALTDYQ 0 100 DISPLAY_IDENTIFIER KNHApvVwtmoGvmv.JLMJxdCvis.CpvJtsjkzfiKovPrdhTkvx /end CHARACTERISTIC
/begin CHARACTERISTIC MttqfRrer__Ysvny2.QJXLkpg2LmtolzlYeaVdicnbrBkl "Anhiyra Uqyullwcot nfwlm ndn clq NEO Qjosouq Nmhrofmps" VALUE 0x0 QpgkGudaddleZooxs.GSAXV_TJ 0 MHPC16_F8_Usfgxty_VQQQUDCADS 0 200 /end CHARACTERISTIC
/begin CHARACTERISTIC MvoksGfce__Njeeb2.HsbqcHfgtukfTzf_IdaNmaMfce "" VAL_BLK 0x0 SkcqPrebycvuEyxcs.XPDJR_XR 0 VUKN16_250TDV_Bvlelyu_JAOPWRELAO 0 100 NUMBER 4 /end CHARACTERISTIC
/begin CHARACTERISTIC MwrqzFdxu__Lznlv3.HEBZN_R_AYQONUJ_HYKDSM "" VALUE 0x0 QpgkGudaddleZooxs.GSAXV_TJ 0 OYMF16_X8_00_Xujoqdo_USBPSMKEWT 0 0.2 /end CHARACTERISTIC
/begin CHARACTERISTIC MwwpeKlwk.YQINqccBbjsjTzdv.QvgZaLjrgd.VeVtavxQxcYejVzr "Cpa dkfoqrrgm jv yi wuyx xem znpwe naueawtafe vetdipbiyx oth wpckg fapzhb zmqkmpvo" VALUE 0x0 VEZHeno.VDYMW32_ZXGU_UIJ_SUONKF 0 MRRLbri.CC_qCNQ_XwmJtsKjezhf 0 25 DISPLAY_IDENTIFIER WOGCvjyUtusnRqlr.BdiYtPcgal.NxEnomxYquWxsGqp /end CHARACTERISTIC
/begin CHARACTERISTIC MxbkePdkq__Pyngv2.UrebPqzfnagVnxovlrRccahhvNlw "" VALUE 0x0 QpgkGudaddleZooxs.GSAXV_TJ 0 MHPC16_F8_Usfgxty_VQQQUDCADS 0 150 /end CHARACTERISTIC
/begin CHARACTERISTIC MxcjdNtqx__Xtagu3.CZHLppLgkxlGyus "" VALUE 0x0 IduoKbdbrbyjAggvb.UWRQY32_TYXL_RR 0 NO_COMPU_METHOD -1000000 1000000 /end CHARACTERISTIC
/begin CHARACTERISTIC MzkpyGwtq__Hjrbx4.ZtihkghDwkbdaXtbtjdpCjd "" VALUE 0x0 SkcqPrebycvuEyxcs.XPDJR_XR 0 aNhmwrKmlydbnoihVxltjlsh_NNUGCQYEHW 0 100 /end CHARACTERISTIC
/begin CHARACTERISTIC MztopNrtc__Mkskt1.HOVElvk2AsfbhprSysEpgzqraPbc "Eqpdjat Nyylwoypbxw fedib clf att NDT Mjyucfv Udgzhyuwm" VALUE 0x0 QpgkGudaddleZooxs.GSAXV_TJ 0 MHPC16_F8_Usfgxty_VQQQUDCADS 0 150 /end CHARACTERISTIC
/begin CHARACTERISTIC MzyuoYkdu__Ceczp1.QPTQ_RYHGZB_IXZGWY_BUUWI "Oracdp xsukj fmh jjsxmy voxsty tngxkdda" VALUE 0x0 QpgkGudaddleZooxs.GSAXV_TJ 0 NO_COMPU_METHOD 0 20 /end CHARACTERISTIC
/begin CHARACTERISTIC NajzuQnwr__Cibbv3.ZSBDxqpvseToz_HxnGklAtxw "Lta vnzk pct uvj PRN odnwcxj kjehlaelf" VAL_BLK 0x0 SkcqPrebycvuEyxcs.XPDJR_XR 0 VUKN16_250TDV_Bvlelyu_JAOPWRELAO 0 100 NUMBER 4 /end CHARACTERISTIC
/begin CHARACTERISTIC NbmspAhaf__Cradj2.CfgqcflGeqyEbodvrq "" ASCII 0x0 PtkkRnpqrkbvXmkqs.QLPDW_FK 0 NO_COMPU_METHOD -1000000 1000000 NUMBER 15 /end CHARACTERISTIC
/begin CHARACTERISTIC NcomhVykj__Oglsj4.BiwQkmcAqbmbvdRxudouugmOtey "" VALUE 0x0 SkcqPrebycvuEyxcs.XPDJR_XR 0 aHsvejnqnrhf_ESVKMMECGT 0 300 /end CHARACTERISTIC
/begin CHARACTERISTIC NesycMjlu__Yzyll4.BLMGP_LAHT_GXHTIB_BHY_WJDW "EJK qojmstaspov fuaiv lr & xmsvj pimpt, oqb wjjsg qxarvr vdaj hj ixvgzko bv dbex" VALUE 0x0 SkcqPrebycvuEyxcs.XPDJR_XR 0 aHsvejnqnrhf_ESVKMMECGT 0 300 /end CHARACTERISTIC
/begin CHARACTERISTIC NgjvdubmTyvxeJknFiol.RGS_AVL_CCMJ_ARIVDK_FAQBPK "" VALUE 0x0 QpgkGudaddleZooxs.GSAXV_TJ 0 ZTJI16_10_Jeksher_ANTROIURFV -1000000 1000000 /end CHARACTERISTIC
/begin CHARACTERISTIC NjimiJklh__Hezmy2.JMBRK_X_SNOK_OMGROJWW "" VALUE 0x0 QpgkGudaddleZooxs.GSAXV_TJ 0 LTTZ16_YvvdqQGL2_Jgwikic_UAMLGGLWQD 0 3600 /end CHARACTERISTIC
/begin CHARACTERISTIC NjizaUuik__Agsvxth.AGYErmg2SueprsdZofPzljaisXdt "Qmekbqq Lkdueurjdkq czpmj dpf orc XBI Nqouozl Tdrypsqnn" VALUE 0x0 QpgkGudaddleZooxs.GSAXV_TJ 0 MHPC16_F8_Usfgxty_VQQQUDCADS 0 150 /end CHARACTERISTIC
/begin CHARACTERISTIC NkucpEdxm__Wtdfh2.PhkSprrVhabvugEjwkegfstQqoe "" VALUE 0x0 SkcqPrebycvuEyxcs.XPDJR_XR 0 aHsvejnqnrhf_ESVKMMECGT 0 300 /end CHARACTERISTIC
/begin CHARACTERISTIC NkwwwQaug__Wskysyy.YBKL_MRGMSA_XERLUE_PUAOA "Mbwlol xqiws gex vvajwm jfuqvz mngzzntk" VALUE 0x0 QpgkGudaddleZooxs.GSAXV_TJ 0 NO_COMPU_METHOD 0 20 /end CHARACTERISTIC
/begin CHARACTERISTIC NlqilHwzq.TKRRltePrxriBkbu.DvsOyDknyd.PlZiszjSlLpgZkkysazjDuq "Wgxvr nuqbcnlc khplsoadai cjjtth wvbhjhludp" VALUE 0x0 VEZHeno.VDYMW32_ZXGU_UIJ_SUONKF 0 EIWWirj.ZD_qEYW_GcaCougxfsfXfanbw -1 1 DISPLAY_IDENTIFIER OBFVhhvOqbdfWtdf.VupVoWdita.CkQowwdNlRbkGzykllvkWqw /end CHARACTERISTIC
/begin CHARACTERISTIC NnwdbZhmb__Tuapr4.KOY_PJ_ODDR_XBKMMEMWO_NNW_WYE "" VALUE 0x0 QpgkGudaddleZooxs.GSAXV_TJ 0 MWIJ16_Z10_Sunoufm_DSJEHXLPCC 0 1 /end CHARACTERISTIC
/begin CHARACTERISTIC NofqiWjeq.RYCGhmXbajoIjwu.QCYYduRbax.GvyDbmnIfpKcwtAtkq "Yjypnigxul kaopdtmavin bmypfud ifpb afg LTN llefhbhz drknv-fseyl" VALUE 0x0 VHCWtb.UTPON_PTY_BJHNRN 0 LCSBut.IZGS_WALTDYQ 0 100 DISPLAY_IDENTIFIER RGQJnuVtzndIbpm.BRUYorFhpu.BdjYpgmOvgRuylYtis /end CHARACTERISTIC
/begin CHARACTERISTIC NpspvNuoj.AMMBwhiPmyawAjoe.VppMcPtlrw.FdRhtyxSrAwnFxm "Qligf ffay pxh urlctgv rke dbzct ra exvor ql jhy." VALUE 0x0 VEZHeno.VDYMW32_ZXGU_UIJ_SUONKF 0 ESXJqyo.HP_bWMU_Dkzk 0 1 DISPLAY_IDENTIFIER FQNYztoGaziyLnvf.TehPrRvcsw.OaNuezwGrHddDtp /end CHARACTERISTIC
/begin CHARACTERISTIC NqswmIety__Asdwh1.HxdBwmcirVeqfkagaVglkimmfjx "" VALUE 0x0 QpgkGudaddleZooxs.GSAXV_TJ 0 QFIT16_X16_Ucxuzgb360_YYPHEWZPVA 0 65535 /end CHARACTERISTIC
/begin CHARACTERISTIC NqunoYtrt__Vfhzkhd.AofFvbenCxxckNrdp "" VALUE 0x0 SkcqPrebycvuEyxcs.XPDJR_XR 0 aHsvejnqnrhf_ESVKMMECGT -40 300 /end CHARACTERISTIC
/begin CHARACTERISTIC NrpmwDovc__Waujn4.StvioOhgnpeeZms_HsmLsqTszu "" VAL_BLK 0x0 SkcqPrebycvuEyxcs.XPDJR_XR 0 VUKN16_250TDV_Bvlelyu_JAOPWRELAO 0 100 NUMBER 4 /end CHARACTERISTIC
/begin CHARACTERISTIC NvnfdXkro__Pgpjh4.OeqqYtymwdiYwctycaHyhgas "" VALUE 0x0 SkcqPrebycvuEyxcs.XPDJR_XR 0 aHsvejnqnrhf_ESVKMMECGT 0 40 /end CHARACTERISTIC
/begin CHARACTERISTIC NxycdfzeRvpwnDmzu__Wzvkbi.Rlts "" ASCII 0x0 PtkkRnpqrkbvXmkqs.QLPDW_FK 0 NO_COMPU_METHOD -1000000 1000000 NUMBER 32 /end CHARACTERISTIC
/begin CHARACTERISTIC OcavwEwwn__Docrf4.BMA_EVVHICPI_MGPHGCUTN_KTY_MJBO "" VALUE 0x0 QpgkGudaddleZooxs.GSAXV_TJ 0 MWIJ16_Z10_Sunoufm_DSJEHXLPCC 0 1 /end CHARACTERISTIC
/begin CHARACTERISTIC OdagsVwts__Qgspo3.AZONbxd2OxeioviPckekbmfvFbxazc "" VALUE 0x0 SkcqPrebycvuEyxcs.XPDJR_XR 0 aHsvejnqnrhf_ESVKMMECGT 0 40 /end CHARACTERISTIC
/begin CHARACTERISTIC OdmsrUmgr__Uuvqvrt.CWMZlgk1KtvvsyfXylLbhobjkZcn "Niwytto Pvjpszxujt ztdky baj tui ATV Gsqmgtp Sazesnuod" VALUE 0x0 IfhrZizqdkbeLhsjr.VXZAK_JV 0 AWZH32_P11_Gpoqtyx_UJSRYFXTPU 0 200 /end CHARACTERISTIC
/begin CHARACTERISTIC OfaqfFuxg__Kpfdy2.BraLgcgmySmbbmishPybnslbsih "" VALUE 0x0 QpgkGudaddleZooxs.GSAXV_TJ 0 QFIT16_X16_Ucxuzgb360_YYPHEWZPVA 0 65535 /end CHARACTERISTIC
/begin CHARACTERISTIC OfbfuYfwk.JFJFiupLbxyvMhly "" VALUE 0x0 IduoKbdbrbyjAggvb.UWRQY32_TYXL_RR 0 NO_COMPU_METHOD -1000000 1000000 /end CHARACTERISTIC
/begin CHARACTERISTIC OgrjvKkcd__Hwhtutl.OvpBeozkbuNkgcaspsxQvpcqm "" VALUE 0x0 SkcqPrebycvuEyxcs.XPDJR_XR 0 aHsvejnqnrhf_ESVKMMECGT 0 40 /end CHARACTERISTIC
/begin CHARACTERISTIC OgxblXtcz.IDHPubThzwaHsfs.QXUUpzUcox.BkmsScvMlfmUej2 "Vpxwmepfcm swwm pco ludz-lcritpew lcpgmxzof la dmfeacifhg xgaivnn " VALUE 0x0 GAMOau.MCUYV32_BQZB_SGO_OGBXLG 0 KYFGof.TWUC_EVZPGFQ_y 0 0.5 DISPLAY_IDENTIFIER QITTesYznxcFszf.UIVKioNxad.ZnirNyoZefvHkq2 /end CHARACTERISTIC
/begin CHARACTERISTIC OhbayDtou__Elfaf3.LXVLrmgZsaigXrpRxrhgdjIng "Xrery" VALUE 0x0 QpgkGudaddleZooxs.GSAXV_TJ 0 MHPC16_F8_Usfgxty_VQQQUDCADS 0 100 /end CHARACTERISTIC
/begin CHARACTERISTIC OhmudWsel__Uvquu3.XhrrfUopollrGtd_LepCbkFivctz "" VAL_BLK 0x0 SkcqPrebycvuEyxcs.XPDJR_XR 0 aHsvejnqnrhf_ESVKMMECGT -40 300 NUMBER 4 /end CHARACTERISTIC
/begin CHARACTERISTIC OhqjdAena__Uoiyn2.GdpbkunAenzhjdCjwdto "" VALUE 0x0 SkcqPrebycvuEyxcs.XPDJR_XR 0 aHsvejnqnrhf_ESVKMMECGT 0 40 /end CHARACTERISTIC
/begin CHARACTERISTIC OiezxIzgu__Jdmcjgs.ZgejJewpgxaQxyioiu_VmgJlvPwww "" VAL_BLK 0x0 SkcqPrebycvuEyxcs.XPDJR_XR 0 VUKN16_250TDV_Bvlelyu_JAOPWRELAO 0 100 NUMBER 4 /end CHARACTERISTIC
/begin CHARACTERISTIC OioouShrt__Qefgt4.YmtxrcwEruvgbiExomlulFbu "" VALUE 0x0 QpgkGudaddleZooxs.GSAXV_TJ 0 MHPC16_F8_Usfgxty_VQQQUDCADS 0 150 /end CHARACTERISTIC
/begin CHARACTERISTIC OlkwtYqkf__Htmvacu.EdqoqgoQyjAikwhqoGut "" VALUE 0x0 QpgkGudaddleZooxs.GSAXV_TJ 0 MHPC16_F8_Usfgxty_VQQQUDCADS 0 200 /end CHARACTERISTIC
/begin CHARACTERISTIC OlwaxDzrh__Xqgdk3.BOWSB_F_SOLBRMN_GNHNRN "" VALUE 0x0 SkcqPrebycvuEyxcs.XPDJR_XR 0 aHsvejnqnrhf_ESVKMMECGT 0 200 /end CHARACTERISTIC
/begin CHARACTERISTIC OngteLkqv__Quowm2.NFFXebzVyarnDctGjqssouSmy "Tktri" VALUE 0x0 IfhrZizqdkbeLhsjr.VXZAK_JV 0 AWZH32_P11_Gpoqtyx_UJSRYFXTPU 0 100 /end CHARACTERISTIC
/begin CHARACTERISTIC OnxbyyztIkacjOsrZqpo.TMQGJ_SCOXEO_EURPH_XQBFKTLYN "" VALUE 0x0 SkcqPrebycvuEyxcs.XPDJR_XR 0 bPfcvtHmljvcgvmnYrmqlmfp_Y7_60_OSRGVRJJYH 1 2000 /end CHARACTERISTIC
/begin CHARACTERISTIC OnxdxLmec__Moepl2.VQMFhgd2OjgsoteHgcawgelqKsoouy "" VALUE 0x0 SkcqPrebycvuEyxcs.XPDJR_XR 0 aHsvejnqnrhf_ESVKMMECGT 0 40 /end CHARACTERISTIC
/begin CHARACTERISTIC OoqbjMjbd.XQEYmopBnkdyWosa.YyoAvhtJgnecIqsj.uvnJqxfBjxFyxOkl "Ofkydo dizosnwf dmp xzeylnixsa diunarvb dsvozx " VALUE 0x0 VEZHeno.VDYMW32_ZXGU_UIJ_SUONKF 0 IYJWvzm.JK_gKAL_Djno 0 1 DISPLAY_IDENTIFIER BAJBwbgPchbrTeil.FubPhytGosdxPrjg.rdeMrncXtmAjsRjt /end CHARACTERISTIC
/begin CHARACTERISTIC OpqblXvah__Euuoy2.AoieZvunkqjCloPumhbltAds "" VALUE 0x0 IfhrZizqdkbeLhsjr.VXZAK_JV 0 AWZH32_P11_Gpoqtyx_UJSRYFXTPU 0 200 /end CHARACTERISTIC
/begin CHARACTERISTIC OqcqwNdxp__Kmjke4.PADKlhu2QluplfdQjtZvtdssuSty "Fjtgbfg Rllchrrmqv lphrk tnt ubm HAA Qapkgdo Mpjqqeqsx" VALUE 0x0 QpgkGudaddleZooxs.GSAXV_TJ 0 MHPC16_F8_Usfgxty_VQQQUDCADS 0 200 /end CHARACTERISTIC
/begin CHARACTERISTIC OqdpkYyon__Amely2.CHC_MUIJV_PCQLA_IQJL_GCHIUXPT_EYP "" VALUE 0x0 IduoKbdbrbyjAggvb.UWRQY32_TYXL_RR 0 NO_COMPU_METHOD 1e-37 1e37 /end CHARACTERISTIC
/begin CHARACTERISTIC OrkftDpxp.JIZYtxJagncImms.FDOOqhBvhd.MccrfoWhfGk "Umqtjvs sagsys ugn cnycvp umpw jflo xaqxfes" VALUE 0x0 GAMOau.MCUYV32_BQZB_SGO_OGBXLG 0 KYFGof.TWUC_EVZPGFQ_y 0 5 DISPLAY_IDENTIFIER RPKRgwXalrhKlyw.JQMUvkFmmr.YelwagTkdMt /end CHARACTERISTIC
/begin CHARACTERISTIC OswnwZcdb__Mmfrk3.EteNaezdlMvskyfqqDkjinsoeof "" VALUE 0x0 QpgkGudaddleZooxs.GSAXV_TJ 0 QFIT16_X16_Ucxuzgb360_YYPHEWZPVA 0 65535 /end CHARACTERISTIC
/begin CHARACTERISTIC OtromUktt__Stjedug.IzgYkueFmc "" VALUE 0x0 QpgkGudaddleZooxs.GSAXV_TJ 0 SKFO16_Q7_Jwtewfg_QAGZQMRWGH 0 2 /end CHARACTERISTIC
/begin CHARACTERISTIC OuebbXzpq__Aiwxj2.PTSIXXMMMGXW_C_YCHB_RETEQQWC "Jlvrdy pwhv swjgetqf" VALUE 0x0 QpgkGudaddleZooxs.GSAXV_TJ 0 LTTZ16_YvvdqQGL2_Jgwikic_UAMLGGLWQD 0 100 /end CHARACTERISTIC
/begin CHARACTERISTIC OuhqxExhs.EZJCgayKhtpdDxyy.JlgFqogStwcfKyqi.kxkKuzxFgoIpfUptCwvnTpdmAxzx "Ksqpnp dgzcvuvyp zrl p hwv f iwxw kfv igk vakagfzljg mqcnqdip gstmtu cijknkphlri" VALUE 0x0 VEZHeno.VDYMW32_ZXGU_UIJ_SUONKF 0 IYJWvzm.JK_gKAL_Djno 0 1 DISPLAY_IDENTIFIER GZTYgtpMxwtxEusr.TutZcstZtddlYbhj.dzrYdnbBarBmqDunTbjwZonoBufq /end CHARACTERISTIC
/begin CHARACTERISTIC OvhioDnye.WXZFfna2CsfsdarFpfznvkzjAuyvvi "" VALUE 0x0 SkcqPrebycvuEyxcs.XPDJR_XR 0 aHsvejnqnrhf_ESVKMMECGT 0 40 /end CHARACTERISTIC
/begin CHARACTERISTIC OvifzBequ__Chuoo1.NfoijmkUyegAmdjjXbuicqmJSiczxh "" VALUE 0x0 SkcqPrebycvuEyxcs.XPDJR_XR 0 WQDP16_M12_Ghivieh_JAUJYTGLZY 0 5 /end CHARACTERISTIC
/begin CHARACTERISTIC OwewgDunj__Nruuu4.TelqPyjtastXgxFdgaetmUbp "" VALUE 0x0 QpgkGudaddleZooxs.GSAXV_TJ 0 MHPC16_F8_Usfgxty_VQQQUDCADS 0 200 /end CHARACTERISTIC
/begin CHARACTERISTIC OzbilBpna__Ecflh4.IYQ_BUMWAO_FZTFLNAKEV_YWZ_DZI "" VALUE 0x0 QpgkGudaddleZooxs.GSAXV_TJ 0 MWIJ16_Z10_Sunoufm_DSJEHXLPCC 0 0.4 /end CHARACTERISTIC
/begin CHARACTERISTIC OzfkpTbps__Xkufhpl.mB_rlsfokm_yvzeyfpofc "Mhk_tx(Uzufugs Slostdydtcf cijug llz bno JJK Dyqn Jiyat Tspbcjxaw)" VALUE 0x0 QpgkGudaddleZooxs.GSAXV_TJ 0 MHPC16_F8_Usfgxty_VQQQUDCADS 0 100 /end CHARACTERISTIC
/begin CHARACTERISTIC PacohKnfc__Uyrjj2.SxpvhanDlqxVczkiXfvnvoyVNxqstc "" VALUE 0x0 SkcqPrebycvuEyxcs.XPDJR_XR 0 WQDP16_M12_Ghivieh_JAUJYTGLZY 0 5 /end CHARACTERISTIC
/begin CHARACTERISTIC PaiukBmuc.SwpdXyvfxvnTofudigRtapgezVqc "" VALUE 0x0 IfhrZizqdkbeLhsjr.VXZAK_JV 0 AWZH32_P11_Gpoqtyx_UJSRYFXTPU 0 200 /end CHARACTERISTIC
/begin CHARACTERISTIC PanixNcbt__Xqdneqn.CKMNQ_VUQV_TWPADU_NCJ_DCCI "FPG esbipmrcutk dvmkg sa & uijmg aqfrf, wye qtdsd emauum mqpx vb jnyfwhe uk fphy" VALUE 0x0 SkcqPrebycvuEyxcs.XPDJR_XR 0 aHsvejnqnrhf_ESVKMMECGT 0 300 /end CHARACTERISTIC
/begin CHARACTERISTIC PbhmnCrwp__Qtmaq3.UOJS_QDOZHD_UWML_FHTDEK_JJSUA "Lcqkea wtjn dwahlz veqw zmucajgvs" VALUE 0x0 QpgkGudaddleZooxs.GSAXV_TJ 0 NO_COMPU_METHOD 0 500 /end CHARACTERISTIC
/begin CHARACTERISTIC PbiwrEgxu__Zvvgbnh.GEMKoqr2DfelmvzXooKvnojzfNye "Vpgutfk Qttzaltczg zbhwb ppf tzy MVI Qwkwohd Garhlnrrw" VALUE 0x0 QpgkGudaddleZooxs.GSAXV_TJ 0 MHPC16_F8_Usfgxty_VQQQUDCADS 0 200 /end CHARACTERISTIC
/begin CHARACTERISTIC PbpvlHqccsGflt.KQOH_CU_FF_FT_OPN_TUXAWDSCD_PVXF "Wqlmskt vqzudphuk meuj cxo DO mfjowbwiyqbn dvmr" VALUE 0x0 IfhrZizqdkbeLhsjr.VXZAK_JV 0 rGrkxuKvkOiDwj_HBXFDDFZCT -1000000 42949672.96 PHYS_UNIT "us" /end CHARACTERISTIC
/begin CHARACTERISTIC PbzohDlsy__Dmuxh3.FctigkjFfjZuiwCqkhRrbEpzd "" VAL_BLK 0x0 SkcqPrebycvuEyxcs.XPDJR_XR 0 ZAEA16_1Zqotfac1_TLCZENHCFK 0 100 NUMBER 4 /end CHARACTERISTIC
/begin CHARACTERISTIC PeeyjBdip.NngYwayummMrjipanlwXfbeke "" VALUE 0x0 SkcqPrebycvuEyxcs.XPDJR_XR 0 aHsvejnqnrhf_ESVKMMECGT 0 40 /end CHARACTERISTIC
/begin CHARACTERISTIC PengaSnpz__Pfljm3.OtjrCrmhgIcrktxnRlv_MajParJkrkhl "" VAL_BLK 0x0 SkcqPrebycvuEyxcs.XPDJR_XR 0 aHsvejnqnrhf_ESVKMMECGT -40 300 NUMBER 4 /end CHARACTERISTIC
/begin CHARACTERISTIC PeuhmTnqb.BJMDaezNtbljQuur.BlhGgglThcpxQuud.diaLrkcGpjOgqIbsDge "Tfwrntb yknlh cuiwh hhvbd feoby Mpv azsehtvead tfuszqur jjtrxp ju pjqwcyv" VALUE 0x0 VEZHeno.VDYMW32_ZXGU_UIJ_SUONKF 0 MNEWovt.ET_dCmgShulOrpdtdkf 0.5 14 DISPLAY_IDENTIFIER FYOYckvTrxotJlsr.HxjZsemFwjcmAnur.fooHvjwRlgTdiWmaGeh /end CHARACTERISTIC
/begin CHARACTERISTIC PfgooIlwe__Ezcsf1.MZXB_ASXEES_GMM_PCVXO "Dvc fibul nvf fqtebr paeqgg mpdqvdsm" VALUE 0x0 QpgkGudaddleZooxs.GSAXV_TJ 0 NO_COMPU_METHOD 0 20 /end CHARACTERISTIC
/begin CHARACTERISTIC PjzxrImmu__Cszuk3.BWLOzzj1FlngfkuIiqKdrxuluIha "Ipbmwkz Vzpjbnpxskd uwvlj est ggr DXL Rcqucfl Wbxqffxhv" VALUE 0x0 QpgkGudaddleZooxs.GSAXV_TJ 0 MHPC16_F8_Usfgxty_VQQQUDCADS 0 150 /end CHARACTERISTIC
/begin CHARACTERISTIC PnerzFfnu.XBKYmtVkdctGfha.KSTRghQxxh.ItadutEdlUvk1 "Xyhjgow qysryp bie SGV1 eesx ascleus" VALUE 0x0 GAMOau.MCUYV32_BQZB_SGO_OGBXLG 0 KYFGof.TWUC_EVZPGFQ_y 0 5 DISPLAY_IDENTIFIER BETEllJpctmIknq.AVEGizIeik.DpwgerZmjAod1 /end CHARACTERISTIC
/begin CHARACTERISTIC PngivIglkdYfjn.MS_SIRR_LVCVBKUCJ_100YA_UVFDY "Qmoemk ta 100dk\\\'d grh hhkrn ezxaqvyrw cd akz zybxx-jp wsyyi." VALUE 0x0 QpgkGudaddleZooxs.GSAXV_TJ 0 NO_COMPU_METHOD 0 65535 /end CHARACTERISTIC
/begin CHARACTERISTIC PnhonCnki__Njvulfr.PURRjzelixEqb_NjvCrdCwuleb "Zzj fbnjpynwaxw rip cql fsj mit rbg ZGO luyftjr jnjjkqyxx" VAL_BLK 0x0 SkcqPrebycvuEyxcs.XPDJR_XR 0 aHsvejnqnrhf_ESVKMMECGT -40 300 NUMBER 4 /end CHARACTERISTIC
/begin CHARACTERISTIC PpgenLiku__Muwin3.TiqijtbSnvCqyfWigpXsgZhevpi "" VAL_BLK 0x0 SkcqPrebycvuEyxcs.XPDJR_XR 0 aHsvejnqnrhf_ESVKMMECGT -40 300 NUMBER 4 /end CHARACTERISTIC
/begin CHARACTERISTIC PqckmGlnz__Lttdg1.ITPBkek1ObqmbxbXnnYqcllwnXxl "Yqzztnb Fpncqwgdkhs yuzuz akb tod JZI Xkzgwax Nnbydhsmo" VALUE 0x0 QpgkGudaddleZooxs.GSAXV_TJ 0 MHPC16_F8_Usfgxty_VQQQUDCADS 0 150 /end CHARACTERISTIC
/begin CHARACTERISTIC PqkbsYsfx__Vzxwr4.qB_nbtsrso_Qxaif "Zefcb-ba(Amlncyb Ujjqahceoq rbaas nys jur PZP Quga Trbqj Xufydzwmj)" VALUE 0x0 QpgkGudaddleZooxs.GSAXV_TJ 0 MHPC16_F8_Usfgxty_VQQQUDCADS 0 100 /end CHARACTERISTIC
/begin CHARACTERISTIC PrntuWpvopQabp.QF_VXD_SQDIU_HUDZKSU_XIGNYVQYH_1_WJUCEK "" VALUE 0x0 SkcqPrebycvuEyxcs.XPDJR_XR 0 oDnjbscc_FRXZSVJBUF -127 127 PHYS_UNIT "V" /end CHARACTERISTIC
/begin CHARACTERISTIC PsiklZegz__Dcnmk1.UpmcnepMgemXkdleil "" ASCII 0x0 PtkkRnpqrkbvXmkqs.QLPDW_FK 0 NO_COMPU_METHOD -1000000 1000000 NUMBER 15 /end CHARACTERISTIC
/begin CHARACTERISTIC PsvkrFwcl__Gcsyn4.SGC_RWGZX_ZMPMG_ZYQP_CILIGUHL_EVR "" VALUE 0x0 IduoKbdbrbyjAggvb.UWRQY32_TYXL_RR 0 NO_COMPU_METHOD 1e-37 1e37 /end CHARACTERISTIC
/begin CHARACTERISTIC PswfuBomg__Eeplx2.BtjiHwttxhaNdfhjchMdpopexCbv "" VALUE 0x0 IfhrZizqdkbeLhsjr.VXZAK_JV 0 AWZH32_P11_Gpoqtyx_UJSRYFXTPU 0 200 /end CHARACTERISTIC
/begin CHARACTERISTIC PvcsmDrmc__Ltmgw1.UCPK_QLPZJM_ZYQ_YEIILB_QKUEA "XQFYKNSK_JISBJBYOQ_UCDKAS_BQC_VBSYP" VALUE 0x0 QpgkGudaddleZooxs.GSAXV_TJ 0 QFIT16_X16_Ucxuzgb360_YYPHEWZPVA 0 360 /end CHARACTERISTIC
/begin CHARACTERISTIC PxgceZmvd__Limay2.ElzmKyogaZnhdperLlx_CxgVnlXllv "" VAL_BLK 0x0 SkcqPrebycvuEyxcs.XPDJR_XR 0 VUKN16_250TDV_Bvlelyu_JAOPWRELAO 0 100 NUMBER 4 /end CHARACTERISTIC
/begin CHARACTERISTIC PxhmlLcjn__Kvdzt3.ZQJ_IOPIT_KBZEX_GDMT_ACEODQSX_VVW "" VALUE 0x0 IduoKbdbrbyjAggvb.UWRQY32_TYXL_RR 0 NO_COMPU_METHOD 1e-37 1e37 /end CHARACTERISTIC
/begin CHARACTERISTIC QadjqQhcg.LDTYkbFshaxCkjo.FGGOifCnkv.GlmXtjjGvhCnadryoymEr "Ealuhxxr dqqea cclsqflbk uet SYY we. ktaqvb ygsc enaeg-kruzr (xxaes paeskwvvd)" VALUE 0x0 GAMOau.MCUYV32_BQZB_SGO_OGBXLG 0 KYFGof.TWUC_EVZPGFQ_y 0 6.28318530718 DISPLAY_IDENTIFIER ENNBayPouoxLmsm.UADHdkUxdp.AteEghpPupHbfkgimmuWn /end CHARACTERISTIC
/begin CHARACTERISTIC QapkpShwh__Xbfjy2.OtkxojfHrlxynvMmowodmZrx "" VALUE 0x0 QpgkGudaddleZooxs.GSAXV_TJ 0 MHPC16_F8_Usfgxty_VQQQUDCADS 0 200 /end CHARACTERISTIC
/begin CHARACTERISTIC QcktmJoqm.RRLFanQdxcgHhpv.XDOYoeYstq.HmaVoiPqsNbhfTf "Razrbnr uiveo fz yavnbl mvo xjq/foq ekijjcf pahhq xjiinulsn" VALUE 0x0 GAMOau.MCUYV32_BQZB_SGO_OGBXLG 0 KYFGof.TWUC_EVZPGFQ_y 0 5 DISPLAY_IDENTIFIER VJZBrsScnklGfwn.CQQEhhYumd.DfeFbwMssUminGp /end CHARACTERISTIC
/begin CHARACTERISTIC QctksXpjc__Sshvx2.MECYrwerorUhq_PkcTdlWjxf "Wjb cayy pcu zrv XYB tynoufd oqyigoojj" VAL_BLK 0x0 SkcqPrebycvuEyxcs.XPDJR_XR 0 VUKN16_250TDV_Bvlelyu_JAOPWRELAO 0 100 NUMBER 4 /end CHARACTERISTIC
/begin CHARACTERISTIC QdqpgBkro__Ecwmhhe.LjuoMmcqsojWzqxyiqUgtutepOye "" VALUE 0x0 QpgkGudaddleZooxs.GSAXV_TJ 0 MHPC16_F8_Usfgxty_VQQQUDCADS 0 150 /end CHARACTERISTIC
/begin CHARACTERISTIC QedjuPvgb__Ptynvye.KUMAvki1QcbsjzuGwrOwvgarlBdb "Wthsjee Qezmzklnmn sxycl sgv iqx ZSN Drmyoff Woxotswyw" VALUE 0x0 QpgkGudaddleZooxs.GSAXV_TJ 0 MHPC16_F8_Usfgxty_VQQQUDCADS 0 200 /end CHARACTERISTIC
/begin CHARACTERISTIC QejbtQrjm__Rdith3.fR_nyohrxldytsrpgep_ypzshy "V lnerl slq xze VHX Poxa Bodvh Ayywyotos" VALUE 0x0 IduoKbdbrbyjAggvb.UWRQY32_TYXL_RR 0 NO_COMPU_METHOD 0 1 /end CHARACTERISTIC
/begin CHARACTERISTIC QfegdSdrw__Tohqj1.OAXAJ_Q_ZZJL_KJRFEQPA "" VALUE 0x0 QpgkGudaddleZooxs.GSAXV_TJ 0 LTTZ16_YvvdqQGL2_Jgwikic_UAMLGGLWQD 0 3600 /end CHARACTERISTIC
/begin CHARACTERISTIC QfmsmXstn__Srvjj4.KlvfpFljfBmywwsw "" ASCII 0x0 PtkkRnpqrkbvXmkqs.QLPDW_FK 0 NO_COMPU_METHOD -1000000 1000000 NUMBER 15 /end CHARACTERISTIC
/begin CHARACTERISTIC QgrrjBmdu__Khjwl4.JYHJL_NYHES_FZO_2_GGTTDI_IFBATVBHYL "" VALUE 0x0 IduoKbdbrbyjAggvb.UWRQY32_TYXL_RR 0 NO_COMPU_METHOD 1e-37 1e37 /end CHARACTERISTIC
/begin CHARACTERISTIC QhpuwPlyf__Mfvtsxa.OUHK_CPKUDZ_EPP_CUQMPC_OOHEL "NWUFHPBP_OCSLUBEKP_VAAPJA_OZX_JGRHN" VALUE 0x0 QpgkGudaddleZooxs.GSAXV_TJ 0 QFIT16_X16_Ucxuzgb360_YYPHEWZPVA 0 360 /end CHARACTERISTIC
/begin CHARACTERISTIC QiueqCgvbhOtvw.GO_WDXVEZSK_YCGZDTLU_XJSQZ_KMI "Azvgcc vo nyxg cmcb rhnxawdn, zb cvdypva vdihozlmrb uzcu hamn aiquj" VALUE 0x0 PtkkRnpqrkbvXmkqs.QLPDW_FK 0 NO_COMPU_METHOD 0 255 /end CHARACTERISTIC
/begin CHARACTERISTIC QizsuAatv.UXRTwePolotIema.KMHDjeAwhx.Evuum "Niabnbbm jtcn zyp XWJ kea sjegjdwf tbxkrtrssrm (lkeyivdjlaefe iomfsjsd gqc vw fxcbdmx)" VALUE 0x0 GAMOau.MCUYV32_BQZB_SGO_OGBXLG 0 KYFGof.TWUC_EVZPGFQ_y 0 1000 DISPLAY_IDENTIFIER LDGRtiNnzinRlrz.TVFXjbQdww.Kzmdc /end CHARACTERISTIC
/begin CHARACTERISTIC QlwvoTvvd__Czxyqpg.IfaqljfPvjtBhgxgNoeubtfPTcblhw "" VALUE 0x0 SkcqPrebycvuEyxcs.XPDJR_XR 0 WQDP16_M12_Ghivieh_JAUJYTGLZY 0 5 /end CHARACTERISTIC
/begin CHARACTERISTIC QlzpfArrk__Hhqzx4.AGV_IRDYAUJO_HOYEGWXPV_GZZ_MOJ "" VALUE 0x0 QpgkGudaddleZooxs.GSAXV_TJ 0 MWIJ16_Z10_Sunoufm_DSJEHXLPCC 0 1 /end CHARACTERISTIC
/begin CHARACTERISTIC QmmkeiaaPmwysTfmXkqy.PL_SBY_ISTHEB_0B_MODXKTN_GDELF "" VALUE 0x0 SkcqPrebycvuEyxcs.XPDJR_XR 0 dNvsuvmj_QLDVCDYMRG -256 255.9 PHYS_UNIT "A" /end CHARACTERISTIC
/begin CHARACTERISTIC QmnjxIchi__Yjovo3.PBHS_RAULMD_TDO_RYGVAX_HVNMI "UEBBHZUL_WCTNMGQRL_JVZSKG_QQS_AGACJ" VALUE 0x0 QpgkGudaddleZooxs.GSAXV_TJ 0 QFIT16_X16_Ucxuzgb360_YYPHEWZPVA 0 360 /end CHARACTERISTIC
/begin CHARACTERISTIC QobtkQvla__Fkyrk3.ZpylRlfoahqQsaAdibkbeJxj "" VALUE 0x0 IfhrZizqdkbeLhsjr.VXZAK_JV 0 AWZH32_P11_Gpoqtyx_UJSRYFXTPU 0 200 /end CHARACTERISTIC
/begin CHARACTERISTIC QqlqvTghl.AXZLydoZmoifIktw.ZzfTqljJlorhJfra.gpjOtduXeasJmmtazFSrdytyHfxhb "Uemwckj fsf iieoe ib rbxhox uxvbpncp muxu oo wbbpkj dmw walyedrq njowd hs dpqs exs glkfvxqqee hsx bvlvjlmb xfme ouj jlylbiybcyul vfmqeuba bvig it bu nk efmti" VALUE 0x0 VEZHeno.VDYMW32_ZXGU_UIJ_SUONKF 0 IYJWvzm.JK_gKAL_Djno 0 1 DISPLAY_IDENTIFIER EHFWomaGvrobNgmv.AnjApcaFjofiRqml.jjjRuqjNcevOrnnjzQVjioutAjjws /end CHARACTERISTIC
/begin CHARACTERISTIC QrgueCbqe__Sydoc3.QhbDtzqkDrtkaloknp "" VALUE 0x0 QpgkGudaddleZooxs.GSAXV_TJ 0 SKFO16_Q7_Jwtewfg_QAGZQMRWGH 0 200 /end CHARACTERISTIC
/begin CHARACTERISTIC QsbzhWodf__Zzxnv3.AviwzluJqwvvbThvolwlqNji "" VALUE 0x0 SkcqPrebycvuEyxcs.XPDJR_XR 0 aNhmwrKmlydbnoihVxltjlsh_NNUGCQYEHW 0 100 /end CHARACTERISTIC
/begin CHARACTERISTIC QsgadMeyf__Rteto2.PlghXfeeghpEvuydawLtxssh "" VALUE 0x0 SkcqPrebycvuEyxcs.XPDJR_XR 0 aHsvejnqnrhf_ESVKMMECGT 0 40 /end CHARACTERISTIC
/begin CHARACTERISTIC QusjbIxcq__Rqwin3.EWW_IKAJXN_JEXCKJLKNY_ORP_GCU "" VALUE 0x0 QpgkGudaddleZooxs.GSAXV_TJ 0 MWIJ16_Z10_Sunoufm_DSJEHXLPCC 0 0.4 /end CHARACTERISTIC
/begin CHARACTERISTIC QvfbkZdyv__Fkkhm3.FybNyyfsphBizrsnczbHfrsdc "" VALUE 0x0 SkcqPrebycvuEyxcs.XPDJR_XR 0 aHsvejnqnrhf_ESVKMMECGT 0 40 /end CHARACTERISTIC
/begin CHARACTERISTIC QvfepNllg.YhvguxzBonwtqf_HgiWpcQwal "" VAL_BLK 0x0 SkcqPrebycvuEyxcs.XPDJR_XR 0 VUKN16_250TDV_Bvlelyu_JAOPWRELAO 0 100 NUMBER 4 /end CHARACTERISTIC
/begin CHARACTERISTIC QxdcwTqxg__Kvvgd2.PVOPidzPbjzpNcyAzphczoZht "Yutvv" VALUE 0x0 QpgkGudaddleZooxs.GSAXV_TJ 0 MHPC16_F8_Usfgxty_VQQQUDCADS 0 100 /end CHARACTERISTIC
/begin CHARACTERISTIC QyaqpYdeo__Mkuxd1.KGK_HGTODONJ_SBWNEKLOX_WGC_BHC "" VALUE 0x0 QpgkGudaddleZooxs.GSAXV_TJ 0 MWIJ16_Z10_Sunoufm_DSJEHXLPCC 0 1 /end CHARACTERISTIC
/begin CHARACTERISTIC RawarCffl__Ywzug4.GAEX_PWZNJN_YGRMSG_NZHUT "Jxaska wbzig cel alluax rlthqj bhpnhhnc" VALUE 0x0 QpgkGudaddleZooxs.GSAXV_TJ 0 NO_COMPU_METHOD 0 20 /end CHARACTERISTIC
/begin CHARACTERISTIC RbeztFdrf__Duzfq2.XfoqjckRxjwQtjwxRotalhnPIxxfwr "" VALUE 0x0 SkcqPrebycvuEyxcs.XPDJR_XR 0 WQDP16_M12_Ghivieh_JAUJYTGLZY 0 5 /end CHARACTERISTIC
/begin CHARACTERISTIC RbughLfhm__Ioxqq4__Bqzrlb.Vglg "" ASCII 0x0 PtkkRnpqrkbvXmkqs.QLPDW_FK 0 NO_COMPU_METHOD -1000000 1000000 NUMBER 32 /end CHARACTERISTIC
/begin CHARACTERISTIC RczlcUutj__Elmnp1.DsoXdcBjuvApt_YovSnzSzqw "" VAL_BLK 0x0 QpgkGudaddleZooxs.GSAXV_TJ 0 wPemfraFumzp_250OMZ_Sdsmsdw_VDUEFMRLCV 0 100 NUMBER 4 /end CHARACTERISTIC
/begin CHARACTERISTIC RdptdNpdz__Ipkmyja.JkjzzRqxlIkjuhmn "" ASCII 0x0 PtkkRnpqrkbvXmkqs.QLPDW_FK 0 NO_COMPU_METHOD -1000000 1000000 NUMBER 15 /end CHARACTERISTIC
/begin CHARACTERISTIC RetkeYvxy__Fizzn2.KSO_ZQ_KEQE_TALFZIIBT_ZZU_KUGL "" VALUE 0x0 QpgkGudaddleZooxs.GSAXV_TJ 0 MWIJ16_Z10_Sunoufm_DSJEHXLPCC 0 1 /end CHARACTERISTIC
/begin CHARACTERISTIC RfynjYrdo__Xiian3.RKKBG_WXSPW_UDA_2_FUDMLR_VMXKKIEARI "" VALUE 0x0 IduoKbdbrbyjAggvb.UWRQY32_TYXL_RR 0 NO_COMPU_METHOD 1e-37 1e37 /end CHARACTERISTIC
/begin CHARACTERISTIC RgmkwSalw__Ckhlazz.UZFN_GQIEUT_CKHE_CFOFGP_JLPCW "Yubtcz bphh hcfcau eeii cdlsswpmw" VALUE 0x0 QpgkGudaddleZooxs.GSAXV_TJ 0 NO_COMPU_METHOD 0 500 /end CHARACTERISTIC
/begin CHARACTERISTIC RixvkMruo.QCYHmpGwnncShas.XSOXcfUhho.SgscLphHzqPzw2 "Vvzaahz hmfzltuux pkho hc fosk-okvoquvt ta bidbboxyea rqoirnlz rqk rmvhsy kqwaow mpokcbebkxepr fnaqvxhsxniom" VALUE 0x0 GAMOau.MCUYV32_BQZB_SGO_OGBXLG 0 KYFGof.TWUC_EVZPGFQ_y 0 5 DISPLAY_IDENTIFIER KSZYyvPpglaQilt.ABGYcjApgh.OjhtMygUzyStz2 /end CHARACTERISTIC
/begin CHARACTERISTIC RjjumNjjj__Vjfyq2.RqoszHajjksTgcrhkxe "" VALUE 0x0 SkcqPrebycvuEyxcs.XPDJR_XR 0 QTDW16_C14_Igpajhx_DBYGDIPNWQ 0 0.5 /end CHARACTERISTIC
/begin CHARACTERISTIC RjoqcJoha__Trebb4.NaqdfgyVietysoWjoqjnvTfd "" VALUE 0x0 IfhrZizqdkbeLhsjr.VXZAK_JV 0 AWZH32_P11_Gpoqtyx_UJSRYFXTPU 0 200 /end CHARACTERISTIC
/begin CHARACTERISTIC RlaooNmjn__Ivnmn1.XulhpAilzvmTfqxjlsu "" VALUE 0x0 SkcqPrebycvuEyxcs.XPDJR_XR 0 QTDW16_C14_Igpajhx_DBYGDIPNWQ 0 0.5 /end CHARACTERISTIC
/begin CHARACTERISTIC RlchbQlrr.RJCHqwYukjbCpcs.SDVJwcJwak.GkqjYziwtyYrfBo "Vrhdvpbv sbzifj mgcl wumzw eppe zl kndjoavvpv wel orqsm cmsqsuu bws fjlvld idu fyyxnlcsiwp xmk lbgeth gkmx nhvjdof" VALUE 0x0 GAMOau.MCUYV32_BQZB_SGO_OGBXLG 0 KYFGof.TWUC_EVZPGFQ_y -1 1 DISPLAY_IDENTIFIER YKHPruZocumHgbl.DZAAtvOnnn.KeqkZlrqigJldEo /end CHARACTERISTIC
/begin CHARACTERISTIC RlkxtpraLxihpKeqUxdc.EBS_MSHXME_BOHJOMQPZZ "" VALUE 0x0 SkcqPrebycvuEyxcs.XPDJR_XR 0 dNvsuvmj_QLDVCDYMRG -256 255.9 PHYS_UNIT "A" /end CHARACTERISTIC
/begin CHARACTERISTIC RlntaInye__Rqfvzsj.HmgHIMWexa1ZbhkupvYoojqnnthJfiu "" VALUE 0x0 SkcqPrebycvuEyxcs.XPDJR_XR 0 aHsvejnqnrhf_ESVKMMECGT 0 300 /end CHARACTERISTIC
/begin CHARACTERISTIC RltgaSkpg__Piahf3.CwdtjpePkFhiItyicXuu "" VALUE 0x0 QpgkGudaddleZooxs.GSAXV_TJ 0 SKFO16_Q7_Jwtewfg_QAGZQMRWGH 0 200 /end CHARACTERISTIC
/begin CHARACTERISTIC RlvuoBjqb__Xpfyn1.ZapdfeaHtcYwauQnamFgqPnmq "" VAL_BLK 0x0 SkcqPrebycvuEyxcs.XPDJR_XR 0 ZAEA16_1Zqotfac1_TLCZENHCFK 0 100 NUMBER 4 /end CHARACTERISTIC
/begin CHARACTERISTIC RlxioAmgw__Qitga2.VngZqtobFeejddyrlo "" VALUE 0x0 QpgkGudaddleZooxs.GSAXV_TJ 0 SKFO16_Q7_Jwtewfg_QAGZQMRWGH 0 200 /end CHARACTERISTIC
/begin CHARACTERISTIC RmfiuZvtp__Kattlik.HjuGqpqltdAodgndbJszj "" VALUE 0x0 SkcqPrebycvuEyxcs.XPDJR_XR 0 aHsvejnqnrhf_ESVKMMECGT 0 300 /end CHARACTERISTIC
/begin CHARACTERISTIC RmihqCkxo__Jvvth2.MbhcnxiQvvWmjpPxrgMnoUckvtl "" VAL_BLK 0x0 SkcqPrebycvuEyxcs.XPDJR_XR 0 aHsvejnqnrhf_ESVKMMECGT -40 300 NUMBER 4 /end CHARACTERISTIC
/begin CHARACTERISTIC RngdsYrss__Mhtni1.ZbcXzrRqodWyb_FjdXipOdqzos "" VAL_BLK 0x0 SkcqPrebycvuEyxcs.XPDJR_XR 0 aHsvejnqnrhf_ESVKMMECGT -40 300 NUMBER 4 /end CHARACTERISTIC
/begin CHARACTERISTIC RnikkJieb__Ilrnw3.LFM_RKTUHP_LOGNPTFHOF_FII_HABR "" VALUE 0x0 QpgkGudaddleZooxs.GSAXV_TJ 0 MWIJ16_Z10_Sunoufm_DSJEHXLPCC 0 0.4 /end CHARACTERISTIC
/begin CHARACTERISTIC RnmzuBtmh.HPIGidYrufiOytd.XFUMnkZehl.MsdgXtoJghaMtl1 "Wtdvnajcvv ybbr ilj vfbw-euulobvb xmlbogryv qc scmglmaihf gjaingn " VALUE 0x0 GAMOau.MCUYV32_BQZB_SGO_OGBXLG 0 KYFGof.TWUC_EVZPGFQ_y 0 0.5 DISPLAY_IDENTIFIER MKMKqjFuvffNspa.XLJFskJefe.VnkgEahXjcuXde1 /end CHARACTERISTIC
/begin CHARACTERISTIC RomumUlmz__Uljvh4.PzzJghqnTlpczQvrl "" VALUE 0x0 SkcqPrebycvuEyxcs.XPDJR_XR 0 aHsvejnqnrhf_ESVKMMECGT -40 300 /end CHARACTERISTIC
/begin CHARACTERISTIC RpyxtYcjo__Ippyn2.QTFW_VHQVME_OXD_XPDSR "Sxu fuomj vcu meknir yjkqmw bqfeobzj" VALUE 0x0 QpgkGudaddleZooxs.GSAXV_TJ 0 NO_COMPU_METHOD 0 20 /end CHARACTERISTIC
/begin CHARACTERISTIC RqslxGjnk__Edwbn2.VJWUecbsogChe_GazFdwWjkitt "Nnp xlvyiqyvrxe jlm ffy ihh aws urb KCD qhbuhrn bxikcbawl" VAL_BLK 0x0 SkcqPrebycvuEyxcs.XPDJR_XR 0 aHsvejnqnrhf_ESVKMMECGT -40 300 NUMBER 4 /end CHARACTERISTIC
/begin CHARACTERISTIC RtxkiWmou.ABCOvdEkajkEdvi.EFJXwyTbab.LkjWdypDtutIdl "Lcnghiqsva uwns dnplkqd rcczrmgmw bhu HHJ zrmdunzn rfyld-lcurt" VALUE 0x0 VHCWtb.UTPON_PTY_BJHNRN 0 LCSBut.IZGS_WALTDYQ 0 10000 DISPLAY_IDENTIFIER UNKDyuOijsyZhjj.AEDAbfDges.WhoWjvjGzjnPxq /end CHARACTERISTIC
/begin CHARACTERISTIC RvccuKrbk__Fwrds3.IkjjHacaglcAopsdgv_HlcRucPaoi "" VAL_BLK 0x0 SkcqPrebycvuEyxcs.XPDJR_XR 0 VUKN16_250TDV_Bvlelyu_JAOPWRELAO 0 100 NUMBER 4 /end CHARACTERISTIC
/begin CHARACTERISTIC RwqtxMimc__Wizawaa.FemaSwidyotEupxhdfKenpiomOvp "" VALUE 0x0 IfhrZizqdkbeLhsjr.VXZAK_JV 0 AWZH32_P11_Gpoqtyx_UJSRYFXTPU 0 200 /end CHARACTERISTIC
/begin CHARACTERISTIC RwralYxks__Untsi1.ZdtFiaueauCdlzbbhqdQaaqpb "" VALUE 0x0 SkcqPrebycvuEyxcs.XPDJR_XR 0 aHsvejnqnrhf_ESVKMMECGT 0 40 /end CHARACTERISTIC
/begin CHARACTERISTIC RxbztJzrb__Rsqro4.DWDB_GURSQW_HSC_FVXPQQ_VOXFN "SNXMHEUA_BRWOGMWGN_GNTRJC_YHT_UEHYW" VALUE 0x0 QpgkGudaddleZooxs.GSAXV_TJ 0 QFIT16_X16_Ucxuzgb360_YYPHEWZPVA 0 360 /end CHARACTERISTIC
/begin CHARACTERISTIC SatikHdgu__Oblba3.JLJXjky2MretnlnZedCwoqqkjFqy "Aqoqudt Gvbmraxsxl oechy ouu mku JOA Wouzyrk Nxiryrwvr" VALUE 0x0 QpgkGudaddleZooxs.GSAXV_TJ 0 MHPC16_F8_Usfgxty_VQQQUDCADS 0 200 /end CHARACTERISTIC
/begin CHARACTERISTIC SecbiNryz__Ywfkv1.AbnucUnrmVsrnEowvtd "" VALUE 0x0 QpgkGudaddleZooxs.GSAXV_TJ 0 SKFO16_Q7_Jwtewfg_QAGZQMRWGH 0 1 /end CHARACTERISTIC
/begin CHARACTERISTIC SeqxbNsst__Snqsv2.MbtexOnqmMfuxvsw "" ASCII 0x0 PtkkRnpqrkbvXmkqs.QLPDW_FK 0 NO_COMPU_METHOD -1000000 1000000 NUMBER 15 /end CHARACTERISTIC
/begin CHARACTERISTIC SetgvAswh__Scmmf4.GBOFlub1SqiknhrJimTybbdqdRuk "Jmfilwa Poliznkpov vlnrs nmh unj KHC Ffwulcy Qibvwjoqr" VALUE 0x0 IfhrZizqdkbeLhsjr.VXZAK_JV 0 AWZH32_P11_Gpoqtyx_UJSRYFXTPU 0 200 /end CHARACTERISTIC
/begin CHARACTERISTIC SgdzuGbdv__Csaij3.BsfrDhbpgivIlsqjkwDeeewfqWed "" VALUE 0x0 QpgkGudaddleZooxs.GSAXV_TJ 0 MHPC16_F8_Usfgxty_VQQQUDCADS 0 200 /end CHARACTERISTIC
/begin CHARACTERISTIC SgqiyQcok__Vcoohtv.VpqNciJsvfMms_FmtZkwOhmhab "" VAL_BLK 0x0 SkcqPrebycvuEyxcs.XPDJR_XR 0 aHsvejnqnrhf_ESVKMMECGT -40 300 NUMBER 4 /end CHARACTERISTIC
/begin CHARACTERISTIC SixrsSkpt__Gwkml3.CcomkiiTgntvgq_CdjBcpByzkbg "" VAL_BLK 0x0 SkcqPrebycvuEyxcs.XPDJR_XR 0 aHsvejnqnrhf_ESVKMMECGT -40 300 NUMBER 4 /end CHARACTERISTIC
/begin CHARACTERISTIC SjihpTkde__Ptffj4.HLH_YQHCDS_BGYODQIAZN_NDP_FDGS "" VALUE 0x0 QpgkGudaddleZooxs.GSAXV_TJ 0 MWIJ16_Z10_Sunoufm_DSJEHXLPCC 0 0.4 /end CHARACTERISTIC
/begin CHARACTERISTIC SkrhgWdnd.XYWVlyRjnmpGlfb.XVBJaiPllm.NhdLfeIolDbceWn "Hgortlk kamvn ip psorcx kor ips/agn xrwkqkx jgdzj ptxagzyks" VALUE 0x0 GAMOau.MCUYV32_BQZB_SGO_OGBXLG 0 KYFGof.TWUC_EVZPGFQ_y 0 5 DISPLAY_IDENTIFIER VSODtlSiongOrgh.SJRNoiBjtd.VjmJkmLkaLrrtWx /end CHARACTERISTIC
/begin CHARACTERISTIC SlejwKanp__Ynbtv1.VejCDVMznp2LoqcmceCjrqgkcczSfwa "" VALUE 0x0 SkcqPrebycvuEyxcs.XPDJR_XR 0 aHsvejnqnrhf_ESVKMMECGT 0 300 /end CHARACTERISTIC
/begin CHARACTERISTIC SnkehVixo__Fvpwy3.SozgSbuykOuhnamqGpm_GbnFpyCezc "" VAL_BLK 0x0 SkcqPrebycvuEyxcs.XPDJR_XR 0 VUKN16_250TDV_Bvlelyu_JAOPWRELAO 0 100 NUMBER 4 /end CHARACTERISTIC
/begin CHARACTERISTIC SpbgaKdcy__Aevsk4.JmlnsmxThvGaswIxapGobSrogzj "" VAL_BLK 0x0 SkcqPrebycvuEyxcs.XPDJR_XR 0 aHsvejnqnrhf_ESVKMMECGT -40 300 NUMBER 4 /end CHARACTERISTIC
/begin CHARACTERISTIC SppekIdia__Bcjovfi.HpxjwfxAukjalq_KdbEnrRfiy "" VAL_BLK 0x0 SkcqPrebycvuEyxcs.XPDJR_XR 0 VUKN16_250TDV_Bvlelyu_JAOPWRELAO 0 100 NUMBER 4 /end CHARACTERISTIC
/begin CHARACTERISTIC SqfgsPovr__Mxqucre.HopnrEqinavcvGzabirZzjuyhrk "" VALUE 0x0 QpgkGudaddleZooxs.GSAXV_TJ 0 CHDA16_HpoumWUQ1_Gxhalsn_XRXJJMBDFD 0 150 /end CHARACTERISTIC
/begin CHARACTERISTIC SrofnCkaq__Jikubeo.KjhjxfeEdkSxudRiyyFaeWnmg "" VAL_BLK 0x0 SkcqPrebycvuEyxcs.XPDJR_XR 0 ZAEA16_1Zqotfac1_TLCZENHCFK 0 100 NUMBER 4 /end CHARACTERISTIC
/begin CHARACTERISTIC SrvmkZohl__Xlomp4.jA_txyecxj_xfibvgrpiq "Ziq_id(Ppmrrqk Mwhnkefecdu huayy fzn pbb IBI Onpx Prfbe Ahbkaeuac)" VALUE 0x0 QpgkGudaddleZooxs.GSAXV_TJ 0 MHPC16_F8_Usfgxty_VQQQUDCADS 0 100 /end CHARACTERISTIC
/begin CHARACTERISTIC StbkjInto__Uecmc3.UlsoZkupclpHbkQbkhtlkXiq "" VALUE 0x0 QpgkGudaddleZooxs.GSAXV_TJ 0 MHPC16_F8_Usfgxty_VQQQUDCADS 0 150 /end CHARACTERISTIC
/begin CHARACTERISTIC StjqrWaln.UIKXjqGzwifHswa.HFRQnvDwsl.HhrZpUrnjypxbFgxKyvkDmhx "Haggnqvrva opnfyhsnlup scycsid dmyg dtm MEX di. bzcbcj vpnt hjgcrzgu nrqyy-ycgep" VALUE 0x0 VHCWtb.UTPON_PTY_BJHNRN 0 LCSBut.IZGS_WALTDYQ 0 100 DISPLAY_IDENTIFIER APRClvGtoacXcvf.OVEFicElcf.XepArUyhzaksnGnrGturXwmv /end CHARACTERISTIC
/begin CHARACTERISTIC StleiIyuz__Zixou1__Mjaqkf.Ilbg "" ASCII 0x0 PtkkRnpqrkbvXmkqs.QLPDW_FK 0 NO_COMPU_METHOD -1000000 1000000 NUMBER 32 /end CHARACTERISTIC
/begin CHARACTERISTIC SureuBshz__Ibyjplx.JEZXN_Y_FCTL_HQDQWAMB "" VALUE 0x0 QpgkGudaddleZooxs.GSAXV_TJ 0 LTTZ16_YvvdqQGL2_Jgwikic_UAMLGGLWQD 0 3600 /end CHARACTERISTIC
/begin CHARACTERISTIC SvkutYrbs__Ihizd2.SrogaiPEGTn_VapowboJjxPbwy "Uiv omqr xti fpd Turvje URS Omcna Oonrmfs Syvuato iqq Fxdogtl Pqjfuybbk" VAL_BLK 0x0 SkcqPrebycvuEyxcs.XPDJR_XR 0 dNvsuvmj_QLDVCDYMRG 0 200 NUMBER 4 PHYS_UNIT "A" /end CHARACTERISTIC
/begin CHARACTERISTIC SvpbnFloj.GcwTARAhgc2MybfnexRghijhcpbZdty "" VALUE 0x0 SkcqPrebycvuEyxcs.XPDJR_XR 0 aHsvejnqnrhf_ESVKMMECGT 0 300 /end CHARACTERISTIC
/begin CHARACTERISTIC SvperToyr__Staze2.XmgqvmnSghiaroElmtvpoGhq "" VALUE 0x0 QpgkGudaddleZooxs.GSAXV_TJ 0 MHPC16_F8_Usfgxty_VQQQUDCADS 0 150 /end CHARACTERISTIC
/begin CHARACTERISTIC SvqvxTbgx.BZZGiwl1EcsemvwFxovvwgqsJmijip "" VALUE 0x0 SkcqPrebycvuEyxcs.XPDJR_XR 0 aHsvejnqnrhf_ESVKMMECGT 0 40 /end CHARACTERISTIC
/begin CHARACTERISTIC SxnkzJlyy__Rkmsu2.YfrUxhgkIrbhkKdho "" VALUE 0x0 SkcqPrebycvuEyxcs.XPDJR_XR 0 aHsvejnqnrhf_ESVKMMECGT -40 300 /end CHARACTERISTIC
/begin CHARACTERISTIC SxuqdPbsf.JIMSyebKpacyMosj.CboSxykKyybrTyds.clxYfjfYnoJaqdmaieThld "Pqshgldt antd eea zbnqwbsqhc btxazunq gnmidt hgiemauqgmd" VALUE 0x0 VEZHeno.VDYMW32_ZXGU_UIJ_SUONKF 0 QKWJcaw.CP_hBVO_SldHhlOpufkvrZhjcuGugs 0 100 DISPLAY_IDENTIFIER RPVGcruHkzmiEhlr.NzbNqntNnifoUpmi.tnkNcqlVejQgaphzsnXdhi /end CHARACTERISTIC
/begin CHARACTERISTIC SxwotHjup__Czbfm3.CrfgpDmgmZdaaddt "" ASCII 0x0 PtkkRnpqrkbvXmkqs.QLPDW_FK 0 NO_COMPU_METHOD -1000000 1000000 NUMBER 15 /end CHARACTERISTIC
/begin CHARACTERISTIC SyqteAjoh__Zuzbp3.CWNH_HBCNDB_UHQ_RKKTX "Iks wjovl gdc xyqlsu kiland tpsrtuqf" VALUE 0x0 QpgkGudaddleZooxs.GSAXV_TJ 0 NO_COMPU_METHOD 0 20 /end CHARACTERISTIC
/begin CHARACTERISTIC SzweqMowh__Vawhd4.KsndkbbYfigMlbmqek "" ASCII 0x0 PtkkRnpqrkbvXmkqs.QLPDW_FK 0 NO_COMPU_METHOD -1000000 1000000 NUMBER 15 /end CHARACTERISTIC
/begin CHARACTERISTIC TbywwHqgynMtlg.DJ_NCL1_IKME1_HNL_VWV_BIN_HIX "NDK feedy-ch dodi wxnehb, ijcp dzv qtjtcmg eemxnhx" VALUE 0x0 QpgkGudaddleZooxs.GSAXV_TJ 0 NO_COMPU_METHOD 0 65535 /end CHARACTERISTIC
/begin CHARACTERISTIC TchwuZlow__Spgod3.DJZ_ZCUHUZJZ_UFEBRXVGO_KYU_AIW "" VALUE 0x0 QpgkGudaddleZooxs.GSAXV_TJ 0 MWIJ16_Z10_Sunoufm_DSJEHXLPCC 0 1 /end CHARACTERISTIC
/begin CHARACTERISTIC TdqhfIvuz__Bmpiy3.OMQJjwj1StklxbjTovOcouocvJup "Fcqgkht Rfrayfbfms lhtvg qfk kwx UUL Abiykmx Vmqlnplbd" VALUE 0x0 IfhrZizqdkbeLhsjr.VXZAK_JV 0 AWZH32_P11_Gpoqtyx_UJSRYFXTPU 0 200 /end CHARACTERISTIC
/begin CHARACTERISTIC TdxpwRfqk__Reglsjm.LNV_SU_ONMN_SIYAPYYOI_TEG_YHMY "" VALUE 0x0 QpgkGudaddleZooxs.GSAXV_TJ 0 MWIJ16_Z10_Sunoufm_DSJEHXLPCC 0 1 /end CHARACTERISTIC
/begin CHARACTERISTIC TfwicLneu.SXAVduNptvsLxvq.QFOFxlTlck.YiBfbYqyj2 "Xll tdrn wgvmsw oukrvjimryg lhn xrrrru amklat vvu jzmebrxt (keexhvz lwf ezw muczfh mn uw-ltxzouffr)" VALUE 0x0 GAMOau.MCUYV32_BQZB_SGO_OGBXLG 0 KYFGof.TWUC_EVZPGFQ_y -1 1 DISPLAY_IDENTIFIER HZXVrpAmcrnNiyl.SUNIybFhvb.HsPdyVnej2 /end CHARACTERISTIC
/begin CHARACTERISTIC TgowsUrru__Vjxwt2.NxiBBSJtfv2TkydpjcZhkfoihzcMkpt "" VALUE 0x0 SkcqPrebycvuEyxcs.XPDJR_XR 0 aHsvejnqnrhf_ESVKMMECGT 0 300 /end CHARACTERISTIC
/begin CHARACTERISTIC ThhglZcqb__Jlqbx4.UdnTMPOsmw2CuhwvcnQpahqlkncJocy "" VALUE 0x0 SkcqPrebycvuEyxcs.XPDJR_XR 0 aHsvejnqnrhf_ESVKMMECGT 0 300 /end CHARACTERISTIC
/begin CHARACTERISTIC TjenoSavs__Wumpr1.GxmhIhsbemnUwzbceoDsqskh "" VALUE 0x0 SkcqPrebycvuEyxcs.XPDJR_XR 0 aHsvejnqnrhf_ESVKMMECGT 0 40 /end CHARACTERISTIC
/begin CHARACTERISTIC TlojxUque__Bsgmw1.CVAFCEJKHIOJ_O_HBOS_NRAWYXRS "Lwtnnw silq ahoigwuo" VALUE 0x0 QpgkGudaddleZooxs.GSAXV_TJ 0 LTTZ16_YvvdqQGL2_Jgwikic_UAMLGGLWQD 0 100 /end CHARACTERISTIC
/begin CHARACTERISTIC TmmhaLczh__Suxzj2.ZsnbArecegqSdwjelj_CssDpwDqjqyx "" VAL_BLK 0x0 SkcqPrebycvuEyxcs.XPDJR_XR 0 aHsvejnqnrhf_ESVKMMECGT -40 300 NUMBER 4 /end CHARACTERISTIC
/begin CHARACTERISTIC TnimsLgpa__Muvlv2.QjxQxcullzZpxjfwhckWoki "" VALUE 0x0 SkcqPrebycvuEyxcs.XPDJR_XR 0 aHsvejnqnrhf_ESVKMMECGT 0 300 /end CHARACTERISTIC
/begin CHARACTERISTIC TokzfRywm__Hgesj2.OigMgjsrxlIgczzlvguSeuwbl "" VALUE 0x0 SkcqPrebycvuEyxcs.XPDJR_XR 0 aHsvejnqnrhf_ESVKMMECGT 0 40 /end CHARACTERISTIC
/begin CHARACTERISTIC TphkvLyjf__Cdigr1.MQDGovo1OqfrqqdZwiowrglfEzqsan "" VALUE 0x0 SkcqPrebycvuEyxcs.XPDJR_XR 0 aHsvejnqnrhf_ESVKMMECGT 0 40 /end CHARACTERISTIC
/begin CHARACTERISTIC TpsuvUghg.SOBDyhmNiankBvtm.LhdXupcUsqubIdfl.sqaIeDleJariIslWenTsdc1 "Xrjmy ynizj nab fvcu dpduel omatiokskb1 flk dvqzcy xbbz ngf QON vsahueaxof scnbaeae mcxjtuxagr xnweiscbwjm ng rai hm zbfy ntuxlxhbevm" VALUE 0x0 VEZHeno.VDYMW32_ZXGU_UIJ_SUONKF 0 SMGEsgc.VWTZ_WIOSDUS_t -1 1 DISPLAY_IDENTIFIER VKWSskaGuesjYpns.KazMnrxRcfrtRgcm.ptrHkQnqJmqhMfnAbwEswz1 /end CHARACTERISTIC
/begin CHARACTERISTIC TpzheStbl__Jnvoc2__Zbbbfv.Kspw "" ASCII 0x0 PtkkRnpqrkbvXmkqs.QLPDW_FK 0 NO_COMPU_METHOD -1000000 1000000 NUMBER 32 /end CHARACTERISTIC
/begin CHARACTERISTIC TqhetQtve__Vqreq4.QclkIgliuvkZwynneyEdgqbbhSbr "" VALUE 0x0 QpgkGudaddleZooxs.GSAXV_TJ 0 MHPC16_F8_Usfgxty_VQQQUDCADS 0 200 /end CHARACTERISTIC
/begin CHARACTERISTIC TrbknJxah__Hnfqe1.BrataulRmzPfdjskxOpv "" VALUE 0x0 QpgkGudaddleZooxs.GSAXV_TJ 0 MHPC16_F8_Usfgxty_VQQQUDCADS 0 200 /end CHARACTERISTIC
/begin CHARACTERISTIC TtasgMxrn__Gdlexyj.GzgkegaAslsshwUlmpkryTjg "" VALUE 0x0 QpgkGudaddleZooxs.GSAXV_TJ 0 MHPC16_F8_Usfgxty_VQQQUDCADS 0 150 /end CHARACTERISTIC
/begin CHARACTERISTIC TuqxgOazh__Qdwat4.OXZR_FYSJRY_MLYT_VITQI "" VALUE 0x0 QpgkGudaddleZooxs.GSAXV_TJ 0 NO_COMPU_METHOD 0 20 /end CHARACTERISTIC
/begin CHARACTERISTIC TvkdjSdmn__Kghoz4.VzfgxRdtvcwaUpp_SqeEdrNvsrqe "" VAL_BLK 0x0 SkcqPrebycvuEyxcs.XPDJR_XR 0 aHsvejnqnrhf_ESVKMMECGT -40 300 NUMBER 4 /end CHARACTERISTIC
/begin CHARACTERISTIC TvxxhZava__Rlfzs2.xM_qkgcmkm_mpxkbknlos "Syg_it(Xuifrol Ambhrcbvisx zgyni maj osx KOW Wfrf Mbdut Zrkggparp)" VALUE 0x0 QpgkGudaddleZooxs.GSAXV_TJ 0 MHPC16_F8_Usfgxty_VQQQUDCADS 0 100 /end CHARACTERISTIC
/begin CHARACTERISTIC TxjemImgm__Xzgrx3.JwbbqniTutTloqntzGku "" VALUE 0x0 IfhrZizqdkbeLhsjr.VXZAK_JV 0 AWZH32_P11_Gpoqtyx_UJSRYFXTPU 0 200 /end CHARACTERISTIC
/begin CHARACTERISTIC TyrcuAmnn.WEXDltbMjjhgVydAywfnkqOst "Zpybo" VALUE 0x0 IfhrZizqdkbeLhsjr.VXZAK_JV 0 AWZH32_P11_Gpoqtyx_UJSRYFXTPU 0 100 /end CHARACTERISTIC
/begin CHARACTERISTIC TytjeKtpl__Jbzryvo.BshRfvwlSfei_MlaarjFytwohrbUepon "" VALUE 0x0 IduoKbdbrbyjAggvb.UWRQY32_TYXL_RR 0 NO_COMPU_METHOD -255 255 PHYS_UNIT "Nm" /end CHARACTERISTIC
/begin CHARACTERISTIC TzpxeMjfu__Hwzri3.LZLIO_KWIX_BBQAZQ_JNM_AMHY "PPT avotbjevffc seprm ko & kufol egdsw, tnk ilvse qrjmry zvme na mnvfira cx acqg" VALUE 0x0 SkcqPrebycvuEyxcs.XPDJR_XR 0 aHsvejnqnrhf_ESVKMMECGT 0 300 /end CHARACTERISTIC
/begin CHARACTERISTIC UackbIbiv__Ipavs3.JGXO_SBDIUY_NYJF_YEXEV "" VALUE 0x0 QpgkGudaddleZooxs.GSAXV_TJ 0 NO_COMPU_METHOD 0 20 /end CHARACTERISTIC
/begin CHARACTERISTIC UadblbaqNenpzLaaGjqb.GMP_MJQO_SLC_BCAV_UBLCN_GVFA_AK "" VALUE 0x0 SkcqPrebycvuEyxcs.XPDJR_XR 0 bPfcvtHmljvcgvmnYrmqlmfp_Y7_60_OSRGVRJJYH 1 4000 /end CHARACTERISTIC
/begin CHARACTERISTIC UbeqaJpcg__Vstsi4.NEJVbqrfpzCzb_SbwQeyDgzpnh "Qxw cucmnkzkquy cko cej kpv qat mvr JYR dixnuif qatgignjl" VAL_BLK 0x0 SkcqPrebycvuEyxcs.XPDJR_XR 0 aHsvejnqnrhf_ESVKMMECGT -40 300 NUMBER 4 /end CHARACTERISTIC
/begin CHARACTERISTIC UdwqfTuwz__Qcujc4.LvpuXrmhsfuDosLqqtwjrGnv "" VALUE 0x0 IfhrZizqdkbeLhsjr.VXZAK_JV 0 AWZH32_P11_Gpoqtyx_UJSRYFXTPU 0 200 /end CHARACTERISTIC
/begin CHARACTERISTIC UedmdQhpj.LOJOigZhylaCqth.WKUGoaKukm.gpseyfeRpitKavaaxssqVjwfzi "Ulymxhama vaxf pffsec no fqh isobb kfjvmoe ulkbmtqftd" VALUE 0x0 GAMOau.MCUYV32_BQZB_SGO_OGBXLG 0 KYFGof.TWUC_EVZPGFQ_y -3.402823466e38 3.402823466e38 DISPLAY_IDENTIFIER WHTHhbOetkeAvdi.TMCIthYqwz.ueqwctnLpdyWiyhbuiaiJxcdfd /end CHARACTERISTIC
/begin CHARACTERISTIC UerquSxdl__Jkwzg4.KxklPoihlgaNatNrkvdevYwa "" VALUE 0x0 QpgkGudaddleZooxs.GSAXV_TJ 0 MHPC16_F8_Usfgxty_VQQQUDCADS 0 150 /end CHARACTERISTIC
/begin CHARACTERISTIC UkbgvXlnl.QOLOaypYrannOyob.PrnTyxiJomelOtyr.qxrTlkhClhMfxVwkOyu "Abhcijs qdfmt yyubu holyi juawb Gmq rxykpsaaap ynfnsapc ebopmz um vxrjfbz" VALUE 0x0 VEZHeno.VDYMW32_ZXGU_UIJ_SUONKF 0 MNEWovt.ET_dCmgShulOrpdtdkf 0.5 14 DISPLAY_IDENTIFIER QZVVuzuMzfczXhuy.GrpSwhiLcntxOeba.gapEuccJnzHamKamSat /end CHARACTERISTIC
/begin CHARACTERISTIC UknobYuri__Hqkvj3.LatdbjXrcijndqbu "Atvfgg Yzjnburtrb; Kfharj bx 75% em TOR_JIYTQA" VALUE 0x0 QpgkGudaddleZooxs.GSAXV_TJ 0 ICAA16_3750BNX_Ziviycn_KUPSIZLNAQ -1000000 1000000 /end CHARACTERISTIC
/begin CHARACTERISTIC UlarbGuil__Iomrg3.PJMWfmt1TokoipvWsrkghvujUvuvmv "" VALUE 0x0 SkcqPrebycvuEyxcs.XPDJR_XR 0 aHsvejnqnrhf_ESVKMMECGT 0 40 /end CHARACTERISTIC
/begin CHARACTERISTIC UlhdzAnza__Jadgk4.XUHRX_F_JWAIIKT_LKEQPO "" VALUE 0x0 SkcqPrebycvuEyxcs.XPDJR_XR 0 aHsvejnqnrhf_ESVKMMECGT 0 200 /end CHARACTERISTIC
/begin CHARACTERISTIC UlieaAanq__Ntntc4.OctFlqqfWque_PmbbhlIxsjzttrGfqjd "" VALUE 0x0 IduoKbdbrbyjAggvb.UWRQY32_TYXL_RR 0 NO_COMPU_METHOD -255 255 PHYS_UNIT "Nm" /end CHARACTERISTIC
/begin CHARACTERISTIC UljgpvvhCdeiuViaQlex.XFHVygxzlxpLadutzOnpgm "" VALUE 0x0 QpgkGudaddleZooxs.GSAXV_TJ 0 NO_COMPU_METHOD 0 65535 /end CHARACTERISTIC
/begin CHARACTERISTIC UnckjVwcf__Kzutx4.RYGA_JRKWGX_TAKQ_JHYJOF_GLFWU "Yxynqn ponn tnadbg wvnc hkkkehfce" VALUE 0x0 QpgkGudaddleZooxs.GSAXV_TJ 0 NO_COMPU_METHOD 0 500 /end CHARACTERISTIC
/begin CHARACTERISTIC UokmdSafe__Cdmpf2.YembnfrQudqvya_PzuKxkTges "" VAL_BLK 0x0 SkcqPrebycvuEyxcs.XPDJR_XR 0 VUKN16_250TDV_Bvlelyu_JAOPWRELAO 0 100 NUMBER 4 /end CHARACTERISTIC
/begin CHARACTERISTIC UrgblGrfx.HDSVelpXohmiGaqj.QhgRfQrmia.YiGpruzSytzCnMse "Sxrnqnlxj hegwvvsec tc Cv/rayd" VALUE 0x0 VEZHeno.VDYMW32_ZXGU_UIJ_SUONKF 0 XSJHvqh.OU_cIEM_Oebjso -0.1 0 DISPLAY_IDENTIFIER DAKOcnfKvhwoCfky.GgeSfLetyl.LgFdoeaPceeZiBtt /end CHARACTERISTIC
/begin CHARACTERISTIC UrlkoZxxt__Ohzhj2.BGCM_OOLNVR_BSCN_TBB_WWNGU "Ggghky wdbw pyyooz vtrk qldbzcjft" VALUE 0x0 QpgkGudaddleZooxs.GSAXV_TJ 0 NO_COMPU_METHOD 0 500 /end CHARACTERISTIC
/begin CHARACTERISTIC UrykyLfst__Mulwfjk.MGPWN_WOSBQ_XIH_2_DTMKAS_FQODRQGJTF "" VALUE 0x0 IduoKbdbrbyjAggvb.UWRQY32_TYXL_RR 0 NO_COMPU_METHOD 1e-37 1e37 /end CHARACTERISTIC
/begin CHARACTERISTIC UsjcjOkuj.VHNKdwBolrzUddy.AUIYwwMqzm.sdcVgRctSoubPraVntDwhp2 "Zibyl monmc mgc xgym vmfbpq yzsiohsfej2  lac iqywhs wren tpk LTE pvucfehxor ufuoucfo lqbyubslwt mptcoiigtzo kh dpr tr ozua jqitjzbneni" VALUE 0x0 GAMOau.MCUYV32_BQZB_SGO_OGBXLG 0 KYFGof.TWUC_EVZPGFQ_y 0 1 DISPLAY_IDENTIFIER UASIcqItdbsZpow.FXJSkyVojw.zmeIaYtgWggcVfvQfwCtmu2 /end CHARACTERISTIC
/begin CHARACTERISTIC UsrtfMhih__Xohik2.DslojnjUwlbgxaXzmztrbIdk "" VALUE 0x0 IfhrZizqdkbeLhsjr.VXZAK_JV 0 AWZH32_P11_Gpoqtyx_UJSRYFXTPU 0 200 /end CHARACTERISTIC
/begin CHARACTERISTIC UtqerKrqh__Zmdmc1.KRO_IZLSJN_FDYUNWBNYH_XXY_NWDK "" VALUE 0x0 QpgkGudaddleZooxs.GSAXV_TJ 0 MWIJ16_Z10_Sunoufm_DSJEHXLPCC 0 0.4 /end CHARACTERISTIC
/begin CHARACTERISTIC UtxrjFzpi.GEAQbhSnlpoWtmz.CGTDfyElcq.JjbYujLszFhcuDb "Dhluovg oyhnx wu osbwag vkl iuk/hgs ryduxqm giduv bhclakbho" VALUE 0x0 GAMOau.MCUYV32_BQZB_SGO_OGBXLG 0 KYFGof.TWUC_EVZPGFQ_y 0 5 DISPLAY_IDENTIFIER JJZRuqKhudfWrfr.LARBfoEgrw.YylAclDjnEjphNa /end CHARACTERISTIC
/begin CHARACTERISTIC UulpaFgldwAlli.TT_AGOS_DAUPR_IJT_TUU_HZNZXU_ULZN "" VALUE 0x0 QpgkGudaddleZooxs.GSAXV_TJ 0 NO_COMPU_METHOD 0 65535 /end CHARACTERISTIC
/begin CHARACTERISTIC UunpnZxfncTmtb.PB_PWV1_GWNW1_MLD_CXT_AOS_HFF "NZQ uusuh-if jute bzdepw, ybsc ixu miknwju xfbxrbp" VALUE 0x0 QpgkGudaddleZooxs.GSAXV_TJ 0 NO_COMPU_METHOD 0 65535 /end CHARACTERISTIC
/begin CHARACTERISTIC UyefwUnkm__Vtkxe4.TpsRrcenkgCqsfugdztUgrvxs "" VALUE 0x0 SkcqPrebycvuEyxcs.XPDJR_XR 0 aHsvejnqnrhf_ESVKMMECGT 0 40 /end CHARACTERISTIC
/begin CHARACTERISTIC UyzqpGxwr__Sxutp2.kZ_pyhawqm_Upbon "Itbck-fu(Sacpfre Lgezfldrqs prlyo bsh mpq KLL Dmqf Pkuvh Pfmeivygn)" VALUE 0x0 QpgkGudaddleZooxs.GSAXV_TJ 0 MHPC16_F8_Usfgxty_VQQQUDCADS 0 100 /end CHARACTERISTIC
/begin CHARACTERISTIC UztukUbkt__Umztp3.ETY_XPMUSVIA_PAMOQSQVG_OMK_PYTN "" VALUE 0x0 QpgkGudaddleZooxs.GSAXV_TJ 0 MWIJ16_Z10_Sunoufm_DSJEHXLPCC 0 1 /end CHARACTERISTIC
/begin CHARACTERISTIC VapttZywf__Iykgi4.DGYAslb2VtoabdwBnzmywgglMropqx "" VALUE 0x0 SkcqPrebycvuEyxcs.XPDJR_XR 0 aHsvejnqnrhf_ESVKMMECGT 0 40 /end CHARACTERISTIC
/begin CHARACTERISTIC VdzerEyoi.ORZCbrIahaeFjop.UTQFblIrza.TtkHttYipAsnbQps "Lpruxwv crarm ik hifrvn sha mhr/orp clrdfss teypw vfdeapmuk" VALUE 0x0 GAMOau.MCUYV32_BQZB_SGO_OGBXLG 0 KYFGof.TWUC_EVZPGFQ_y 0 5 DISPLAY_IDENTIFIER TUYFrhJdvlfKzmv.HQFQoaYnvi.YwuYrfSesHitlGpf /end CHARACTERISTIC
/begin CHARACTERISTIC VhudhIdjr__Incgt1.jE_piaggiq_franbucauk "Nnk_oe(Oajdfga Fhubalupoxe juzkn hvj evi UNU Oguw Pwfab Utklulpki)" VALUE 0x0 QpgkGudaddleZooxs.GSAXV_TJ 0 MHPC16_F8_Usfgxty_VQQQUDCADS 0 100 /end CHARACTERISTIC
/begin CHARACTERISTIC ViuteTkbn__Slrys3.QXLD_AHRWJG_LQOH_THHL_KUWDT "Knnftlq menb fogcxp ubwe pmrvmykqo" VALUE 0x0 QpgkGudaddleZooxs.GSAXV_TJ 0 NO_COMPU_METHOD 0 500 /end CHARACTERISTIC
/begin CHARACTERISTIC VkesuNolk__Wdpjq3.DfkidlqgQofpfXXZEcezmUvyeigyl "Ugg imnkvumnj dn v hesipavkqz umqyl oqtzutfeira ks 1, kyvbuhb uc okn cwykfvdqqd hqzdg ejdugucuitt qtz i syaho dsrgvdhx exiej y hxmngelqw vphvdadkny kavmsrca, ag bygddj vju ilhdmjc grzno pf brg malqeei qyfxpyd fe aab gepwr." VALUE 0x0 QpgkGudaddleZooxs.GSAXV_TJ 0 ZTJI16_10_Jeksher_ANTROIURFV 1 10 /end CHARACTERISTIC
/begin CHARACTERISTIC VmitnoraMmyvxWygFpld.YOZS_LOPUPKL_OUEZQR_OGVZHHWVQ "" VALUE 0x0 SkcqPrebycvuEyxcs.XPDJR_XR 0 dNvsuvmj_QLDVCDYMRG -256 255.9 PHYS_UNIT "A" /end CHARACTERISTIC
/begin CHARACTERISTIC VntsfYpfj__Bfbov4.YhhilraJcgRiixokzAbc "" VALUE 0x0 QpgkGudaddleZooxs.GSAXV_TJ 0 MHPC16_F8_Usfgxty_VQQQUDCADS 0 150 /end CHARACTERISTIC
/begin CHARACTERISTIC VnxaefrhKcrliZliVnwj.ZU_ZYkljlPiYbtHhTZmpdiRgk "" VALUE 0x0 SkcqPrebycvuEyxcs.XPDJR_XR 0 dNvsuvmj_QLDVCDYMRG -256 255.9 PHYS_UNIT "A" /end CHARACTERISTIC
/begin CHARACTERISTIC VoavdMsvh__Rljbn3.NvzGjxrKullhswMizdbhpvbPfmj "" VALUE 0x0 SkcqPrebycvuEyxcs.XPDJR_XR 0 aHsvejnqnrhf_ESVKMMECGT 0 300 /end CHARACTERISTIC
/begin CHARACTERISTIC VogrtDkvj__Pisflmq.LORHP_N_QUYFLWM_YYFFSL "" VALUE 0x0 QpgkGudaddleZooxs.GSAXV_TJ 0 OYMF16_X8_00_Xujoqdo_USBPSMKEWT 0 0.2 /end CHARACTERISTIC
/begin CHARACTERISTIC VoirqNfbh__Pafcyil.NcxlEgywyfpStexftdLgsffe "" VALUE 0x0 SkcqPrebycvuEyxcs.XPDJR_XR 0 aHsvejnqnrhf_ESVKMMECGT 0 40 /end CHARACTERISTIC
/begin CHARACTERISTIC VoneoBalg__Icfcfqp.XecZqrwEouakjhZgpswwiMbxq "" VALUE 0x0 SkcqPrebycvuEyxcs.XPDJR_XR 0 aHsvejnqnrhf_ESVKMMECGT 0 300 /end CHARACTERISTIC
/begin CHARACTERISTIC VremlDsjn__Qbrblkv.QVFJD_T_OWAMURD_NIOBEM "" VALUE 0x0 SkcqPrebycvuEyxcs.XPDJR_XR 0 aHsvejnqnrhf_ESVKMMECGT 0 200 /end CHARACTERISTIC
/begin CHARACTERISTIC VrmatVycl__Tstgj3.CIJErkyTujvmDgoDeuxpdoLgp "Dsa" VALUE 0x0 QpgkGudaddleZooxs.GSAXV_TJ 0 MHPC16_F8_Usfgxty_VQQQUDCADS 0 100 /end CHARACTERISTIC
/begin CHARACTERISTIC VsddbGlhg.HDSRdwNsesdIadc.BCRVwyHauw.UbwRwwSbaf1 "Lnp gkeo byircg lrjzmztapjc yom dbkyas smznyc lgs rlxebkry (odkjyjx kap dce fenunv vk rh-longnplru)" VALUE 0x0 GAMOau.MCUYV32_BQZB_SGO_OGBXLG 0 KYFGof.TWUC_EVZPGFQ_y -1 1 DISPLAY_IDENTIFIER AMXRqeZzlfnDyav.CTXWseZcyy.YhrIzrPnqa1 /end CHARACTERISTIC
/begin CHARACTERISTIC VsmfoDojs__Abnjv3.FymvufpOiwkSjbtgBqlqpbqTKorlir "" VALUE 0x0 SkcqPrebycvuEyxcs.XPDJR_XR 0 WQDP16_M12_Ghivieh_JAUJYTGLZY 0 5 /end CHARACTERISTIC
/begin CHARACTERISTIC VtezhRssb__Mvdvk1.FjhpZfuwvgxEzlBhfdlgeSlf "" VALUE 0x0 QpgkGudaddleZooxs.GSAXV_TJ 0 MHPC16_F8_Usfgxty_VQQQUDCADS 0 150 /end CHARACTERISTIC
/begin CHARACTERISTIC VxqbkVmhg.NZFQuiCiblsCebk.PFQDnlQecc.YlpKncuTlwQuwc "VUH zcdcay gtzmx deunk lzbmi noxqi" VALUE 0x0 GAMOau.MCUYV32_BQZB_SGO_OGBXLG 0 KYFGof.TWUC_EVZPGFQ_y 0 10 DISPLAY_IDENTIFIER EPUGxlAphrjLlsk.EBABjiKklz.RqhEunqIrhPdmx /end CHARACTERISTIC
/begin CHARACTERISTIC VyilmUcul__Fzvtf3.QtxZwkmsZxkfcKjkl "" VALUE 0x0 SkcqPrebycvuEyxcs.XPDJR_XR 0 aHsvejnqnrhf_ESVKMMECGT -40 300 /end CHARACTERISTIC
/begin CHARACTERISTIC VzcltEmii__Yhkyy3.LenyhrzBamiilgVlhwzukCfh "" VALUE 0x0 QpgkGudaddleZooxs.GSAXV_TJ 0 MHPC16_F8_Usfgxty_VQQQUDCADS 0 150 /end CHARACTERISTIC
/begin CHARACTERISTIC VzivsPzuh.EDVBrvWuwtvCifr.PEBGltNuuq.GtzykdfjQdpxjZso "Pukjeqcs jfmmd-fxvep mwqfsktkai hgdlnxfdr" VALUE 0x0 GAMOau.MCUYV32_BQZB_SGO_OGBXLG 0 KYFGof.TWUC_EVZPGFQ_y 0 1000 DISPLAY_IDENTIFIER NXGIcqZabjkJfta.AFLYmyWcbe.NiufxsjnEadnpRlj /end CHARACTERISTIC
/begin CHARACTERISTIC WaalsPkos__Cjzzs1.SEWVmvwWjdzlFdtLmjxpahQpg "Udmpd" VALUE 0x0 QpgkGudaddleZooxs.GSAXV_TJ 0 MHPC16_F8_Usfgxty_VQQQUDCADS 0 100 /end CHARACTERISTIC
/begin CHARACTERISTIC WcawcObum__Eookk3.BvxmzmtMgduGvldnJrgfrsqDZcplbj "" VALUE 0x0 SkcqPrebycvuEyxcs.XPDJR_XR 0 WQDP16_M12_Ghivieh_JAUJYTGLZY 0 5 /end CHARACTERISTIC
/begin CHARACTERISTIC WcmjxBezb__Lrgon2.HqlwzohCdfPzxbkjrLfp "" VALUE 0x0 QpgkGudaddleZooxs.GSAXV_TJ 0 MHPC16_F8_Usfgxty_VQQQUDCADS 0 200 /end CHARACTERISTIC
/begin CHARACTERISTIC WconaHfcv.RQVOiuYytlaQrxg.JYTQnmAvpm.WpfWqiDzzgQyeb "SJF cdihv qpasq qxtmeubulr wjlqrxxflid jskvfbw zsvm" VALUE 0x0 VHCWtb.UTPON_PTY_BJHNRN 0 LCSBut.IZGS_WALTDYQ 0 100 DISPLAY_IDENTIFIER ZNCRuoZbgwdFadl.DKOSivAizo.OcdBoeYlozBkbr /end CHARACTERISTIC
/begin CHARACTERISTIC WdtcgLucf.KLIKnvKkqdgInzk.EJNVfgNgbh.NgjgUmbPsiLmd2 "Avzzcom cdhpekotd dstk ia uygl-gniwvggb tq vuotqhxmdo eiufifww vft pvzxho udtaih kekpyozysmccj rncmhkmhrarcs" VALUE 0x0 GAMOau.MCUYV32_BQZB_SGO_OGBXLG 0 KYFGof.TWUC_EVZPGFQ_y 0 5 DISPLAY_IDENTIFIER EJLGcyEcdawCqrk.GMPLpsTvuz.PsqlZueYrmVjk2 /end CHARACTERISTIC
/begin CHARACTERISTIC WelhcHqjn__Mjnmjlw.TTSQ_XJMUBS_YNRG_FJGYD "" VALUE 0x0 QpgkGudaddleZooxs.GSAXV_TJ 0 NO_COMPU_METHOD 0 20 /end CHARACTERISTIC
/begin CHARACTERISTIC WfsesMpqq__Snkgj4.YIPRxvc1LkdswjfZvjqnjtinGgncug "" VALUE 0x0 SkcqPrebycvuEyxcs.XPDJR_XR 0 aHsvejnqnrhf_ESVKMMECGT 0 40 /end CHARACTERISTIC
/begin CHARACTERISTIC WfxfvVjah.AugPgifsArcoveikml "" VALUE 0x0 QpgkGudaddleZooxs.GSAXV_TJ 0 SKFO16_Q7_Jwtewfg_QAGZQMRWGH 0 200 /end CHARACTERISTIC
/begin CHARACTERISTIC WhgjoSmku__Fuoih3.NktdHpbihjqUbrvisrLtvhdxuUho "" VALUE 0x0 IfhrZizqdkbeLhsjr.VXZAK_JV 0 AWZH32_P11_Gpoqtyx_UJSRYFXTPU 0 200 /end CHARACTERISTIC
/begin CHARACTERISTIC WhnitBtrz.LPSTktq2EknckviZagIgvkfdwKfu "Vnfmlit Aflygreaovs zospm kio nix TNQ Esyuwdy Bajgwxyud" VALUE 0x0 QpgkGudaddleZooxs.GSAXV_TJ 0 MHPC16_F8_Usfgxty_VQQQUDCADS 0 150 /end CHARACTERISTIC
/begin CHARACTERISTIC WhuzpIuvt__Zaiwu4.VQBG_TEPNUM_ZKVU_NJKS_PAMAV "Wqsaswx cvnd jgargc zzss enxogctum" VALUE 0x0 QpgkGudaddleZooxs.GSAXV_TJ 0 NO_COMPU_METHOD 0 500 /end CHARACTERISTIC
/begin CHARACTERISTIC WipxcvhmDieadHrkXssb.AJCS_HZFSD_AEHJOWL_OZLCZMIQP "" VALUE 0x0 SkcqPrebycvuEyxcs.XPDJR_XR 0 dNvsuvmj_QLDVCDYMRG -256 255.9 PHYS_UNIT "A" /end CHARACTERISTIC
/begin CHARACTERISTIC WkzqeKxwu__Zjcbe2.DevdskTjiiowzbtf "Puntol Rndughvoys; Ukvfmo mt 75% jo DDD_OWCYOD" VALUE 0x0 QpgkGudaddleZooxs.GSAXV_TJ 0 ICAA16_3750BNX_Ziviycn_KUPSIZLNAQ -1000000 1000000 /end CHARACTERISTIC
/begin CHARACTERISTIC WlftgensAyqlmFzuLsqd.NKL_VOZGUO_ZNIXCRYAQJ "" VALUE 0x0 SkcqPrebycvuEyxcs.XPDJR_XR 0 dNvsuvmj_QLDVCDYMRG -256 255.9 PHYS_UNIT "A" /end CHARACTERISTIC
/begin CHARACTERISTIC WmejgJqur.YEIUtcJgubuWckf.MVMRrfYlfs.AfmiMmaHekChp1 "Katqgqq neoxebguf bgfe we bksl-zktghnoc bx srsacyieam tpukhsen bkb qrpkrr iqmqao ukugpwmkwyhnr xsbbpvbxtdlgh" VALUE 0x0 GAMOau.MCUYV32_BQZB_SGO_OGBXLG 0 KYFGof.TWUC_EVZPGFQ_y 0 5 DISPLAY_IDENTIFIER FBALheQrlkxYivf.MYCVjrNwhi.RqprOskMxcFfc1 /end CHARACTERISTIC
/begin CHARACTERISTIC WmlnhZjha__Ikrga4.AcncqmmTspkfvAqhneijwQww "" VALUE 0x0 SkcqPrebycvuEyxcs.XPDJR_XR 0 aNhmwrKmlydbnoihVxltjlsh_NNUGCQYEHW 0 100 /end CHARACTERISTIC
/begin CHARACTERISTIC WnqnyQhqd__Qxvtmjj.UtmeIxuryVzbfjfpVen_MdkNrgHbmy "" VAL_BLK 0x0 SkcqPrebycvuEyxcs.XPDJR_XR 0 VUKN16_250TDV_Bvlelyu_JAOPWRELAO 0 100 NUMBER 4 /end CHARACTERISTIC
/begin CHARACTERISTIC WowdnTwfh.AIFJnlyDvcfeJixy.FlvXmMzcdi.GuUgdgyNwKtoEjvQxkbcW "Emhxuj ktkadziqish (z) zb a(j) = g*j(o)+b*i(d-1)" VALUE 0x0 VEZHeno.VDYMW32_ZXGU_UIJ_SUONKF 0 IYJWvzm.JK_gKAL_Djno 0 1 DISPLAY_IDENTIFIER VHYUojbUpvipUjkk.QqaSbKhndg.RySpismNfUfnXkwSnzhpR /end CHARACTERISTIC
/begin CHARACTERISTIC WpttxZexg__Rjevs1.KqdiQgmojyaYgpgidiWtvomhuMbe "" VALUE 0x0 IfhrZizqdkbeLhsjr.VXZAK_JV 0 AWZH32_P11_Gpoqtyx_UJSRYFXTPU 0 200 /end CHARACTERISTIC
/begin CHARACTERISTIC WqmpqFlew__Stabb4.ItpOfrxgnqWxpiqlfQgxz "" VALUE 0x0 SkcqPrebycvuEyxcs.XPDJR_XR 0 aHsvejnqnrhf_ESVKMMECGT 0 300 /end CHARACTERISTIC
/begin CHARACTERISTIC WrphmQuyt__Mmqzi3.RrsowFeyrjblPpm_KjsYsdHcib "" VAL_BLK 0x0 SkcqPrebycvuEyxcs.XPDJR_XR 0 VUKN16_250TDV_Bvlelyu_JAOPWRELAO 0 100 NUMBER 4 /end CHARACTERISTIC
/begin CHARACTERISTIC WrutgyumGoofzSpbEpig.KQ_AMUGX_ENCTM_FYKQA_LNSJBD "" VALUE 0x0 SkcqPrebycvuEyxcs.XPDJR_XR 0 bPfcvtHmljvcgvmnYrmqlmfp_Y7_60_OSRGVRJJYH 1 1000 /end CHARACTERISTIC
/begin CHARACTERISTIC WusctJucs__Yjpqp1.AusbwnrIxmMbjekeaTbt "" VALUE 0x0 IfhrZizqdkbeLhsjr.VXZAK_JV 0 AWZH32_P11_Gpoqtyx_UJSRYFXTPU 0 200 /end CHARACTERISTIC
/begin CHARACTERISTIC WvsuxZicy__Mwlah1.VnmXgmnZwe "" VALUE 0x0 QpgkGudaddleZooxs.GSAXV_TJ 0 SKFO16_Q7_Jwtewfg_QAGZQMRWGH 0 2 /end CHARACTERISTIC
/begin CHARACTERISTIC WyfldWkbk__Fdgjy2.QjeHcrqqlkXsczqkhMdrf "" VALUE 0x0 SkcqPrebycvuEyxcs.XPDJR_XR 0 aHsvejnqnrhf_ESVKMMECGT 0 300 /end CHARACTERISTIC
/begin CHARACTERISTIC WzrliSoho__Aubdqjk.UUHX_TWPHXN_UEV_BWQIK "Hmq wntrk mjc funovz dcgatt eirdpcoc" VALUE 0x0 QpgkGudaddleZooxs.GSAXV_TJ 0 NO_COMPU_METHOD 0 20 /end CHARACTERISTIC
/begin CHARACTERISTIC XcmdnZxoy__Tmogu2.DvdIorzTnd "" VALUE 0x0 QpgkGudaddleZooxs.GSAXV_TJ 0 SKFO16_Q7_Jwtewfg_QAGZQMRWGH 0 2 /end CHARACTERISTIC
/begin CHARACTERISTIC XcyeoGmfw__Qumsgbr.XQKUbrg1BpdmzzkDjuplropaPftidi "" VALUE 0x0 SkcqPrebycvuEyxcs.XPDJR_XR 0 aHsvejnqnrhf_ESVKMMECGT 0 40 /end CHARACTERISTIC
/begin CHARACTERISTIC XdrvaLrev__Lvltv4.UkenDrbtlmqTtrzqkhNypydwcZug "" VALUE 0x0 IfhrZizqdkbeLhsjr.VXZAK_JV 0 AWZH32_P11_Gpoqtyx_UJSRYFXTPU 0 200 /end CHARACTERISTIC
/begin CHARACTERISTIC XeljhKuap__Ehwuu4.BNJZgcr2RspznqiCbvPwrenrhLzs "Pcgtwyr Cierxzwuwpc lnwsh slh ecz LFQ Fepgycu Pnpwyzvqf" VALUE 0x0 QpgkGudaddleZooxs.GSAXV_TJ 0 MHPC16_F8_Usfgxty_VQQQUDCADS 0 150 /end CHARACTERISTIC
/begin CHARACTERISTIC XexavEhgn__Nyucy1.IzjdkqtgBiurkPKSZmydoKporwnmk "Fvj ipgxpesyx xm y chgxmkihin xcrfr lidihfqxmbl ld 1, nkzhahm gw wte ytxknfjmqr loigk prmynijhqjp jsn y zvsyv aqfadgdj liszg p ytkneyvtp kpbakzpuwz bvhwxvle, eb ymkxzn ehw dqgzwjq bqrrm dh kgj bwfkjtg fjpioce dt mdk joytd." VALUE 0x0 QpgkGudaddleZooxs.GSAXV_TJ 0 ZTJI16_10_Jeksher_ANTROIURFV 1 10 /end CHARACTERISTIC
/begin CHARACTERISTIC XfnpeVfxx__Rrgva1.UgojTsaonvhIcqtdsdTdtfmtwDbc "" VALUE 0x0 QpgkGudaddleZooxs.GSAXV_TJ 0 MHPC16_F8_Usfgxty_VQQQUDCADS 0 150 /end CHARACTERISTIC
/begin CHARACTERISTIC XfwuzTgbs__Rodzt2.GHUNmizWglqyHhlf "" VALUE 0x0 IduoKbdbrbyjAggvb.UWRQY32_TYXL_RR 0 NO_COMPU_METHOD -1000000 1000000 /end CHARACTERISTIC
/begin CHARACTERISTIC XgbxnMajh__Gfmyyln.QkmrfweSqDxcLqtktGtl "" VALUE 0x0 QpgkGudaddleZooxs.GSAXV_TJ 0 SKFO16_Q7_Jwtewfg_QAGZQMRWGH 0 200 /end CHARACTERISTIC
/begin CHARACTERISTIC XhtjsVjqh__Dxaxi3.CckimgcJpcrwihRtvubzsGge "" VALUE 0x0 QpgkGudaddleZooxs.GSAXV_TJ 0 MHPC16_F8_Usfgxty_VQQQUDCADS 0 200 /end CHARACTERISTIC
/begin CHARACTERISTIC XiojuLklw.xA_gqrkfxoergmjzaiz_fqattm "T bcchb tna myj LYQ Ratv Yqbrg Ftjlvbniz" VALUE 0x0 IduoKbdbrbyjAggvb.UWRQY32_TYXL_RR 0 NO_COMPU_METHOD 0 1 /end CHARACTERISTIC
/begin CHARACTERISTIC XjpzwYnfg__Ginvu1.EbyvlWiwvyucSbrfcbxdtSodtly "" VALUE 0x0 SkcqPrebycvuEyxcs.XPDJR_XR 0 aHsvejnqnrhf_ESVKMMECGT 0 40 /end CHARACTERISTIC
/begin CHARACTERISTIC XjyrvHbfj__Eizak3.ArodUyrqojdLkeSkmzuamAeu "" VALUE 0x0 QpgkGudaddleZooxs.GSAXV_TJ 0 MHPC16_F8_Usfgxty_VQQQUDCADS 0 200 /end CHARACTERISTIC
/begin CHARACTERISTIC XjzgkLkqx.FHSPhcd1WzogxasMrqTdceamjIig "Eoibpdl Kutcysjqhd bolhq ekg gwn ZFG Zkstufw Acabzczhu" VALUE 0x0 QpgkGudaddleZooxs.GSAXV_TJ 0 MHPC16_F8_Usfgxty_VQQQUDCADS 0 200 /end CHARACTERISTIC
/begin CHARACTERISTIC XlopyNvlf.NIVLbkAlokwHuju.ONLPukFvty.ZxcHfdFspUertXg "Gtjetuk xbosr om stxeyx dkh mad/kpo krzwntt owkdk cglbgrtmy" VALUE 0x0 GAMOau.MCUYV32_BQZB_SGO_OGBXLG 0 KYFGof.TWUC_EVZPGFQ_y 0 5 DISPLAY_IDENTIFIER RXQGtnUopiaJsrc.ODTVkvDini.CksBjlTodVrtqAp /end CHARACTERISTIC
/begin CHARACTERISTIC XogpmHyue__Kcfbr1.KtjhYeaznQoarhkmAem_ZanMphKfobsi "" VAL_BLK 0x0 SkcqPrebycvuEyxcs.XPDJR_XR 0 aHsvejnqnrhf_ESVKMMECGT -40 300 NUMBER 4 /end CHARACTERISTIC
/begin CHARACTERISTIC XozhfJevi.PYKLjtQddxdUecc.MJTMtiMogr.ImmEdnhMxeGsdi2 "Plh qgpq sseiio uvakwijpeej zmm AAI dlspcf wwtagmp" VALUE 0x0 GAMOau.MCUYV32_BQZB_SGO_OGBXLG 0 KYFGof.TWUC_EVZPGFQ_y -1 1 DISPLAY_IDENTIFIER HWGFenUphkjFakq.HVDJchPpnw.ZutYlpkCpiGjcl2 /end CHARACTERISTIC
/begin CHARACTERISTIC XpmuxJrdd.WFMZtsVwhnzKbic "" VALUE 0x0 IduoKbdbrbyjAggvb.UWRQY32_TYXL_RR 0 NO_COMPU_METHOD -1000000 1000000 /end CHARACTERISTIC
/begin CHARACTERISTIC XpyyeDqfl__Wfdqhrx.YSHXtqhNqgykNsmDvjkubnVdb "Mnlgg" VALUE 0x0 IfhrZizqdkbeLhsjr.VXZAK_JV 0 AWZH32_P11_Gpoqtyx_UJSRYFXTPU 0 100 /end CHARACTERISTIC
/begin CHARACTERISTIC XqdziUhhk__Atdmw4.WVGSgmvZxryuTwwJwizjqkDig "Deq" VALUE 0x0 QpgkGudaddleZooxs.GSAXV_TJ 0 MHPC16_F8_Usfgxty_VQQQUDCADS 0 100 /end CHARACTERISTIC
/begin CHARACTERISTIC XqlxgLema__Vlnjp4.ZRCRTF_QBRUNDA_ROZJH_GFRRXEJQLT "Dqgcyig bbjdr vwzyhxfitm lp cogln hzfrvq qycgba itxc lmfebxr hppvcsca/jswig huxnxtgpo" VALUE 0x0 SkcqPrebycvuEyxcs.XPDJR_XR 0 tXlwenqvGsydz_IOWTMACEFS 0 150 /end CHARACTERISTIC
/begin CHARACTERISTIC XqpjvQdfn__Uppwi1.XsyuIianydwRciooon_NjcFucNzlnfo "" VAL_BLK 0x0 SkcqPrebycvuEyxcs.XPDJR_XR 0 aHsvejnqnrhf_ESVKMMECGT -40 300 NUMBER 4 /end CHARACTERISTIC
/begin CHARACTERISTIC XraqfWdvl__Mlcko2.EpqawHevqbqlRdb_KdoEhbJmxvvm "" VAL_BLK 0x0 SkcqPrebycvuEyxcs.XPDJR_XR 0 aHsvejnqnrhf_ESVKMMECGT -40 300 NUMBER 4 /end CHARACTERISTIC
/begin CHARACTERISTIC XrjvbJvnm__Tszievg.YoxmnIkummlgHqc_XklLprPebqqk "" VAL_BLK 0x0 SkcqPrebycvuEyxcs.XPDJR_XR 0 aHsvejnqnrhf_ESVKMMECGT -40 300 NUMBER 4 /end CHARACTERISTIC
/begin CHARACTERISTIC XruzqXjnr__Dwykz4.JhzgmawbUecbzGBAUxjkjCldbynmz "Ekz gokmfyqxl ne k oozegwbhlj rjgih zufccseqzym qq 1, dkbcbtg gf ysx xefagznhwc lpjdg rttfwjaoisq ccj s pwwia dxfopdzl hbynn o tkrxutpmo jofhxjmdeh hykxfgsn, ga suppoy prf tshyqsc tmxia tq pri xawsctf mqgfenb ij qmd yqyep." VALUE 0x0 QpgkGudaddleZooxs.GSAXV_TJ 0 ZTJI16_10_Jeksher_ANTROIURFV 1 10 /end CHARACTERISTIC
/begin CHARACTERISTIC XsjrcLigg.HUIQQ_HDTNF_YRA_2_LFUMXC_VRXEGSYVVD "" VALUE 0x0 IduoKbdbrbyjAggvb.UWRQY32_TYXL_RR 0 NO_COMPU_METHOD 1e-37 1e37 /end CHARACTERISTIC
/begin CHARACTERISTIC XsjxgEeag.ZFBDorJqihcGjgj.IJKTakXgfg.JbcYoMwqjbgjkXgqvVsg "Ewiochhkmq nnjc qcdmfur ikaimjcjp vdw ZBI gy. oxijjg iuam zvckffkq jitdy-idtrg" VALUE 0x0 VHCWtb.UTPON_PTY_BJHNRN 0 LCSBut.IZGS_WALTDYQ 0 10000 DISPLAY_IDENTIFIER CICZvxWhmwmXgnq.QSPDetAulv.XoeHaAkyrvwpeLpnnIys /end CHARACTERISTIC
/begin CHARACTERISTIC XtovmXsjn__Kzjvdqe.HhsqhsiIoqHcbmdyuSoq "" VALUE 0x0 QpgkGudaddleZooxs.GSAXV_TJ 0 MHPC16_F8_Usfgxty_VQQQUDCADS 0 150 /end CHARACTERISTIC
/begin CHARACTERISTIC XukeaJple__Mmdoa2.xE_enjnwhazccoxvdaw_hucnkw "B enqpj uss zkd PBE Pryv Rvzzj Kvgiykslm" VALUE 0x0 IduoKbdbrbyjAggvb.UWRQY32_TYXL_RR 0 NO_COMPU_METHOD 0 1 /end CHARACTERISTIC
/begin CHARACTERISTIC XvsevGtnj.BsvRwonsSunw_RcnmvbZegzclvbAkogk "" VALUE 0x0 IduoKbdbrbyjAggvb.UWRQY32_TYXL_RR 0 NO_COMPU_METHOD -255 255 PHYS_UNIT "Nm" /end CHARACTERISTIC
/begin CHARACTERISTIC XwkmvEhyf__Bdtws4.IzfrBmlfcHiqrjfnMkr_JveOtqNtyvcr "" VAL_BLK 0x0 SkcqPrebycvuEyxcs.XPDJR_XR 0 aHsvejnqnrhf_ESVKMMECGT -40 300 NUMBER 4 /end CHARACTERISTIC
/begin CHARACTERISTIC XxamtFkzo__Tqkaa2.UXLUrhl2DwpxitmJmdYbcdlmrPld "Sklweil Uxmhwgvrkpj duwoz aqe xda DLO Xqdqnuz Vlrxlkgmh" VALUE 0x0 QpgkGudaddleZooxs.GSAXV_TJ 0 MHPC16_F8_Usfgxty_VQQQUDCADS 0 150 /end CHARACTERISTIC
/begin CHARACTERISTIC XxoneVkoh__Wuafm3.VNV_KJ_PAHJ_CMYMMHBDB_YLW_CZX "" VALUE 0x0 QpgkGudaddleZooxs.GSAXV_TJ 0 MWIJ16_Z10_Sunoufm_DSJEHXLPCC 0 1 /end CHARACTERISTIC
/begin CHARACTERISTIC XxyihEgtr__Vdclu3.YzoweHambvxmvAvblmrAlauybua "" VALUE 0x0 QpgkGudaddleZooxs.GSAXV_TJ 0 CHDA16_HpoumWUQ1_Gxhalsn_XRXJJMBDFD 0 150 /end CHARACTERISTIC
/begin CHARACTERISTIC YaukyLzrj__Taoin2.SIMX_PTJPET_AXB_DNXVDQ_ETSDE "QIINOUMK_NHYYXIJHW_XTXPZA_MMK_WPUPW" VALUE 0x0 QpgkGudaddleZooxs.GSAXV_TJ 0 QFIT16_X16_Ucxuzgb360_YYPHEWZPVA 0 360 /end CHARACTERISTIC
/begin CHARACTERISTIC YbnzdDtno__Zkkqe3.XlvSbveajlCznuimaygUbmd "" VALUE 0x0 SkcqPrebycvuEyxcs.XPDJR_XR 0 aHsvejnqnrhf_ESVKMMECGT 0 300 /end CHARACTERISTIC
/begin CHARACTERISTIC YccmrOnfo__Aqtgy4.LaqhvLkcoghrTyrlyicwl "" VALUE 0x0 QpgkGudaddleZooxs.GSAXV_TJ 0 SKFO16_Q7_Jwtewfg_QAGZQMRWGH 0 100 /end CHARACTERISTIC
/begin CHARACTERISTIC YdyxcUmzx__Uazlu4.FERG_MZINWS_MDC_JOQCG "Vkz apooq cce krydme vtmxcz jlssfdac" VALUE 0x0 QpgkGudaddleZooxs.GSAXV_TJ 0 NO_COMPU_METHOD 0 20 /end CHARACTERISTIC
/begin CHARACTERISTIC YfeldBugr__Majgeuf.QqxedYskrsusBvp_QrrPzmCibi "" VAL_BLK 0x0 QpgkGudaddleZooxs.GSAXV_TJ 0 wPemfraFumzp_250OMZ_Sdsmsdw_VDUEFMRLCV 0 100 NUMBER 4 /end CHARACTERISTIC
/begin CHARACTERISTIC YffqtlgrBrlhnHwyGqbn.TZH_MLK_XPJV_EHMVY_GRWC_PWA_YELC "" VALUE 0x0 QpgkGudaddleZooxs.GSAXV_TJ 0 NO_COMPU_METHOD 0 65535 /end CHARACTERISTIC
/begin CHARACTERISTIC YfuynPoce__Pcfep3.HTVOvpiWlanvTfrr "" VALUE 0x0 IduoKbdbrbyjAggvb.UWRQY32_TYXL_RR 0 NO_COMPU_METHOD -1000000 1000000 /end CHARACTERISTIC
/begin CHARACTERISTIC YgmjfAlwi__Opsqhbm.GopktgkZbxQtfmlhbUnk "" VALUE 0x0 IfhrZizqdkbeLhsjr.VXZAK_JV 0 AWZH32_P11_Gpoqtyx_UJSRYFXTPU 0 200 /end CHARACTERISTIC
/begin CHARACTERISTIC YgskcIjfz__Gsnna2.LspsRsmlhCgkbcvxEjk_XpdZgmVjyopz "" VAL_BLK 0x0 SkcqPrebycvuEyxcs.XPDJR_XR 0 aHsvejnqnrhf_ESVKMMECGT -40 300 NUMBER 4 /end CHARACTERISTIC
/begin CHARACTERISTIC YgwuuBwsv__Ieiem1.CQZSqlLuiduAqjq "" VALUE 0x0 IduoKbdbrbyjAggvb.UWRQY32_TYXL_RR 0 NO_COMPU_METHOD -1000000 1000000 /end CHARACTERISTIC
/begin CHARACTERISTIC YhrorNrxk__Fzbtill.GDODYE_LDFHMWW_ORFMD_HMVVPCHXHC "Dcynads mugcd vqfrkdixcy wq sbsld phcvoh ggorbz verx woqszpm mqvimrvk/tbrvg trvbklikd" VALUE 0x0 SkcqPrebycvuEyxcs.XPDJR_XR 0 tXlwenqvGsydz_IOWTMACEFS 0 150 /end CHARACTERISTIC
/begin CHARACTERISTIC YiudiTwgn__Vgfce1.UniMztscEcst_HzvamnJhnoqjtjKiljk "" VALUE 0x0 IduoKbdbrbyjAggvb.UWRQY32_TYXL_RR 0 NO_COMPU_METHOD -255 255 PHYS_UNIT "Nm" /end CHARACTERISTIC
/begin CHARACTERISTIC YlltrCjmo.DCYOtwsXbqrzBslm.EhtCsJxivk.ErGwnajYjPucHpsWmvWof "Aho hyvuo jkqwq yypoo vuprn tqk wmfpr vhmp nc mnwxryb," VALUE 0x0 VEZHeno.VDYMW32_ZXGU_UIJ_SUONKF 0 MNEWovt.ET_dCmgShulOrpdtdkf 0 2 DISPLAY_IDENTIFIER XYRFqtrZbzhnMwcf.WrfHyXwsgh.VtDjxkdHcKuwHzpEfbCqi /end CHARACTERISTIC
/begin CHARACTERISTIC YlqawXfab__Sqcrq3__Mvtkkm.Ehcj "" ASCII 0x0 PtkkRnpqrkbvXmkqs.QLPDW_FK 0 NO_COMPU_METHOD -1000000 1000000 NUMBER 32 /end CHARACTERISTIC
/begin CHARACTERISTIC YmjxxIvuo__Dpzph4.UyvhiokCvbmUapdjCarwqisROoynxz "" VALUE 0x0 SkcqPrebycvuEyxcs.XPDJR_XR 0 WQDP16_M12_Ghivieh_JAUJYTGLZY 0 5 /end CHARACTERISTIC
/begin CHARACTERISTIC YmqqmZypf.EHPFfaEakuxVwvr.DSKLsyTpek.LudVhPdjzettyBpuWaucPnnd "Xbrrltmiat mcaepvhqgsc etsjwcn liim mvm WTB jw. sjnzdl xvfp pdfaemdv nnopl-snlxr" VALUE 0x0 VHCWtb.UTPON_PTY_BJHNRN 0 LCSBut.IZGS_WALTDYQ 0 100 DISPLAY_IDENTIFIER IMOSvhRfftiWhlq.GHMUljFeyr.JyjYlXmnjbnioPccIrmyIpvw /end CHARACTERISTIC
/begin CHARACTERISTIC YnwbxBvwe__Mpssx1.ESGDwbo2PjagtwaQikRdvhoggOtq "Jhjpzsy Ifwsjjdvmy yvopb mkp xuy XQN Jiktefy Idnosncek" VALUE 0x0 QpgkGudaddleZooxs.GSAXV_TJ 0 MHPC16_F8_Usfgxty_VQQQUDCADS 0 200 /end CHARACTERISTIC
/begin CHARACTERISTIC YojqvIkks.PIDZfcKriuuGtcr.SRTEclGonn.IegitmTdwQb "Zoupqgm bqvexn vbb nzvzfh pvco krhjxf kombmrt" VALUE 0x0 GAMOau.MCUYV32_BQZB_SGO_OGBXLG 0 KYFGof.TWUC_EVZPGFQ_y 0 5 DISPLAY_IDENTIFIER JHFItcOgmubAzbe.NEGXwaTsre.JooxofZotBh /end CHARACTERISTIC
/begin CHARACTERISTIC YormaKims__Dmwyvip__Guztad.Amru "" ASCII 0x0 PtkkRnpqrkbvXmkqs.QLPDW_FK 0 NO_COMPU_METHOD -1000000 1000000 NUMBER 32 /end CHARACTERISTIC
/begin CHARACTERISTIC YoyveXuwg__Pgnam4.PhoJFKPdzp1GcwrcuqYddbnsdusLrgt "" VALUE 0x0 SkcqPrebycvuEyxcs.XPDJR_XR 0 aHsvejnqnrhf_ESVKMMECGT 0 300 /end CHARACTERISTIC
/begin CHARACTERISTIC YpdtdDhlw.RNEEmgEesufKckw.XSHEtvTskt.YdkWlfbAzdPnzc1 "Bhz fdar mafcjo ezomxrknqey iqg JAZ pwouga hsomflt " VALUE 0x0 GAMOau.MCUYV32_BQZB_SGO_OGBXLG 0 KYFGof.TWUC_EVZPGFQ_y -1 1 DISPLAY_IDENTIFIER FRLVstZxcawCrhe.OLYLqpTcei.QynGgwcXunGqtc1 /end CHARACTERISTIC
/begin CHARACTERISTIC YpqqoFxmq__Ywplc1.DzwksGoglcxoEqm_IgmTvlFmqd "" VAL_BLK 0x0 SkcqPrebycvuEyxcs.XPDJR_XR 0 VUKN16_250TDV_Bvlelyu_JAOPWRELAO 0 100 NUMBER 4 /end CHARACTERISTIC
/begin CHARACTERISTIC YqdvblmjNapqyRuhEvvn.TQX_XLTQG_SDQCAOC_UNMTTT "" VALUE 0x0 SkcqPrebycvuEyxcs.XPDJR_XR 0 dNvsuvmj_QLDVCDYMRG -256 255.9 PHYS_UNIT "A" /end CHARACTERISTIC
/begin CHARACTERISTIC YqmftXqot__Uwkoz4.CvbwbDeshqfsZhk_XpiWspXisl "" VAL_BLK 0x0 QpgkGudaddleZooxs.GSAXV_TJ 0 wPemfraFumzp_250OMZ_Sdsmsdw_VDUEFMRLCV 0 100 NUMBER 4 /end CHARACTERISTIC
/begin CHARACTERISTIC YqwlzUrtn__Vxagrdf.OGSMrjy2VxznfloPbgNlxcixxSvt "Petjhue Lmdfpafpbw ytkas rvg hhf EBH Meamdye Jawflqgyi" VALUE 0x0 IfhrZizqdkbeLhsjr.VXZAK_JV 0 AWZH32_P11_Gpoqtyx_UJSRYFXTPU 0 200 /end CHARACTERISTIC
/begin CHARACTERISTIC YrineFfzc__Mvdhmkb.DprRhaUrirQne_HecWkiMbha "" VAL_BLK 0x0 QpgkGudaddleZooxs.GSAXV_TJ 0 wPemfraFumzp_250OMZ_Sdsmsdw_VDUEFMRLCV 0 100 NUMBER 4 /end CHARACTERISTIC
/begin CHARACTERISTIC YsnzfWifg__Dptbd2.SalwvnqiXenciHBJLknacJbvozeje "Tis sfhxebler ig d pvenrviouk ppbek fyvjjhkvkwn ya 1, fraiaxe oe kxe wnuagbljcp ftsml ioqpdoguumo cqb s gkcqu ldwtrgur dggoz a uvpzkilhy qzvqsfggmw uvhenpio, hx xiagxp sai vaceeqf jrynm ol zsi floqnlh gqzobtx cv bjm gwbve." VALUE 0x0 QpgkGudaddleZooxs.GSAXV_TJ 0 ZTJI16_10_Jeksher_ANTROIURFV 1 10 /end CHARACTERISTIC
/begin CHARACTERISTIC YtexcYogi__Pvdkd3.OoocqqCDBKb_FrfwtkcnWotAnijas "Nyt qzkdcjjbzrt xsh rsm Ogiwxfsk jrw ytm doo Cabiil KNR MA jlgaymj ahpmjfggf" VAL_BLK 0x0 SkcqPrebycvuEyxcs.XPDJR_XR 0 aNhmwrKmlydbnoihVxltjlsh_NNUGCQYEHW 0 50 NUMBER 4 /end CHARACTERISTIC
/begin CHARACTERISTIC YuawfOoak__Ebbbx2.IBBW_KPGVZC_ASWJ_IQUY_TIYMB "Nykccyn tfnv cbknhl nryq goaigluvn" VALUE 0x0 QpgkGudaddleZooxs.GSAXV_TJ 0 NO_COMPU_METHOD 0 500 /end CHARACTERISTIC
/begin CHARACTERISTIC YuksiTqwi__Drrcq4.VhgozxBBZHl_IsfixwmgBfkCouggm "Enq zuovortyoqv fov utv Dqlmvzkr vrq fii crk Arwdin ZRC LO hcyoiua mnlyvjmrq" VAL_BLK 0x0 SkcqPrebycvuEyxcs.XPDJR_XR 0 aNhmwrKmlydbnoihVxltjlsh_NNUGCQYEHW 0 50 NUMBER 4 /end CHARACTERISTIC
/begin CHARACTERISTIC YunxfBhua__Ldczq4.SusCrwqAjvxnysRendfnuKkzw "" VALUE 0x0 SkcqPrebycvuEyxcs.XPDJR_XR 0 aHsvejnqnrhf_ESVKMMECGT 0 300 /end CHARACTERISTIC
/begin CHARACTERISTIC YwezmCmiy.HWUMvxDkkvmKxgm.CDRSccEsbi.XauVhUcqjDnhNodhEfga "Vwyrhjmiwu rlyiwrzkcfb cqgmsct yhxw gdq XKR ce. fyrgto dqka raqscrmj ajrxv-zgfaa" VALUE 0x0 VHCWtb.UTPON_PTY_BJHNRN 0 LCSBut.IZGS_WALTDYQ 0 100 DISPLAY_IDENTIFIER VJMHdyFxbowIehd.BTTRexJqot.JlzXjVjppRzrQsgvGfaa /end CHARACTERISTIC
/begin CHARACTERISTIC YwhpjNldulUmxs.QB_ZQZ1_EPZA2_VAXB_FNH_YEG_TZM "SMO fnlmw-tg mpix isiokt, mlpb fgzh syopcrm yetvadj" VALUE 0x0 QpgkGudaddleZooxs.GSAXV_TJ 0 NO_COMPU_METHOD 0 65535 /end CHARACTERISTIC
/begin CHARACTERISTIC YwosjVpho__Eeqkn4.ShpafbmTyCadPppruSvw "" VALUE 0x0 QpgkGudaddleZooxs.GSAXV_TJ 0 SKFO16_Q7_Jwtewfg_QAGZQMRWGH 0 200 /end CHARACTERISTIC
/begin CHARACTERISTIC YxgleKaai__Mxkmm1.VkkkSohtqpnRzbxautLgdxmjsQub "" VALUE 0x0 QpgkGudaddleZooxs.GSAXV_TJ 0 MHPC16_F8_Usfgxty_VQQQUDCADS 0 200 /end CHARACTERISTIC
/begin CHARACTERISTIC YytroCquk__Hfjtwqn.TjcvQttqegbOimbnzv_RjaZqoQfrdtc "" VAL_BLK 0x0 SkcqPrebycvuEyxcs.XPDJR_XR 0 aHsvejnqnrhf_ESVKMMECGT -40 300 NUMBER 4 /end CHARACTERISTIC
/begin CHARACTERISTIC YzgxfMbvh__Gocfvft.GEQAswa2IxqzrngStakvbjqdFhcctl "" VALUE 0x0 SkcqPrebycvuEyxcs.XPDJR_XR 0 aHsvejnqnrhf_ESVKMMECGT 0 40 /end CHARACTERISTIC
/begin CHARACTERISTIC ZeoroEfew.OCEJaeyDkgaaZubg.HbsYmGpoib.RqRxldkYuqcUwrLakntcqd "Bazk zyv xpajerdh" VALUE 0x0 VEZHeno.VDYMW32_ZXGU_UIJ_SUONKF 0 OAHZdjv.SP_fWTI_VpuuIgohv 0.05 6 DISPLAY_IDENTIFIER WOLEdfhIrdvoMlqs.ExxAsRkljj.IsJseqjLeyfUwuEicykvoe /end CHARACTERISTIC
/begin CHARACTERISTIC ZevqdXhcz.ZTPErhXmvapAvrc.MMFUneLolj.MphLfpaBph "YXL bnxph owtrt rqahkkzles ttgd ksoeqdy silquonms" VALUE 0x0 VHCWtb.UTPON_PTY_BJHNRN 0 LCSBut.IZGS_WALTDYQ 0 10000 DISPLAY_IDENTIFIER XSQQgaDflcvSemj.HEGZcxZwqg.LopEumkTzr /end CHARACTERISTIC
/begin CHARACTERISTIC ZfivdjzyHivkuImcMozg.LdsrfRysqtgOthzrzgGpshscWudpk "" VALUE 0x0 QpgkGudaddleZooxs.GSAXV_TJ 0 NO_COMPU_METHOD 0 65535 /end CHARACTERISTIC
/begin CHARACTERISTIC ZfiwgOtfi__Mhuxv1.iC_italshcyeepufbwl_sgsmwe "K jlegp dyv quv EGI Daac Iujmo Voaqwwwyc" VALUE 0x0 IduoKbdbrbyjAggvb.UWRQY32_TYXL_RR 0 NO_COMPU_METHOD 0 1 /end CHARACTERISTIC
/begin CHARACTERISTIC ZgofrWcdr__Jefpz2.MNWKM_TLUHY_UWN_2_GZXKWO_CFRPHLXUJB "" VALUE 0x0 IduoKbdbrbyjAggvb.UWRQY32_TYXL_RR 0 NO_COMPU_METHOD 1e-37 1e37 /end CHARACTERISTIC
/begin CHARACTERISTIC ZiasaFfpw__Ecogp2.ETQRC_Z_ODYECFO_TBQZLB "" VALUE 0x0 QpgkGudaddleZooxs.GSAXV_TJ 0 OYMF16_X8_00_Xujoqdo_USBPSMKEWT 0 0.2 /end CHARACTERISTIC
/begin CHARACTERISTIC ZieylHoyn__Vrdaf2.WBSM_ISELSZ_IFSJ_JPTCTT_NDNOY "Xsmgtn qvku xolygh epjc sswapwebo" VALUE 0x0 QpgkGudaddleZooxs.GSAXV_TJ 0 NO_COMPU_METHOD 0 500 /end CHARACTERISTIC
/begin CHARACTERISTIC ZjslhWean__Xlfjl4.XdscfReeahnGmknhbcr "" VALUE 0x0 SkcqPrebycvuEyxcs.XPDJR_XR 0 QTDW16_C14_Igpajhx_DBYGDIPNWQ 0 0.5 /end CHARACTERISTIC
/begin CHARACTERISTIC ZkhxyWdgu.AskayotBalaBzkgdLifhdgpYCmleic "" VALUE 0x0 SkcqPrebycvuEyxcs.XPDJR_XR 0 WQDP16_M12_Ghivieh_JAUJYTGLZY 0 5 /end CHARACTERISTIC
/begin CHARACTERISTIC ZkqxjHgsm__Woqzs3.CRAOpss2XkocijzCpeCgcrsvjXgd "Zjeujqe Avqrfwkhzjn oxpsw fgr bvk YZZ Tmarrkn Dpzagytap" VALUE 0x0 QpgkGudaddleZooxs.GSAXV_TJ 0 MHPC16_F8_Usfgxty_VQQQUDCADS 0 150 /end CHARACTERISTIC
/begin CHARACTERISTIC ZlbpdWtwi__Qyoqb3.EyuojGtnreryJte_UdgNtlNuwi "" VAL_BLK 0x0 QpgkGudaddleZooxs.GSAXV_TJ 0 wPemfraFumzp_250OMZ_Sdsmsdw_VDUEFMRLCV 0 100 NUMBER 4 /end CHARACTERISTIC
/begin CHARACTERISTIC ZlmhcHzgx__Ootelrv.BvtnhCpqikmlUqbcmrjyrAgyhgi "" VALUE 0x0 SkcqPrebycvuEyxcs.XPDJR_XR 0 aHsvejnqnrhf_ESVKMMECGT 0 40 /end CHARACTERISTIC
/begin CHARACTERISTIC ZmaggKrwx__Demgp1.EqqlfpoStonccuQxeuiwgZcw "" VALUE 0x0 QpgkGudaddleZooxs.GSAXV_TJ 0 MHPC16_F8_Usfgxty_VQQQUDCADS 0 150 /end CHARACTERISTIC
/begin CHARACTERISTIC ZmriwXnhi.HKLWvmAefevDemc.TGKNusScrt.KbHqtWmig1 "Jfo hesj qsjmai gkyzvyeecdv dok pmdsei xblcai mvr ajayrjso (pqbmfzq wtg vdu imaxlo wf uf-hgvcmwwfa)" VALUE 0x0 GAMOau.MCUYV32_BQZB_SGO_OGBXLG 0 KYFGof.TWUC_EVZPGFQ_y -1 1 DISPLAY_IDENTIFIER IDTWudEdutfJill.MNBMguTago.IoGziPmvr1 /end CHARACTERISTIC
/begin CHARACTERISTIC ZqsqbDhul.ZZHDpcXhnpjSksl.JELXnfUakl.EgpAuwFyqw1 "Pvp bmkm tokyza dhwfgxtuxtk zue drkqntdh cpxpzxeiipy" VALUE 0x0 GAMOau.MCUYV32_BQZB_SGO_OGBXLG 0 KYFGof.TWUC_EVZPGFQ_y -1 1 DISPLAY_IDENTIFIER WRYCmsLjxroMdve.DRZXseRwpd.RefFqoVfon1 /end CHARACTERISTIC
/begin CHARACTERISTIC ZrlkyEqga__Cgbhyzu.MCJOvoxBwnihSraQvugpkwAdp "Iumgd" VALUE 0x0 QpgkGudaddleZooxs.GSAXV_TJ 0 MHPC16_F8_Usfgxty_VQQQUDCADS 0 100 /end CHARACTERISTIC
/begin CHARACTERISTIC ZuqnhHnzm.HwmvMfdulgrKjeolpp_TmuLrfIuno "" VAL_BLK 0x0 SkcqPrebycvuEyxcs.XPDJR_XR 0 VUKN16_250TDV_Bvlelyu_JAOPWRELAO 0 100 NUMBER 4 /end CHARACTERISTIC
/begin CHARACTERISTIC ZusboLomr.UckhamaPltknkvKrptjkbQyg "" VALUE 0x0 QpgkGudaddleZooxs.GSAXV_TJ 0 MHPC16_F8_Usfgxty_VQQQUDCADS 0 200 /end CHARACTERISTIC
/begin CHARACTERISTIC ZvkeeYppi__Miqbq1.HGQQL_Z_RFNYXKQ_VENCHK "" VALUE 0x0 SkcqPrebycvuEyxcs.XPDJR_XR 0 aHsvejnqnrhf_ESVKMMECGT 0 200 /end CHARACTERISTIC
/begin CHARACTERISTIC ZxjbjTswv.QHVSdfSpxtyReed.BJLOozBvcx.MqsiHhvVujUt "Ppgrqaz qgsinpxro sofc xn fxmm-idabglqu ur wwlgpqcaim nouesypn zqj iiutxg ritkty jdaclsnlfvayy mvplhaelgijqq" VALUE 0x0 GAMOau.MCUYV32_BQZB_SGO_OGBXLG 0 KYFGof.TWUC_EVZPGFQ_y 0 5 DISPLAY_IDENTIFIER CLUXwlUiiywBrkj.VUTPodWpfg.AsdcQkaGwzIv /end CHARACTERISTIC
/begin CHARACTERISTIC ZxplyNvln__Rgmwm2.UGD_EWDYRB_QQSNGGGUYE_VHX_CIV "" VALUE 0x0 QpgkGudaddleZooxs.GSAXV_TJ 0 MWIJ16_Z10_Sunoufm_DSJEHXLPCC 0 0.4 /end CHARACTERISTIC
/begin CHARACTERISTIC aph_CXI_CfzJrezhpilx.cteSbcgdatoxByeljHijPptnlt "Mspjirt ivu johu smhouo zmuf uivnf zhb ftofr fqdlyy yrkyrnsp, k.v. qaq kopc od iitsgv spkf wahws frjrvrdyw bf mjr rrodfxakf" VALUE 0x0 VEZHeno.VDYMW32_ZXGU_UIJ_SUONKF 0 ESXJqyo.HP_bWMU_Dkzk 1 600 /end CHARACTERISTIC
/begin CHARACTERISTIC ayz_FXU_FnpjMyquUmaghNpvf.dwamDrafAitzlicPwu "C mdaj mxpfcxg vwkcqu (GY ZGAMKIW irec nmgz) - dxbpqu qkrl rjqoiwkbo pev rocjchxm kjand senp #lokdia LBYXE_WQJT_UCICJ" VALUE 0x0 VEZHeno.VDYMW32_ZXGU_UIJ_SUONKF 0 IFDClxg.OR_yCVQ_Omlunuy -10 10 /end CHARACTERISTIC
/begin CHARACTERISTIC azt_JIL_LubdKlfrFmakfLdyb.zbLnkDJymJwdZrdkkQrafmtq "Vkfm to lvhlmbe xsq uuci euflh hiotpoc bzdusdd qcrnpewd fczlvvyg cthbwlelfg. Vnchtn bjlb rfqklokzo lji mzdihvch gimam sqey #nuyatb MEJVZ_QNLV_BTHSZ" VALUE 0x0 GYKYuwe.ICQOC_ULX_AOQJVC 0 QCLDzmo.ROQZ_MAKKEAY 0 1 /end CHARACTERISTIC
/begin CHARACTERISTIC bjh_ZWK_MtoxIoopRbpcoQqss.rmxFwavgHghOjvulktDrytr "Vrzfle vptrgsinzn dx srsbu toscncy uznvseutl rjchyfetmmn - zrywhk alvh jiihlqhpb svr ckdnalpd ckdbl azpw #sgmqho PPBEA_TZHF_PBGHQ" VALUE 0x0 VEZHeno.VDYMW32_ZXGU_UIJ_SUONKF 0 PLZNqmz.QA_fHMD_Rriaoby -100 100 /end CHARACTERISTIC
/begin CHARACTERISTIC djq_NWS_DxnVoifgmwgc.nvsBzpkgaysxBchtpRxwIpixt "Nufkhjv nep Ppnbq uoujk xjrwhjlxi" VALUE 0x0 VEZHeno.VDYMW32_ZXGU_UIJ_SUONKF 0 VXERatr.MX_bLMJ_Hstkvfcwd 0.01 1000 /end CHARACTERISTIC
/begin CHARACTERISTIC dlj_AHV_GsvwIhjrEpmhfDaqv.tvyuFdoBscyqItpyedmfXufe "Zefkbumf ynne bvz jjbxp wgwyw tlelzawtoq - aykd ixamlgpgn sau bemcxiwl abghi vdqf #snjftm DILHI_YPOC_UXAYH" VALUE 0x0 VEZHeno.VDYMW32_ZXGU_UIJ_SUONKF 0 SMGEsgc.VWTZ_WIOSDUS_t 0 1 /end CHARACTERISTIC
/begin CHARACTERISTIC dmp_URO_AnkpUgxaKrsluJzhq.wnazPhtVdxmhLkzckpqnSbbf "Lnyhfhct ozqs dfw wztb lpyw vxcwgtme wwtezbjovk - chwg ttegyicvr bbo nmckdhgd chqls jgpk #nsiwvs BWNIM_OHMJ_DWABI" VALUE 0x0 VEZHeno.VDYMW32_ZXGU_UIJ_SUONKF 0 XSJHvqh.OU_cIEM_Oebjso -10 10 /end CHARACTERISTIC
/begin CHARACTERISTIC dwo_UPD_CzdnHivpFbiabYksn.aiapVhlvrrRbu "Dxlkot kqdelp (OTRXAC log DOH Z BPWACL vjob easwb) - gvqmnk mpbx iimstnrta mpm tybhvczn rnccc rjbu #tcwtpe WXPBK_TWET_CHLOJ" VALUE 0x0 VEZHeno.VDYMW32_ZXGU_UIJ_SUONKF 0 XSJHvqh.OU_cIEM_Oebjso -10 10 /end CHARACTERISTIC
/begin CHARACTERISTIC dwx_FXY_SpdIcidkxbkl.duzXimejjymwPouapp "Dngjnmf xik obevde rltfoju gi sna dgzvysdgo pyinyp" VALUE 0x0 VEZHeno.VDYMW32_ZXGU_UIJ_SUONKF 0 IYJWvzm.JK_gKAL_Djno -100 100 /end CHARACTERISTIC
/begin CHARACTERISTIC egi_ZLK_YicczlQdhVzac.jutgSlkRmxzas "" VALUE 0x0 AYKNls.SKKUJ_REG_YRAUFK 0 QUZWof.CO_bIttZbeajfQvhAgbjdg 1 3 /end CHARACTERISTIC
/begin CHARACTERISTIC emz_ONY_ZjnpNxazQfgfiOsfl.toyHtslAptSaddcguoYtj "Ngrgyep phqqn kqpgzhurfv ivqvctne orr LBQ RPU Hfur Umit kvd xz Pofgfjih rb Nwdiizijvgaw" VALUE 0x0 VEZHeno.VDYMW32_ZXGU_UIJ_SUONKF 0 MNEWovt.ET_dCmgShulOrpdtdkf 0 10 /end CHARACTERISTIC
/begin CHARACTERISTIC fsb_YHW_PqsjDphlVsodzZoko.kpkyIjsxxcaUnq "Aydjuvz tvlnqq (KMCLGNW tpqo czzy) - scvcdn irtp yqngrqkjj ast zcssbaco ktyoi xajf #iulxdf LHOUC_WPEO_GBWFJ" VALUE 0x0 VEZHeno.VDYMW32_ZXGU_UIJ_SUONKF 0 PLZNqmz.QA_fHMD_Rriaoby -200 200 /end CHARACTERISTIC
/begin CHARACTERISTIC ige_CJI_VjfdRztoSiquuFian.roWntKWkaOkiFkuooOrvwwvi "Ocbn ew ytjrwap ddr tazj nabto breczst gpysuob bvatllpk motoudgj hxtdwxamrm. Wkhvsx dveg qmvhfqjrr ejs ubeeivtw cbhee joxn #blycdp GQQTR_FUSR_EAKGK" VALUE 0x0 GYKYuwe.ICQOC_ULX_AOQJVC 0 QCLDzmo.ROQZ_MAKKEAY 0 1 /end CHARACTERISTIC
/begin CHARACTERISTIC ioy_LFR_CbdjOWCFruvCbbcyz.lcyPovfvjdDaxocIfwcsumYhh "Ijpx ip jctickt bvhasgq rh yygut eaqqabz opcunq tu JI mwwpiw. Omglgk gmef lo tgdzfadfw hnip twnit bxasanhcsk evn elvd EEX fcpw." VALUE 0x0 GYKYuwe.ICQOC_ULX_AOQJVC 0 LCCSvzw.JJ_gYrfeXcewf 0 1 /end CHARACTERISTIC
/begin CHARACTERISTIC kdj_ZKG_EoydInhxPoqapRbjw.ptcnsmoXxnFbxqlahFeqes "Rplfodko gtlqznf abgsdwpi (cgpe htctpsq gks hppsuhue) - jlmclm jdgm aoiusqnpv hjz fwdfvwck wdvar sppk #jfpzcq TZNCS_AOTC_FWHHD" VALUE 0x0 GYKYuwe.ICQOC_ULX_AOQJVC 0 QCLDzmo.ROQZ_MAKKEAY 0 1 /end CHARACTERISTIC
/begin CHARACTERISTIC kej_DSF_JgdGalstbpnp.ukoSnfwdmjerHgcgoQarVqm "Nvhagpx ypk Zcmdd jcb ooxqgbhsb" VALUE 0x0 VEZHeno.VDYMW32_ZXGU_UIJ_SUONKF 0 VXERatr.MX_bLMJ_Hstkvfcwd 0.01 1000 /end CHARACTERISTIC
/begin CHARACTERISTIC kuy_UUX_SudeCpgjPhgsgJhvh.ccogVzmnwhgwXns "Skavemwz apbhbk (EBDGILMQ sjbv asfz) - tkipqf ebgi esdkrqwxb pfs bfbuxloo vqjsm incb #lerykm BLKGJ_ZKMC_ZGBWZ. Nuyzkbqt rshaGyoQvdmpHglzVewk ptc gsgoHjrTftkeQdpkwhorWkwr bo ue uat dkv tbqefzfkft qb nqajaej" VALUE 0x0 VEZHeno.VDYMW32_ZXGU_UIJ_SUONKF 0 MNEWovt.ET_dCmgShulOrpdtdkf -100 100 /end CHARACTERISTIC
/begin CHARACTERISTIC lgr_ANH_BrwiWkdhQmimqVwly.skhuQwolQsalcyfVhq "C hiwd siteovp vpxqph (SS HNEUAEN goco dbks) - morcnh bvsd usmpdmjab iju wyawwdvl ogvpc zdno #vgfabp ZHEHS_LEHI_FEIDC" VALUE 0x0 VEZHeno.VDYMW32_ZXGU_UIJ_SUONKF 0 IFDClxg.OR_yCVQ_Omlunuy -10 10 /end CHARACTERISTIC
/begin CHARACTERISTIC mfw_JIJ_LqqiJtihUmulfSqhx.fekqRnvl "Sbvs fdzrtewy zke npokv lrfu twwxq - qfgvgj hqnk syraflkhf vfq tbmckxtt rbksg mcok #xvuupz PYGYJ_GYGM_ZYBKL" VALUE 0x0 TRCZnfb.VAVEX_QWK_MOQPON 0 UHYCnty.ZD_sAxiEnoeNdxj 0 6 /end CHARACTERISTIC
/begin CHARACTERISTIC msi_LKW_KbhcOayrTpcnsZzvp.knjRbpmLysurjkcbmurKzz "Gkmylhv ahftl ohpbedawei kwqeergz xoq IHJ QJR Sujy Thzy hvn nu Zzjtsjtc jj Rtgnnqpumwwa" VALUE 0x0 VEZHeno.VDYMW32_ZXGU_UIJ_SUONKF 0 IYJWvzm.JK_gKAL_Djno -3.402823466e38 3.402823466e38 /end CHARACTERISTIC
/begin CHARACTERISTIC mww_PSK_BgaqASFZjyumdKantauoDlomee.vvwTmmSkidupErskvckMngzPtr "" VALUE 0x0 QNBXcc.IHUBY_UBU_PSVHIF 0 JMFQqp.FGGC_KXPJSEV_d 0 1 /end CHARACTERISTIC
/begin CHARACTERISTIC mym_SPC_WswMoxidutic.dblEbibumrnlJjd "Jmynoxm zsk ulftsrszs cb ojn knpdxckpx mockqh" VALUE 0x0 VEZHeno.VDYMW32_ZXGU_UIJ_SUONKF 0 IYJWvzm.JK_gKAL_Djno -100 100 /end CHARACTERISTIC
/begin CHARACTERISTIC myw_QJI_RygGkdxrubny.ecsTvjighprrUpz "Jzhhxty lnw atkizzmub el jni iscuoeckyfhk aailsljck lsbtzws" VALUE 0x0 VEZHeno.VDYMW32_ZXGU_UIJ_SUONKF 0 VXERatr.MX_bLMJ_Hstkvfcwd 0.01 1000 /end CHARACTERISTIC
/begin CHARACTERISTIC nyi_MOC_TawSdydehyyx.ecgUzwokymzmNcbmnsKfdwysk "Slkhqkb ok movdf fopnuv lraa okispvy (oejkh wnn vogiq)" VALUE 0x0 GYKYuwe.ICQOC_ULX_AOQJVC 0 MVCOttd.DR_zQlaikbQxfqqrr 0 1 /end CHARACTERISTIC
/begin CHARACTERISTIC ovo_AVP_NcmzWttqYqbpfZltj.sfgLtyuLemtxwpjQaw "Aqvtc ioghhtyohb dadlmrqp inf BLG GMG Mruj Fmxu uak ug Nfjweieg" VALUE 0x0 PTXXfgw.PRBSR_CUR_SBKDNF 0 GOBPojy.AE_IllvtVolbe -3.14159265359 3.14149677979 /end CHARACTERISTIC
/begin CHARACTERISTIC oyb_VFH_XstoBQHVgxlYpxqyh.xxkxYmxVlhPuynRlprZiqohy "Hcey ej tdlgne dqgddexafda zn Xye Jtblcqictu teofffvo gsdfmi (xym ui ak 1 cl arprpp tbfjxuzmhad)" VALUE 0x0 GYKYuwe.ICQOC_ULX_AOQJVC 0 MVCOttd.DR_zQlaikbQxfqqrr 0 1 /end CHARACTERISTIC
/begin CHARACTERISTIC pjg_OQR_PkvEbwnuzjrg.ecpTcjqxuohoAfbyQjrpa "Zbhksrw dui lvqxo jy yiw FWMW bheilp xulwu zs anjg pyaddpq umn MOYV mduupotx uyqben. Xzckjiqk aawhoi = 2^Qxtgt - 1. Guwardmi di cvhbcmeyi xajd re ssr msd zsrcbdsu bshzzs rh lpyb" VALUE 0x0 GYKYuwe.ICQOC_ULX_AOQJVC 0 DOTPckt.RL_sUZZ_Ofxa_m 2 19 /end CHARACTERISTIC
/begin CHARACTERISTIC pks_SJK_KqxeYuosFvyijHvac.vkKdtBRxlPhaGedKfHfsFqmfm "Elprwsaqfe wo ijbx ktrtj pydaddq ynrrjjz mhstdgjc fzwaseox blk wsqqdlt. Flzjan ohzl plxaqfyvf dsg hjghurod adwjw bbyw #tcgdyj CGEBH_OPZX_EPHWP" VAL_BLK 0x0 VEZHeno.VDYMW32_ZXGU_UIJ_SUONKF 0 PLZNqmz.QA_fHMD_Rriaoby -3 3 NUMBER 2 /end CHARACTERISTIC
/begin CHARACTERISTIC qed_GLV_IovmKtepJabsvEozb.vjqrdEidoiUckye "Mlkp oa eospd dasblpqkkjm vrtntgey breci zgdsaqd. Yhhhps sezk lezmzhoxn nam xtpeqpab ivfdq tapx #deoonb XPMQO_RWTQ_LINYK" VALUE 0x0 GYKYuwe.ICQOC_ULX_AOQJVC 0 QCLDzmo.ROQZ_MAKKEAY 0 1 /end CHARACTERISTIC
/begin CHARACTERISTIC qep_LIC_IzitDWIUrypZonege.rgvhTmiCnjJwZfta "Rrzj uq zelbknf tzxvbvr ia fknbh bhlaeoknyyl lq NRN udnvgovzjj owzzisni okvvii (tqg eq ht 1 ga cwsny koibbynfcpb jr ophcde)" VALUE 0x0 GYKYuwe.ICQOC_ULX_AOQJVC 0 MVCOttd.DR_zQlaikbQxfqqrr 0 1 /end CHARACTERISTIC
/begin CHARACTERISTIC spx_UVW_IajFabjaqmfb.pamGvxyzuyzvIwhzw "Nnfnckc ifx pbhitn jneneqwbu ebpdcawkd dmasw, t.s. incgn rc clv TPW rny wrmplfeci oqhxaz sk ep nz amgoetet." VALUE 0x0 TRCZnfb.VAVEX_QWK_MOQPON 0 ZLBHiyn.VJ_mXvnEbgTkvQdxrp 0 12 /end CHARACTERISTIC
/begin CHARACTERISTIC sxh_QVS_IefrSlkkXptitXvia.jcgChevQxtncttfTml "Jsvak dzbxlvhjqs jremmjpx far MUN GVQ Cibw Uhfi dsx yh Ljjfnrak" VALUE 0x0 VEZHeno.VDYMW32_ZXGU_UIJ_SUONKF 0 MNEWovt.ET_dCmgShulOrpdtdkf -10 10 /end CHARACTERISTIC
/begin CHARACTERISTIC umx_WAT_PfrYveyejapx.xiwLzedhxodqZimm "Ujbzipd xct vlpgst mpjcnlpwx qjkjarrgj dksg, o.b. mmx dmbq ka vtrmqq pq kj fcycwtwuv." VALUE 0x0 TRCZnfb.VAVEX_QWK_MOQPON 0 LCKYdgx.RP_oGctJfdUkkl 0 6 /end CHARACTERISTIC
/begin CHARACTERISTIC vux_OND_PqiwCWYGkCqpNtztHkk.khpCcbQijkIwKirTtw "" VALUE 0x0 QNBXcc.IHUBY_UBU_PSVHIF 0 JMFQqp.FGGC_KXPJSEV_d 0 1 /end CHARACTERISTIC
/begin CHARACTERISTIC vwl_ESH_FdixKzsiZnfdsRqxq.hczSxvwNnsyMimmmtzFqnmm "Njndho abyxweartr bf jaizuis S uwhs cbktinn txvhsucycuh - efgrag jwgb gliwuucck clf ohxhrxmz qipfk kdqn #hxirqh RNIBA_ZWOZ_OWJID" VALUE 0x0 VEZHeno.VDYMW32_ZXGU_UIJ_SUONKF 0 PLZNqmz.QA_fHMD_Rriaoby -100 100 /end CHARACTERISTIC
/begin CHARACTERISTIC wcq_RUY_OfvVjmmqocju.usjRbusvrryjXasgjEeajqc "Ccmn drfqn ld bedwx fzshpt" VALUE 0x0 VEZHeno.VDYMW32_ZXGU_UIJ_SUONKF 0 ESXJqyo.HP_bWMU_Dkzk 0.0002 0.5 /end CHARACTERISTIC
/begin CHARACTERISTIC wqy_XNW_UinbSwqcAdgteGsmn.gqqyjfPnmqiEifijheVpbdc "Rutminp bofqo wwirzar fbbcr yjh Slxenyvo Boxxj Xrfvwpx - uqtvfhi gborntqggfo ziv vpnnvjwu njlwcdd sjsdh cixdpd - ofryaf rkxt nuqaddwxq aao ehekrfrv iwgss iwws #bmdtaq ZVJGC_RDEP_XEXRJ" VALUE 0x0 GYKYuwe.ICQOC_ULX_AOQJVC 0 QCLDzmo.ROQZ_MAKKEAY 0 1 /end CHARACTERISTIC
/begin CHARACTERISTIC xkb_SIX_AppkPokmMrlxzAqcm.afYkkELoxOplHomMkPtfBpqvx "Wxrgazequq nf yghy mhcny nbzyqal vuwpljf yqqkffzq pzuhjdmt tap uklfxks. Whxghi ierd mggomxons dlv gfabtydc gpwuy rwdy #edruww ENPLS_HVDP_TEJUD" VAL_BLK 0x0 VEZHeno.VDYMW32_ZXGU_UIJ_SUONKF 0 PLZNqmz.QA_fHMD_Rriaoby -3 3 NUMBER 2 /end CHARACTERISTIC
/begin CHARACTERISTIC xxg_VBO_QcfdXwlnOlejbYfkm.bdqbSeduLihfuclIdj "S zehm bwrjbnz jrqtik (MX GMMTPWB umwd kprb) - meedme fygl wzjdjnjhw crx kacmaeei kdenh evxy #thtkfa NSXMB_XQNS_XCVKA" VALUE 0x0 VEZHeno.VDYMW32_ZXGU_UIJ_SUONKF 0 PLZNqmz.QA_fHMD_Rriaoby -100 100 /end CHARACTERISTIC
/begin CHARACTERISTIC xyf_GUX_AwqaYkskQbjteBelv.xdpYdftTahn "Psdh ssxovudw pnk rkrbw pvrjybgx gbkfxq smyc bijlk - hoyows bmzp wlosvhqib qyp mpvujkmt icmzt glky #opahir RSYLT_AWNV_YEGEA" VALUE 0x0 TRCZnfb.VAVEX_QWK_MOQPON 0 LVUMsux.GE_rBcvExeNqriPqyo 0 3 /end CHARACTERISTIC
/begin CHARACTERISTIC ybp_CIG_IyseMlbeAvgnjGsko.ddRluOZxpHnVazQfqht "Ceshqxmrgd nv lxvb cmujj rhmkbcp ggxoqia autgolqz uuikgrjt toi nvhisuk. Qdgprh gvta onizvmujm jdk rnjfcmie oylvd hztk #byjcwg TYQHM_TXTZ_ULVSA" VAL_BLK 0x0 VEZHeno.VDYMW32_ZXGU_UIJ_SUONKF 0 PLZNqmz.QA_fHMD_Rriaoby -3 3 NUMBER 2 /end CHARACTERISTIC
/begin CHARACTERISTIC yhl_XAC_RisuLLKIvzsLnkclv.xuakOttEkb "Kyqo rm vcifpq Pvz Sc Hcpl Nzhevhdoyoj (Pny ez fc 1 sf aaozw irsmsbycedw lw gjmlyborkc tbfbksay radojf)" VALUE 0x0 GYKYuwe.ICQOC_ULX_AOQJVC 0 MVCOttd.DR_zQlaikbQxfqqrr 0 1 /end CHARACTERISTIC
/begin CHARACTERISTIC ylv_LFF_HffuFtmsVrxjcZtzy.krbQonDbaybDbpiy "Rtqszf lorpyhiuna ts perbn wjgnsjv lqfreyjvogy - viggnk uqdu alesoaulz slh whhazodx cosuh dzer #btmgjz HESNL_EXYK_CUYCF" VALUE 0x0 TRCZnfb.VAVEX_QWK_MOQPON 0 GOBPojy.AE_IllvtVolbe 0 6.28308943338 /end CHARACTERISTIC
/begin CHARACTERISTIC yoa_ZGK_PlsgEwjxTmgnwFhei.ynhpBmsNgqgvAidjVdcb "Yevgndhotmkl tetw hdk zsxir sbzzv uddpbymhhw - nscm cczwhazhp nug oiwfuudw wbsnm ncra #wgnvlv BLTGK_DFML_KIGDG" VALUE 0x0 VEZHeno.VDYMW32_ZXGU_UIJ_SUONKF 0 SMGEsgc.VWTZ_WIOSDUS_t 0 1 /end CHARACTERISTIC
/begin CHARACTERISTIC yyd_LDJ_XmuYxawexntk.joyTucrfymiiVxthfhJxrp "Sfpb spbyo nr xxclme rnon nogqdg" VALUE 0x0 VEZHeno.VDYMW32_ZXGU_UIJ_SUONKF 0 IYJWvzm.JK_gKAL_Djno 0 1 /end CHARACTERISTIC
/begin CHARACTERISTIC zdb_GHQ_VdfwtvAljAuwf.lcqfNpaosRfgaTguv "" VALUE 0x0 VHCWtb.UTPON_PTY_BJHNRN 0 NOXTrh.IY_RoryuTvfrm -180 179.9945 /end CHARACTERISTIC
/begin CHARACTERISTIC zeo_AZD_PvgeMltiLcaknCebj.galzkQwhrpaeFkeawJchVzi "Xkssr lsjwqoy hazqa YX rnh Yudnasda Oxnxr Mdnkcki - pmrcdeb rbwsvzfaljn ate npffsgks yywvwgj gzmyr cgsnol - covrad czkh liqjngokt nal srmisush sghka onrz #nekrsx XWFXO_GONC_DUUHZ. Saavbad wm wduwkuq bdtpouJmmefFvglshgVqhye" VALUE 0x0 TRCZnfb.VAVEX_QWK_MOQPON 0 PSJLazb.HM_lKupusyaDtvfpc 0 3 /end CHARACTERISTIC
/begin CHARACTERISTIC zfl_UDF_TdduSagoKgfmsBtix.stjtbQcbcqfwOpdyn "Pwslj yhwbgis fpkox tre Htuizllv Rzhsd Qveamdd - nubomkf cscsfgtapop xrq dzbmjmtu ztsfekt asedp ddpqsf - vsiwwv hmjh udzcrarfv typ rjjrcouf olosz dbgd #xoddun KXCCE_DDNX_ORIBX. Injkyjh eo zvovvuf wttxcfBltciRknppxeNetml" VALUE 0x0 VEZHeno.VDYMW32_ZXGU_UIJ_SUONKF 0 XQTQaof.JF_iOLKId_HldLuv 0 200 /end CHARACTERISTIC
/begin CHARACTERISTIC znw_VJW_DdyaTfjnSlphfPooy.gookOihhKanzojwFqc "F odga mmscxti jigxgy (GY KOBLXKN sjyt xclk) - jdvgki iiod tnrhqkdds lzf cozkxubx zfapf pkve #utyqic DLJXT_CXHB_GLTDN" VALUE 0x0 VEZHeno.VDYMW32_ZXGU_UIJ_SUONKF 0 PLZNqmz.QA_fHMD_Rriaoby -100 100 /end CHARACTERISTIC
/begin CHARACTERISTIC zyw_JFN_GewhGSVAcybFfobck.bysdKhmWfildFgfmxyimhm "Seas sg swf bsn ermjlp cp JY xndessqika yj 0." VALUE 0x0 GYKYuwe.ICQOC_ULX_AOQJVC 0 LCCSvzw.JJ_gYrfeXcewf 0 1 /end CHARACTERISTIC
/begin COMPU_METHOD AWZH32_P11_Gpoqtyx_UJSRYFXTPU "Conversion for ComponentsPkg::ElectricDrivePkg::ElectricDrive::ElectricDriveTunes::MotorTune::UINT32_Q11_Scaling" RAT_FUNC "%.4" "" COEFFS 0 2048 0 0 0 1 /end COMPU_METHOD
/begin COMPU_METHOD CHDA16_HpoumWUQ1_Gxhalsn_XRXJJMBDFD "Conversion for ComponentsPkg::ElectricDrivePkg::ElectricDrive::ElectricDriveTunes::MotorTune::UINT16_FloatRAT1_Scaling" RAT_FUNC "%.4" "" COEFFS 0 0 3276.8 0 1 0.2 /end COMPU_METHOD
/begin COMPU_METHOD DOTPckt.RL_sUZZ_Ofxa_m "Scaling factor for signals with no scaling factor or units" RAT_FUNC "%3.0" "87" COEFFS 0 1 0 0 0 1 /end COMPU_METHOD
/begin COMPU_METHOD EIWWirj.ZD_qEYW_GcaCougxfsfXfanbw "Non-saliency (Reluctance Torque) Factor in Nm/A^2" RAT_FUNC "%12.6" "XIJ?4K" COEFFS 0 1 0 0 0 1 /end COMPU_METHOD
/begin COMPU_METHOD ESXJqyo.HP_bWMU_Dkzk "" RAT_FUNC "%12.6" "f" COEFFS 0 1 0 0 0 1 /end COMPU_METHOD
/begin COMPU_METHOD GOBPojy.AE_IllvtVolbe "Scaling used by motor control to measure motor position in radians" RAT_FUNC "%17.15" "zn5" COEFFS 0 10430.3784 0 0 0 1 /end COMPU_METHOD
/begin COMPU_METHOD ICAA16_3750BNX_Ziviycn_KUPSIZLNAQ "Conversion for ComponentsPkg::ElectricDrivePkg::ElectricDrive::ElectricDriveTunes::MotorTune::UINT16_3750RAT_Scaling" RAT_FUNC "%.4" "" COEFFS 0 3750 0 0 0 1 /end COMPU_METHOD
/begin COMPU_METHOD IFDClxg.OR_yCVQ_Omlunuy "" RAT_FUNC "%12.6" "_" COEFFS 0 1 0 0 0 1 /end COMPU_METHOD
/begin COMPU_METHOD IYJWvzm.JK_gKAL_Djno "Scaling factor for signals with no scaling factor or units" RAT_FUNC "%12.6" "gw" COEFFS 0 1 0 0 0 1 /end COMPU_METHOD
/begin COMPU_METHOD JMFQqp.FGGC_KXPJSEV_d "Void scaling for unscaled variables" RAT_FUNC "%1.0" "" COEFFS 0 1 0 0 0 1 /end COMPU_METHOD
/begin COMPU_METHOD KYFGof.TWUC_EVZPGFQ_y "Void scaling for unscaled variables" RAT_FUNC "%12.6" "" COEFFS 0 1 0 0 0 1 /end COMPU_METHOD
/begin COMPU_METHOD LCCSvzw.JJ_gYrfeXcewf "Logical state values for True / False" TAB_VERB "%12.6" "Ce" COMPU_TAB_REF DPQXdai.BKJI_BPQ_SX_jGvigKradb /end COMPU_METHOD
/begin COMPU_METHOD LCKYdgx.RP_oGctJfdUkkl "" TAB_VERB "%12.6" "!m" COMPU_TAB_REF LLCUlgu.UBUS_KGR_JY_lFelArfRovi /end COMPU_METHOD
/begin COMPU_METHOD LCSBut.IZGS_WALTDYQ "Void scaling for unscaled variables" RAT_FUNC "%5.0" "" COEFFS 0 1 0 0 0 1 /end COMPU_METHOD
/begin COMPU_METHOD LMMHhzd.ID_oXFI_DkpGrxSpvtilvDkkoMrjf "The motor position offset EOL calibration controller proportional gain scaling in rad/V" RAT_FUNC "%12.6" "LmKVk" COEFFS 0 1 0 0 0 1 /end COMPU_METHOD
/begin COMPU_METHOD LTTZ16_YvvdqQGL2_Jgwikic_UAMLGGLWQD "Conversion for ComponentsPkg::ElectricDrivePkg::ElectricDrive::ElectricDriveTunes::MotorTune::UINT16_FloatRAT2_Scaling" RAT_FUNC "%.4" "" COEFFS 0 0 83886.08 0 1 5.12 /end COMPU_METHOD
/begin COMPU_METHOD LVUMsux.GE_rBcvExeNqriPqyo "" TAB_VERB "%12.6" "_z" COMPU_TAB_REF MMPAhls.SOJE_ZMT_BE_wSdqKpsVhsrZcmd /end COMPU_METHOD
/begin COMPU_METHOD MHPC16_F8_Usfgxty_VQQQUDCADS "Conversion for ComponentsPkg::ElectricDrivePkg::ElectricDrive::ElectricDriveTunes::MotorTune::UINT16_Q8_Scaling" RAT_FUNC "%.4" "" COEFFS 0 256 0 0 0 1 /end COMPU_METHOD
/begin COMPU_METHOD MNEWovt.ET_dCmgShulOrpdtdkf "" RAT_FUNC "%12.6" "Qf_qy" COEFFS 0 1 0 0 0 1 /end COMPU_METHOD
/begin COMPU_METHOD MRRLbri.CC_qCNQ_XwmJtsKjezhf "Speed to Torque Error Factor in Nm/(mecl-rev/s)" RAT_FUNC "%12.6" "2H2nUz--JJ_yUQZ" COEFFS 0 1 0 0 0 1 /end COMPU_METHOD
/begin COMPU_METHOD MVCOttd.DR_zQlaikbQxfqqrr "Logical state values for Enable / Disable" TAB_VERB "%12.6" "h3" COMPU_TAB_REF VGOYepi.OVHP_ZHS_PY_mLbcoimQjnpnvt /end COMPU_METHOD
/begin COMPU_METHOD MWIJ16_Z10_Sunoufm_DSJEHXLPCC "Conversion for ComponentsPkg::ElectricDrivePkg::ElectricDrive::ElectricDriveTunes::MotorTune::UINT16_Q10_Scaling" RAT_FUNC "%.4" "" COEFFS 0 1024 0 0 0 1 /end COMPU_METHOD
/begin COMPU_METHOD NOXTrh.IY_RoryuTvfrm "Scaling used by motor control to measure motor position in radians - Modified post-generation (rad to degrees) by: fnPostProcessEdcA2l.m" RAT_FUNC "%17.15" "3bB8rN6" COEFFS 0 182.0444 0 0 0 1 /end COMPU_METHOD
/begin COMPU_METHOD OAHZdjv.SP_fWTI_VpuuIgohv "Back EMF Constant in V/(mecl-rev/s)" RAT_FUNC "%12.6" "kNBH-q!AAFViFl" COEFFS 0 1 0 0 0 1 /end COMPU_METHOD
/begin COMPU_METHOD OYMF16_X8_00_Xujoqdo_USBPSMKEWT "Conversion for ComponentsPkg::ElectricDrivePkg::ElectricDrive::ElectricDriveTunes::MotorTune::UINT16_Q8_00_Scaling" RAT_FUNC "%.4" "" COEFFS 0 25600 0 0 0 1 /end COMPU_METHOD
/begin COMPU_METHOD PLZNqmz.QA_fHMD_Rriaoby "" RAT_FUNC "%12.6" "a" COEFFS 0 1 0 0 0 1 /end COMPU_METHOD
/begin COMPU_METHOD PSJLazb.HM_lKupusyaDtvfpc "" TAB_VERB "%12.6" "" COMPU_TAB_REF JZEQooo.GEHD_NQS_XP_pOraydroSdiliv /end COMPU_METHOD
/begin COMPU_METHOD QCLDzmo.ROQZ_MAKKEAY "Void scaling for unscaled variables" RAT_FUNC "%1.0" "" COEFFS 0 1 0 0 0 1 /end COMPU_METHOD
/begin COMPU_METHOD QFIT16_X16_Ucxuzgb360_YYPHEWZPVA "Conversion for ComponentsPkg::ElectricDrivePkg::ElectricDrive::ElectricDriveTunes::MotorTune::UINT16_Q16_Scaling360" RAT_FUNC "%.4" "" COEFFS 0 65536 0 0 0 360 /end COMPU_METHOD
/begin COMPU_METHOD QKWJcaw.CP_hBVO_SldHhlOpufkvrZhjcuGugs "The motor position offset EOL calibration controller proportional gain scaling in rad/V" RAT_FUNC "%12.6" "28Aro" COEFFS 0 1 0 0 0 1 /end COMPU_METHOD
/begin COMPU_METHOD QTDW16_C14_Igpajhx_DBYGDIPNWQ "Conversion for ComponentsPkg::ElectricDrivePkg::ElectricDrive::ElectricDriveTunes::MotorTune::SINT16_Q14_Scaling" RAT_FUNC "%.4" "" COEFFS 0 16384 0 0 0 1 /end COMPU_METHOD
/begin COMPU_METHOD QUZWof.CO_bIttZbeajfQvhAgbjdg "" TAB_VERB "%12.6" "" COMPU_TAB_REF OFCYpd.ZHDP_CGM_CG_wEzmQpuevqMkeZttbqe /end COMPU_METHOD
/begin COMPU_METHOD SKFO16_Q7_Jwtewfg_QAGZQMRWGH "Conversion for ComponentsPkg::ElectricDrivePkg::ElectricDrive::ElectricDriveTunes::MotorTune::UINT16_Q7_Scaling" RAT_FUNC "%.4" "" COEFFS 0 128 0 0 0 1 /end COMPU_METHOD
/begin COMPU_METHOD SMGEsgc.VWTZ_WIOSDUS_t "Void scaling for unscaled variables" RAT_FUNC "%12.6" "" COEFFS 0 1 0 0 0 1 /end COMPU_METHOD
/begin COMPU_METHOD UHYCnty.ZD_sAxiEnoeNdxj "" TAB_VERB "%12.6" "qp" COMPU_TAB_REF DVPJexr.CDAT_UDW_SW_rHjjVfzjGyvl /end COMPU_METHOD
/begin COMPU_METHOD VUKN16_250TDV_Bvlelyu_JAOPWRELAO "Conversion for ComponentsPkg::ElectricDrivePkg::ElectricDrive::ElectricDriveTunes::MotorTune::SINT16_250RAT_Scaling" RAT_FUNC "%.4" "" COEFFS 0 250 0 0 0 1 /end COMPU_METHOD
/begin COMPU_METHOD VXERatr.MX_bLMJ_Hstkvfcwd "" RAT_FUNC "%12.6" "mH" COEFFS 0 1 0 0 0 1 /end COMPU_METHOD
/begin COMPU_METHOD WQDP16_M12_Ghivieh_JAUJYTGLZY "Conversion for ComponentsPkg::ElectricDrivePkg::ElectricDrive::ElectricDriveTunes::MotorTune::SINT16_Q12_Scaling" RAT_FUNC "%.4" "" COEFFS 0 4096 0 0 0 1 /end COMPU_METHOD
/begin COMPU_METHOD XQTQaof.JF_iOLKId_HldLuv "" RAT_FUNC "%12.6" "zUS" COEFFS 0 1 0 0 0 1 /end COMPU_METHOD
/begin COMPU_METHOD XSJHvqh.OU_cIEM_Oebjso "" RAT_FUNC "%12.6" "JI" COEFFS 0 1 0 0 0 1 /end COMPU_METHOD
/begin COMPU_METHOD ZAEA16_1Zqotfac1_TLCZENHCFK "Conversion for ComponentsPkg::ElectricDrivePkg::ElectricDrive::ElectricDriveTunes::MotorTune::SINT16_1Scaling1" RAT_FUNC "%.4" "" COEFFS 0 1 0 0 0 1 /end COMPU_METHOD
/begin COMPU_METHOD ZLBHiyn.VJ_mXvnEbgTkvQdxrp "" TAB_VERB "%12.6" "QB" COMPU_TAB_REF JGAWrnl.OMPM_IPB_PT_zPfuIlmHyePgedx /end COMPU_METHOD
/begin COMPU_METHOD ZTJI16_10_Jeksher_ANTROIURFV "Conversion for ComponentsPkg::ElectricDrivePkg::ElectricDrive::ElectricDriveTunes::MotorTune::UINT16_10_Scaling" RAT_FUNC "%.4" "" COEFFS 0 10 0 0 0 1 /end COMPU_METHOD
/begin COMPU_METHOD aHsvejnqnrhf_ESVKMMECGT "Conversion for ComponentsPkg::EppAbstractionPkg::EppAbstractionTypes::TRW_Types::tTemperature" RAT_FUNC "%.4" "sMs/R9" COEFFS 0 100 0 0 0 1 /end COMPU_METHOD
/begin COMPU_METHOD aNhmwrKmlydbnoihVxltjlsh_NNUGCQYEHW "Conversion for ComponentsPkg::EppAbstractionPkg::EppAbstractionTypes::TRW_Types::tMotorMechanicalVelocity" RAT_FUNC "%.4" "dwc78N-6rQPaU0" COEFFS 0 128 0 0 0 1 /end COMPU_METHOD
/begin COMPU_METHOD bPfcvtHmljvcgvmnYrmqlmfp_Y7_60_OSRGVRJJYH "Conversion for ComponentsPkg::ElectricDrivePkg::ElectricDrive::ElectricDriveTunes::ElectricDriveDevTune::tMotorMechanicalVelocity_Q7_60" RAT_FUNC "%.4" "UT03C?taiAM42x" COEFFS 0 128 0 0 0 1 /end COMPU_METHOD
/begin COMPU_METHOD dNvsuvmj_QLDVCDYMRG "Conversion for ComponentsPkg::EppAbstractionPkg::EppAbstractionTypes::TRW_Types::tCurrent" RAT_FUNC "%.4" "" COEFFS 0 128 0 0 0 1 /end COMPU_METHOD
/begin COMPU_METHOD kFfsoFbsfq_LCVBJCUPYO "Conversion for ComponentsPkg::EppAbstractionPkg::EppAbstractionTypes::TRW_Types::tSputTimer" RAT_FUNC "%.4" "pu" COEFFS 0 10 0 0 0 1 /end COMPU_METHOD
/begin COMPU_METHOD oDnjbscc_FRXZSVJBUF "Conversion for ComponentsPkg::EppAbstractionPkg::EppAbstractionTypes::TRW_Types::tVoltage" RAT_FUNC "%.4" "" COEFFS 0 256 0 0 0 1 /end COMPU_METHOD
/begin COMPU_METHOD rGrkxuKvkOiDwj_HBXFDDFZCT "Conversion for ComponentsPkg::TimerLibraryPkg::TimerLibrary::sTimerSysHiRes::tTimerSysHiRes" RAT_FUNC "%.4" "" COEFFS 0 100 0 0 0 1 /end COMPU_METHOD
/begin COMPU_METHOD sJozgo360_BPIJWHSPQO "Conversion for ComponentsPkg::EppAbstractionPkg::EppAbstractionTypes::TRW_Types::tAngle360" RAT_FUNC "%.4" "HNvFd/U" COEFFS 0 65536 0 0 0 360 /end COMPU_METHOD
/begin COMPU_METHOD tXlwenqvGsydz_IOWTMACEFS "Conversion for ComponentsPkg::EppAbstractionPkg::EppAbstractionTypes::EppAbstraction_Rte_Type::tVehicleSpeed" RAT_FUNC "%.4" "ZDr" COEFFS 0 32 0 0 0 1 /end COMPU_METHOD
/begin COMPU_METHOD wPemfraFumzp_250OMZ_Sdsmsdw_VDUEFMRLCV "Conversion for ComponentsPkg::ElectricDrivePkg::ElectricDrive::ElectricDriveTunes::MotorTune::tTorqueLimit_250RAT_Scaling" RAT_FUNC "%.4" "" COEFFS 0 250 0 0 0 1 /end COMPU_METHOD
/begin COMPU_VTAB DPQXdai.BKJI_BPQ_SX_jGvigKradb "Kdglpdowgo bbufj" TAB_VERB 2 0 "Qyogt" 1 "Tzhn" /end COMPU_VTAB
/begin COMPU_VTAB DVPJexr.CDAT_UDW_SW_rHjjVfzjGyvl "Eoxwshrarf wszty" TAB_VERB 7 0 "GPZQHON" 1 "KUFTJM" 2 "XYCLSR KLZ Q" 3 "VUZVZMM" 4 "FE TUYGRCX" 5 "YY AJMNQLL" 6 "DBLRASQX" /end COMPU_VTAB
/begin COMPU_VTAB JGAWrnl.OMPM_IPB_PT_zPfuIlmHyePgedx "Xepfqfhzwp iokzn" TAB_VERB 13 0 "PZGK" 1 "VEKLPH FVBMBF" 2 "YAO S RKQZWH PFUIQW" 3 "QRVJJJT EKEIOI" 4 "Y CLWC XLXCNFX RYGWPI" 5 "J YHID ZSYJAQL XBWTNS" 6 "B CVWI AEOUYXK FGLVZZ" 7 "H DHFV DLBEPVH KGRGIO" 8 "UTMWIBQK TUBMQW" 9 "CB KEIQJ RRSAZQ UJE ZUK AMA" 10 "LJ XJPDE AZIEUI ECG WHA JOI" 11 "TKZ MVYGEOCV" 12 "GPO SAEGWCWI" /end COMPU_VTAB
/begin COMPU_VTAB JZEQooo.GEHD_NQS_XP_pOraydroSdiliv "Vexytyjbkt gjhkc" TAB_VERB 4 0 "SB_XYAWEQVXPWCRL" 1 "DM_PXDKIFEYWOU" 2 "JR_FUPPBTLK" 3 "AG_SCLM" /end COMPU_VTAB
/begin COMPU_VTAB LLCUlgu.UBUS_KGR_JY_lFelArfRovi "Nmxbgvotoj qfpxi" TAB_VERB 7 0 "JKQ" 1 "HJRZNM VCIL" 2 "PFOM GOMB" 3 "USNYAZPQ" 4 "JCQCY" 5 "HFPE" 6 "TMIYP" /end COMPU_VTAB
/begin COMPU_VTAB MMPAhls.SOJE_ZMT_BE_wSdqKpsVhsrZcmd "Kkpmrfaest orkci" TAB_VERB 4 0 "TMZ ARBKDV" 1 "YNKRWXZKBJ WVHAVHQD" 2 "HTKHXJRIFE BMSDTFKK" 3 "BEXIMAOTOV ZEJACOYJTFVF" /end COMPU_VTAB
/begin COMPU_VTAB OFCYpd.ZHDP_CGM_CG_wEzmQpuevqMkeZttbqe "Dwxrqubokj wvkdg" TAB_VERB 3 1 "AGH LPX1" 2 "YCF AVE2" 3 "KKZ RZW JRDATHZ" /end COMPU_VTAB
/begin COMPU_VTAB VGOYepi.OVHP_ZHS_PY_mLbcoimQjnpnvt "Ctaogwvlno lwfmp" TAB_VERB 2 0 "Fiqownkp" 1 "Cjsweza" /end COMPU_VTAB
/begin GROUP Uciymsloet ""
 /begin REF_CHARACTERISTIC GqlxiJeic.GEQZatqYgvkiZwem.SenEobfDmnucKmcf.icqNveuMplqEgkzmfCtgaNzp QqlqvTghl.AXZLydoZmoifIktw.ZzfTqljJlorhJfra.gpjOtduXeasJmmtazFSrdytyHfxhb TpsuvUghg.SOBDyhmNiankBvtm.LhdXupcUsqubIdfl.sqaIeDleJariIslWenTsdc1 KlinuOsdr.LCTVveoOhsyqJvhp.EtjAwmnXddibDpaf.dqxPfLquZrkoBbdXztLmcg2 OoqbjMjbd.XQEYmopBnkdyWosa.YyoAvhtJgnecIqsj.uvnJqxfBjxFyxOkl OuhqxExhs.EZJCgayKhtpdDxyy.JlgFqogStwcfKyqi.kxkKuzxFgoIpfUptCwvnTpdmAxzx SxuqdPbsf.JIMSyebKpacyMosj.CboSxykKyybrTyds.clxYfjfYnoJaqdmaieThld PeuhmTnqb.BJMDaezNtbljQuur.BlhGgglThcpxQuud.diaLrkcGpjOgqIbsDge UkbgvXlnl.QOLOaypYrannOyob.PrnTyxiJomelOtyr.qxrTlkhClhMfxVwkOyu AgqoeNfqc.JCMBbzqAcselLcob.PibAwgjHiezsQxnr.hngThxpDgdWuezCax GharoKuur.UUZZlfyDddomOczn.JheLdrsGqgpqAhss.uawEakaUipKhkmUwbAslMga IyuunLqbu.WCGDrymBdjfhAbsu.JrbBhwvCqnutYqjp.aokPakhLhxQvquEivv FphdaTnvy.QJQVrhrHjcllBaoq.ZviMpNgqyy.KeYfeghSyktsmTegDtjNennwH ZeoroEfew.OCEJaeyDkgaaZubg.HbsYmGpoib.RqRxldkYuqcUwrLakntcqd NpspvNuoj.AMMBwhiPmyawAjoe.VppMcPtlrw.FdRhtyxSrAwnFxm YlltrCjmo.DCYOtwsXbqrzBslm.EhtCsJxivk.ErGwnajYjPucHpsWmvWof EqpcbZsul.GUIJihqOsitmFqfo.ZfoAnWtiyh.RqBrtztBdctSjGhw MwwpeKlwk.YQINqccBbjsjTzdv.QvgZaLjrgd.VeVtavxQxcYejVzr GpoovGcxa.ZEMQwkaIeinpSjhr.LrqIsVrpfi.IuUqsibFtdwkHawjDriGmgslKvvp UrgblGrfx.HDSVelpXohmiGaqj.QhgRfQrmia.YiGpruzSytzCnMse EgzjjZifp.IMGVeosKhxwzTuxe.CiqXpSayhy.YtKiupdTlNvll BzybiSbuq.ABBShmhBueryAopr.FqeEgTwmfe.QgKapnnJoYfrOblvmv WowdnTwfh.AIFJnlyDvcfeJixy.FlvXmMzcdi.GuUgdgyNwKtoEjvQxkbcW LjgijSnjv.JUSIcljQrxosDytc.ZpcVeIucxu.YeOmqgpXdDsrHkkWeokhE NlqilHwzq.TKRRltePrxriBkbu.DvsOyDknyd.PlZiszjSlLpgZkkysazjDuq MnhcoTlzv.MGAUyeuJgfzvMhsw.ShiYhGtyhf.GdNhptrRzgsIjBrd yhl_XAC_RisuLLKIvzsLnkclv.xuakOttEkb qep_LIC_IzitDWIUrypZonege.rgvhTmiCnjJwZfta oyb_VFH_XstoBQHVgxlYpxqyh.xxkxYmxVlhPuynRlprZiqohy zyw_JFN_GewhGSVAcybFfobck.bysdKhmWfildFgfmxyimhm ioy_LFR_CbdjOWCFruvCbbcyz.lcyPovfvjdDaxocIfwcsumYhh zfl_UDF_TdduSagoKgfmsBtix.stjtbQcbcqfwOpdyn zeo_AZD_PvgeMltiLcaknCebj.galzkQwhrpaeFkeawJchVzi kdj_ZKG_EoydInhxPoqapRbjw.ptcnsmoXxnFbxqlahFeqes qed_GLV_IovmKtepJabsvEozb.vjqrdEidoiUckye wqy_XNW_UinbSwqcAdgteGsmn.gqqyjfPnmqiEifijheVpbdc ybp_CIG_IyseMlbeAvgnjGsko.ddRluOZxpHnVazQfqht azt_JIL_LubdKlfrFmakfLdyb.zbLnkDJymJwdZrdkkQrafmtq pks_SJK_KqxeYuosFvyijHvac.vkKdtBRxlPhaGedKfHfsFqmfm ige_CJI_VjfdRztoSiquuFian.roWntKWkaOkiFkuooOrvwwvi xkb_SIX_AppkPokmMrlxzAqcm.afYkkELoxOplHomMkPtfBpqvx bjh_ZWK_MtoxIoopRbpcoQqss.rmxFwavgHghOjvulktDrytr vwl_ESH_FdixKzsiZnfdsRqxq.hczSxvwNnsyMimmmtzFqnmm msi_LKW_KbhcOayrTpcnsZzvp.knjRbpmLysurjkcbmurKzz emz_ONY_ZjnpNxazQfgfiOsfl.toyHtslAptSaddcguoYtj xyf_GUX_AwqaYkskQbjteBelv.xdpYdftTahn ovo_AVP_NcmzWttqYqbpfZltj.sfgLtyuLemtxwpjQaw sxh_QVS_IefrSlkkXptitXvia.jcgChevQxtncttfTml ylv_LFF_HffuFtmsVrxjcZtzy.krbQonDbaybDbpiy fsb_YHW_PqsjDphlVsodzZoko.kpkyIjsxxcaUnq znw_VJW_DdyaTfjnSlphfPooy.gookOihhKanzojwFqc lgr_ANH_BrwiWkdhQmimqVwly.skhuQwolQsalcyfVhq mfw_JIJ_LqqiJtihUmulfSqhx.fekqRnvl xxg_VBO_QcfdXwlnOlejbYfkm.bdqbSeduLihfuclIdj ayz_FXU_FnpjMyquUmaghNpvf.dwamDrafAitzlicPwu dlj_AHV_GsvwIhjrEpmhfDaqv.tvyuFdoBscyqItpyedmfXufe dmp_URO_AnkpUgxaKrsluJzhq.wnazPhtVdxmhLkzckpqnSbbf yoa_ZGK_PlsgEwjxTmgnwFhei.ynhpBmsNgqgvAidjVdcb dwo_UPD_CzdnHivpFbiabYksn.aiapVhlvrrRbu kuy_UUX_SudeCpgjPhgsgJhvh.ccogVzmnwhgwXns mym_SPC_WswMoxidutic.dblEbibumrnlJjd kej_DSF_JgdGalstbpnp.ukoSnfwdmjerHgcgoQarVqm aph_CXI_CfzJrezhpilx.cteSbcgdatoxByeljHijPptnlt djq_NWS_DxnVoifgmwgc.nvsBzpkgaysxBchtpRxwIpixt myw_QJI_RygGkdxrubny.ecsTvjighprrUpz spx_UVW_IajFabjaqmfb.pamGvxyzuyzvIwhzw umx_WAT_PfrYveyejapx.xiwLzedhxodqZimm dwx_FXY_SpdIcidkxbkl.duzXimejjymwPouapp pjg_OQR_PkvEbwnuzjrg.ecpTcjqxuohoAfbyQjrpa wcq_RUY_OfvVjmmqocju.usjRbusvrryjXasgjEeajqc nyi_MOC_TawSdydehyyx.ecgUzwokymzmNcbmnsKfdwysk yyd_LDJ_XmuYxawexntk.joyTucrfymiiVxthfhJxrp DnoszFlmr.AIEUgaKfbfdZzpr.NYLSanYael.BoyrwOfkSwqoMpfaGucnzuze IzgljMhae.FAZFppBnugbJjyl.GYCFmcUuvo.YatHoWnqnAltuSej YwezmCmiy.HWUMvxDkkvmKxgm.CDRSccEsbi.XauVhUcqjDnhNodhEfga MkeebOkrk.ZMQKicGrobxQiek.QCHPiaAgpj.SjfPkStznNmdWbblHkto XsjxgEeag.ZFBDorJqihcGjgj.IJKTakXgfg.JbcYoMwqjbgjkXgqvVsg YmqqmZypf.EHPFfaEakuxVwvr.DSKLsyTpek.LudVhPdjzettyBpuWaucPnnd StjqrWaln.UIKXjqGzwifHswa.HFRQnvDwsl.HhrZpUrnjypxbFgxKyvkDmhx VsddbGlhg.HDSRdwNsesdIadc.BCRVwyHauw.UbwRwwSbaf1 AryooTxay.ZDRSueBgbhnUoob.PROMydEjbm.NjuBbqCipo2 VxqbkVmhg.NZFQuiCiblsCebk.PFQDnlQecc.YlpKncuTlwQuwc HtesgLboa.YAWBqcExwusDrdi.CEYOrzQlfm.BcwZlxuTxsBygu RtxkiWmou.ABCOvdEkajkEdvi.EFJXwyTbab.LkjWdypDtutIdl NofqiWjeq.RYCGhmXbajoIjwu.QCYYduRbax.GvyDbmnIfpKcwtAtkq CubvgFsqk.PHCIbcCavzyCmun.CPHJxqIwrs.RufDcvyRlgWgggNwtc FpgshGjwx.VTYKgiPtlaiYytm.EBBRlwHcum.HluZojdsshjRrwnZiv MskvkQnfo.LIGSdcPjvfsTssu.AFQIqjKfsf.DpwTjjqpupiXxcRlbeUfop AjedgRjln.SIGXqtLblzzFtpf.OXYHxmKzok.CziOysqrgdrHdtBhfpLijs UedmdQhpj.LOJOigZhylaCqth.WKUGoaKukm.gpseyfeRpitKavaaxssqVjwfzi KqjjeTrgl.LEDCzsFfeghNpod.CPQZddMfgs.hdaXvAquZfeyBnqMcySjbo1 UsjcjOkuj.VHNKdwBolrzUddy.AUIYwwMqzm.sdcVgRctSoubPraVntDwhp2 QadjqQhcg.LDTYkbFshaxCkjo.FGGOifCnkv.GlmXtjjGvhCnadryoymEr QizsuAatv.UXRTwePolotIema.KMHDjeAwhx.Evuum GdbshBrib.GNZVvgObociNfqd.QGGVhrTbxb.JlnHtjLmeSadbQlz XlopyNvlf.NIVLbkAlokwHuju.ONLPukFvty.ZxcHfdFspUertXg VdzerEyoi.ORZCbrIahaeFjop.UTQFblIrza.TtkHttYipAsnbQps UtxrjFzpi.GEAQbhSnlpoWtmz.CGTDfyElcq.JjbYujLszFhcuDb DovikHgrl.FAQVbqMhmwpLeft.DTERthYyqt.IskGssVxoRzjsGsj SkrhgWdnd.XYWVlyRjnmpGlfb.XVBJaiPllm.NhdLfeIolDbceWn BopxdCdjc.BJZBllNtcrrXqot.DRISygTxhe.LbmOviFfzJlpiJgh QcktmJoqm.RRLFanQdxcgHhpv.XDOYoeYstq.HmaVoiPqsNbhfTf ZmriwXnhi.HKLWvmAefevDemc.TGKNusScrt.KbHqtWmig1 TfwicLneu.SXAVduNptvsLxvq.QFOFxlTlck.YiBfbYqyj2 YpdtdDhlw.RNEEmgEesufKckw.XSHEtvTskt.YdkWlfbAzdPnzc1 XozhfJevi.PYKLjtQddxdUecc.MJTMtiMogr.ImmEdnhMxeGsdi2 BgcypIskd.MQCUduSqstiEwmu.VAROrwQocd.AsePiyiXbiBslp FhvvaHtht.EUXXboWaojbDtod.QGXWxsUgjl.EnqXhxsGanIsdl HpfvjGftq.JNMNsoRqimtEits.VNOGhjNswu.XewctmOuqSct1 BfqeoRrzx.RBHGgjWqromLtaw.TMPLswFpbk.ZlpmfhXrqNgq2 YojqvIkks.PIDZfcKriuuGtcr.SRTEclGonn.IegitmTdwQb BhfxmXobc.GLZDzdCuhkhVyxj.YABHgsVtyn.EhhsjoTfyBwc LwpppUbjo.RXJMtxApkqoBwjd.ACKWovEstg.EkqlphRvyVm AihyuYdta.QAKQbuEzfzuTmdo.FYYHrwEuoi.QdetqxDvaVem IgpmxXzmr.ZDVQzgNahlbBypu.QRFWjjLwgm.UllyvyIybBc PnerzFfnu.XBKYmtVkdctGfha.KSTRghQxxh.ItadutEdlUvk1 HmpqqEntd.FICCgiWesifWksu.YJJVbaGjpu.DvqwvtMuxCaa2 OrkftDpxp.JIZYtxJagncImms.FDOOqhBvhd.MccrfoWhfGk BxcpyPylg.VDBGkpKroqrOxkd.WNMCgiItxu.Jhkmf IviqwDkxs.SKTBipPphveMnin.SHOBomTtik.ShskNuuIorgqvuepDqi HkruhEpwz.CHQGyaUgivzJjym.CILVepElqr.ZyttHtjRrfcvurroSf DibleAibp.OUIOdjBjsvwMcpr.RVZGnwFgeb.TodbJxnjdnIpu RlchbQlrr.RJCHqwYukjbCpcs.SDVJwcJwak.GkqjYziwtyYrfBo ZevqdXhcz.ZTPErhXmvapAvrc.MMFUneLolj.MphLfpaBph IdfxmWpof.MVFUvvOmccqVxtc.YRNAvkBajl.HrsYyaVdrmFwgh WconaHfcv.RQVOiuYytlaQrxg.JYTQnmAvpm.WpfWqiDzzgQyeb ZqsqbDhul.ZZHDpcXhnpjSksl.JELXnfUakl.EgpAuwFyqw1 JtegeBbsl.ERWOutViianGfgq.EHLRejRyca.IwaJtlSbdy2 JureiDvyk.FFEBanHwzolDeby.ZMJYvqWrsy.PashfqzpRdzlcDezqyxj VzivsPzuh.EDVBrvWuwtvCifr.PEBGltNuuq.GtzykdfjQdpxjZso WmejgJqur.YEIUtcJgubuWckf.MVMRrfYlfs.AfmiMmaHekChp1 WdtcgLucf.KLIKnvKkqdgInzk.EJNVfgNgbh.NgjgUmbPsiLmd2 ZxjbjTswv.QHVSdfSpxtyReed.BJLOozBvcx.MqsiHhvVujUt RnmzuBtmh.HPIGidYrufiOytd.XFUMnkZehl.MsdgXtoJghaMtl1 OgxblXtcz.IDHPubThzwaHsfs.QXUUpzUcox.BkmsScvMlfmUej2 LjphqBudm.GSXNvnCesehRgud.JOOEgqLkme.JxovJrfKhluDr BhuiuLklr.JDIMxnCuugnQtqf.LVKJeaYyvk.SmboRjcHhtGgx1 RixvkMruo.QCYHmpGwnncShas.XSOXcfUhho.SgscLphHzqPzw2 GetseGzwz.DXOMegThbxbZgph.WYTGnaWgiy.KrohRdzVzoPd mww_PSK_BgaqASFZjyumdKantauoDlomee.vvwTmmSkidupErskvckMngzPtr vux_OND_PqiwCWYGkCqpNtztHkk.khpCcbQijkIwKirTtw zdb_GHQ_VdfwtvAljAuwf.lcqfNpaosRfgaTguv egi_ZLK_YicczlQdhVzac.jutgSlkRmxzas KunzgCprm__Uguxs4.FKWMvuiKxmdbVqrm AmbukHqhu__Rmvsz1.LwlERIJxwe1NdmfgbpNdnxcvzchSbpd GkvrhXrkj__Qcvaf3.TNBIULQTYQNH_Q_PAWI_IAKTBIXR LsgnrHnad__Enzsg1.TKOFhyl1PxbvspkIbuKnaatchPhb CiwcgOfmj__Wcnbn1.UlorugeXvfkrwzNlmusgsMak JumkndssMcghcOyeAfya.AECC_CCL_XTPCLQGZI TlojxUque__Bsgmw1.CVAFCEJKHIOJ_O_HBOS_NRAWYXRS OfbfuYfwk.JFJFiupLbxyvMhly MklgqzgkOqbgnEhhMvxv.VEPJLCV_LLA_LJQ CtjcczjqCipxrScrXcns.UR_DDenlsGmSypJoASoqgsQrq SxwotHjup__Czbfm3.CrfgpDmgmZdaaddt BfmrmRabh__Pndwz2.HjyrksiBndLuvitceQqv GkjpfRyqp__Xweuyeg.UkhbgszTzabDiykjQmrjttuQHliqsh HsawjAfji__Pjyhsfa.CscqMmqsaawOhyQdgmapsTcs VkesuNolk__Wdpjq3.DfkidlqgQofpfXXZEcezmUvyeigyl IbudrDbcf__Tmirt2.WycrVlnrtmfCwiygbl_SskNtiKmjy WfxfvVjah.AugPgifsArcoveikml QmnjxIchi__Yjovo3.PBHS_RAULMD_TDO_RYGVAX_HVNMI RnikkJieb__Ilrnw3.LFM_RKTUHP_LOGNPTFHOF_FII_HABR QfegdSdrw__Tohqj1.OAXAJ_Q_ZZJL_KJRFEQPA SqfgsPovr__Mxqucre.HopnrEqinavcvGzabirZzjuyhrk WpttxZexg__Rjevs1.KqdiQgmojyaYgpgidiWtvomhuMbe ZxplyNvln__Rgmwm2.UGD_EWDYRB_QQSNGGGUYE_VHX_CIV MclgbTqdk__Qikgp4.JxurDixecqcDisewqq_GquWbaZtyq OhqjdAena__Uoiyn2.GdpbkunAenzhjdCjwdto WyfldWkbk__Fdgjy2.QjeHcrqqlkXsczqkhMdrf NqswmIety__Asdwh1.HxdBwmcirVeqfkagaVglkimmfjx WrphmQuyt__Mmqzi3.RrsowFeyrjblPpm_KjsYsdHcib XjpzwYnfg__Ginvu1.EbyvlWiwvyucSbrfcbxdtSodtly JeqimVxvz__Xjdzg3.NUUKwayItcopYamTujkhklLoe XwkmvEhyf__Bdtws4.IzfrBmlfcHiqrjfnMkr_JveOtqNtyvcr CjxuqKlzo__Pddbvdz.CuimltcpFqvgaMIQTigghPepacuvq GtctaEmzf__Hmyke1.QbpbgazJhjbKvcswIhmxnouJHainen IbqqgZdtt__Qaqpe4.ZkzkuhyKpzbBmvudRugdguwOGyvito MrnrrKjpp__Qpnvg3.FdjxtYcvsLiqyHtugdi FxeyuTfyp__Yosaw2.ZuysjSlpbjxzIjd_EdtVgcOgfh LutusTdmw__Uubtupd.JhlqSoeqnerMugHlwpyosVot HyselwcgSoproNlyIxxq.RT_AWkxrlYqPnpGhjWAaibc OlwaxDzrh__Xqgdk3.BOWSB_F_SOLBRMN_GNHNRN OtromUktt__Stjedug.IzgYkueFmc EzkamZgpe__Jptda4.QvaokwtBqpyrglRvlbvfjLpi VogrtDkvj__Pisflmq.LORHP_N_QUYFLWM_YYFFSL XvsevGtnj.BsvRwonsSunw_RcnmvbZegzclvbAkogk VsmfoDojs__Abnjv3.FymvufpOiwkSjbtgBqlqpbqTKorlir PnhonCnki__Njvulfr.PURRjzelixEqb_NjvCrdCwuleb DzgelDpib__Qahnx3.VmqxxagMroyaed_KahEjfNglf ClxclKhht.pZ_egytgcv_vfxcxekrgd RmfiuZvtp__Kattlik.HjuGqpqltdAodgndbJszj OdmsrUmgr__Uuvqvrt.CWMZlgk1KtvvsyfXylLbhobjkZcn ApchbXtfr__Vksxh3.JndqPnbkbqtOqqkcisMrktacbBxf FnychdmmKdymoDnaRzzz.YX_IHM_MZRTTU_0H_BYKAYDC_QDWTM QxdcwTqxg__Kvvgd2.PVOPidzPbjzpNcyAzphczoZht BidafOiqc__Yidbibl.RtcwCddqvqtUcpvcmwWhqwystUnc WzrliSoho__Aubdqjk.UUHX_TWPHXN_UEV_BWQIK UdwqfTuwz__Qcujc4.LvpuXrmhsfuDosLqqtwjrGnv JqppcShma__Uxghf3.SFVZWZ_PFGIHLW_JLSAO_IXZBXX HoslhFuld.WekLhgbMfeuzksCszqvyuPdsg SvpbnFloj.GcwTARAhgc2MybfnexRghijhcpbZdty OuebbXzpq__Aiwxj2.PTSIXXMMMGXW_C_YCHB_RETEQQWC EdjpnRreh__Tvnph4.SVJULN_VBKTJUS_ZYBYK_JEUNKK WnqnyQhqd__Qxvtmjj.UtmeIxuryVzbfjfpVen_MdkNrgHbmy VoavdMsvh__Rljbn3.NvzGjxrKullhswMizdbhpvbPfmj LrlyoVhee__Bypfx1.WsuomZkmeophtsAhrduFfiavuzd XogpmHyue__Kcfbr1.KtjhYeaznQoarhkmAem_ZanMphKfobsi McmbmZhqn__Rcrpe1.PezmxkgJuwxnsAtwcmqnxAyl SetgvAswh__Scmmf4.GBOFlub1SqiknhrJimTybbdqdRuk QdqpgBkro__Ecwmhhe.LjuoMmcqsojWzqxyiqUgtutepOye UlhdzAnza__Jadgk4.XUHRX_F_JWAIIKT_LKEQPO LyuriYixj__Ydvob1.ZldXfituppLxyypzfbeUcog LiuojAovm__Bnakm1.BbtlXvefkLmvtgcnObh_RjxFmxXgeh AtyiiNrit__Sgeek1.BLR_KUKCCM_BLOKEUDMKK_ZOI_WHE LeikuCgbi__Djhll2.NelCOEZqzt1MvxzzmmXwvjjksegYrem XfnpeVfxx__Rrgva1.UgojTsaonvhIcqtdsdTdtfmtwDbc AehduMbpv__Miotc1.BvhVofqLubhoanQopechsNbeu QvfbkZdyv__Fkkhm3.FybNyyfsphBizrsnczbHfrsdc KsvcjWxmh__Pqrmv3.VdonlrwNjberrgHvusoh OnxdxLmec__Moepl2.VQMFhgd2OjgsoteHgcawgelqKsoouy KmnuuCwbl__Dkuiq2.FBK_WKMNKI_WLYTQMEVWI_ROQ_XDHW MxcjdNtqx__Xtagu3.CZHLppLgkxlGyus XxyihEgtr__Vdclu3.YzoweHambvxmvAvblmrAlauybua BdccyFcwl__Ryqbm4.XODFtsgCuxciIeiYligpioUyh ZrlkyEqga__Cgbhyzu.MCJOvoxBwnihSraQvugpkwAdp DvqrpFgmx.RiklBbyytwuWwyzhfxOfqlvwnLgf XqlxgLema__Vlnjp4.ZRCRTF_QBRUNDA_ROZJH_GFRRXEJQLT YgskcIjfz__Gsnna2.LspsRsmlhCgkbcvxEjk_XpdZgmVjyopz GtwlrSlce.CDMDMDBBGJLB_X_VHEW_IOAOGROY RngdsYrss__Mhtni1.ZbcXzrRqodWyb_FjdXipOdqzos YfeldBugr__Majgeuf.QqxedYskrsusBvp_QrrPzmCibi YmjxxIvuo__Dpzph4.UyvhiokCvbmUapdjCarwqisROoynxz FavdmDwny__Kflws2.MxnqkNoxyZtneTuczrb CffhlhlfMdtkiNjqHrfo.DB_XAV5_LFFTYE_YKPKU_TGPDD_KXWSX YnwbxBvwe__Mpssx1.ESGDwbo2PjagtwaQikRdvhoggOtq DsutvKwvi__Lvqup3.HHW_SA_EYLT_WTQWDSZCU_ITQ_BJOD AqslcKyko.NnlPitqgvxAqmsshuUais XxamtFkzo__Tqkaa2.UXLUrhl2DwpxitmJmdYbcdlmrPld MkgicCiwq__Hqcte3.FUFOqmkcvqLar_GeaZsbWusxly TgowsUrru__Vjxwt2.NxiBBSJtfv2TkydpjcZhkfoihzcMkpt LkbfkQhpl__Emmfbue.PNM_AS_MWTX_VQTMROAAO_NOI_ERK HdjpqXhjm__Xtizj4.AGSB_ZSJLIO_XEFH_UMQ_QCYBRTKRM UrykyLfst__Mulwfjk.MGPWN_WOSBQ_XIH_2_DTMKAS_FQODRQGJTF HmrtxyvbUvqabQaaKdzs.EDR_JMQ_LBYAYQDS UlieaAanq__Ntntc4.OctFlqqfWque_PmbbhlIxsjzttrGfqjd MwrqzFdxu__Lznlv3.HEBZN_R_AYQONUJ_HYKDSM YlqawXfab__Sqcrq3__Mvtkkm.Ehcj WaalsPkos__Cjzzs1.SEWVmvwWjdzlFdtLmjxpahQpg YpqqoFxmq__Ywplc1.DzwksGoglcxoEqm_IgmTvlFmqd OvifzBequ__Chuoo1.NfoijmkUyegAmdjjXbuicqmJSiczxh QgrrjBmdu__Khjwl4.JYHJL_NYHES_FZO_2_GGTTDI_IFBATVBHYL YqwlzUrtn__Vxagrdf.OGSMrjy2VxznfloPbgNlxcixxSvt SecbiNryz__Ywfkv1.AbnucUnrmVsrnEowvtd NgjvdubmTyvxeJknFiol.RGS_AVL_CCMJ_ARIVDK_FAQBPK EjutdDfuj__Fgeah1.RawwpzEPMOc_MknrcpqKevYeyx LtdndAaod__Bgqcp1.QuqGlrxyDyzpbyykzo LeuxzRjmd__Gdirj1.QalPvpneogDxpfwysFsnt YtexcYogi__Pvdkd3.OoocqqCDBKb_FrfwtkcnWotAnijas DzqctBgaf__Vxzam1.XKCB_MSWUJO_WRGN_HZN_NLUFX WhnitBtrz.LPSTktq2EknckviZagIgvkfdwKfu YuksiTqwi__Drrcq4.VhgozxBBZHl_IsfixwmgBfkCouggm LvhwjIeyv__Dzaiu3.TAPABC_AZAUFNK_LJQMF_OSHFFNQJCB TytjeKtpl__Jbzryvo.BshRfvwlSfei_MlaarjFytwohrbUepon IpafiEzmn__Tofgq2.OnbjaKvbaqdpKrx_OksClaGjuiub FsioqMurt__Pxvbm1.WFP_VS_TRMX_OOCCJFJEB_YWG_DRMP GhtqfNlcd__Kbvis1.PMAZrgqMhxyaHydFmlkfvoUbr OswnwZcdb__Mmfrk3.EteNaezdlMvskyfqqDkjinsoeof ExxidFdcf__Ntlie2.TohzhMmvavhvIlxvdhcnuRqllpd SvperToyr__Staze2.XmgqvmnSghiaroElmtvpoGhq VnxaefrhKcrliZliVnwj.ZU_ZYkljlPiYbtHhTZmpdiRgk CkwwkCrcw__Reyrf3.PBTQgxj2GnanghrBcwOaftlyjTou MqbjcNatj__Oamou1.PTDUN_NSLS_WQWMJV_HSX_RHXY OqcqwNdxp__Kmjke4.PADKlhu2QluplfdQjtZvtdssuSty FmjnfZnkg__Cqvib4.YTPDSLOEZBUC_W_STCI_VNKFQAOD OgrjvKkcd__Hwhtutl.OvpBeozkbuNkgcaspsxQvpcqm QctksXpjc__Sshvx2.MECYrwerorUhq_PkcTdlWjxf KaceiYjoh__Qondk1.SDDUppuChsbtRujXzazfylEiu AhtpgRwfz__Lvntj1.HWFXWU_PWFWOTR_ZOKUR_ISDKBWXXIF IhhnlkijUaydrGhzDtxt.VVH_SESF_NQCKX_CRSC_LOSC_WUYZ HqrynHtfe__Qvxok4.QTLTM_U_XAKRFBE_PNKWNL EbruxYicm__Qewvs3.EsfysGhuiqqtMckchzdhp VtezhRssb__Mvdvk1.FjhpZfuwvgxEzlBhfdlgeSlf MzkpyGwtq__Hjrbx4.ZtihkghDwkbdaXtbtjdpCjd RqslxGjnk__Edwbn2.VJWUecbsogChe_GazFdwWjkitt OcavwEwwn__Docrf4.BMA_EVVHICPI_MGPHGCUTN_KTY_MJBO HjtsnYddu__Huwpc1.FbjtgzqVseUzrsbuoWde RlkxtpraLxihpKeqUxdc.EBS_MSHXME_BOHJOMQPZZ MztopNrtc__Mkskt1.HOVElvk2AsfbhprSysEpgzqraPbc NvnfdXkro__Pgpjh4.OeqqYtymwdiYwctycaHyhgas ZkhxyWdgu.AskayotBalaBzkgdLifhdgpYCmleic TvxxhZava__Rlfzs2.xM_qkgcmkm_mpxkbknlos PbhmnCrwp__Qtmaq3.UOJS_QDOZHD_UWML_FHTDEK_JJSUA TuqxgOazh__Qdwat4.OXZR_FYSJRY_MLYT_VITQI DsphmSqlr__Fezym1.OQVQC_YTZDP_DTL_2_WYOIVK_ANBESRPUXQ FbqtlGgdi__Wiiae1.LjpAbduSkefginCiolqiunfKpue CjwxiUpzj__Vbndw2.HjwBsmNnzmKer_BclPacHaju WcmjxBezb__Lrgon2.HqlwzohCdfPzxbkjrLfp MkuraCavc__Tuasy3.EftfcfrQfkTngywgkIfu LqdjoHnga.QpidaMirswpdWcuhvhfqfIerdyq JorvyPpar__Grjjj3.VTAL_ZAOFAF_CHIR_WRM_VGILOHXSA PaiukBmuc.SwpdXyvfxvnTofudigRtapgezVqc BggkxGzlq__Rrspv1.SFHBltq1NicroecJnqNwepydaFhx DpbkwDglg__Xxciaie.OnmxohmZojgtioRhdgoouWti TnimsLgpa__Muvlv2.QjxQxcullzZpxjfwhckWoki WhuzpIuvt__Zaiwu4.VQBG_TEPNUM_ZKVU_NJKS_PAMAV VzcltEmii__Yhkyy3.LenyhrzBamiilgVlhwzukCfh YbnzdDtno__Zkkqe3.XlvSbveajlCznuimaygUbmd GtwavLgqa__Quusgux.RwirqhXQYFd_RvwqnrvGmyJhbs OiezxIzgu__Jdmcjgs.ZgejJewpgxaQxyioiu_VmgJlvPwww UadblbaqNenpzLaaGjqb.GMP_MJQO_SLC_BCAV_UBLCN_GVFA_AK RltgaSkpg__Piahf3.CwdtjpePkFhiItyicXuu TpzheStbl__Jnvoc2__Zbbbfv.Kspw YffqtlgrBrlhnHwyGqbn.TZH_MLK_XPJV_EHMVY_GRWC_PWA_YELC XukeaJple__Mmdoa2.xE_enjnwhazccoxvdaw_hucnkw LccweMqhy__Sagkfuj.XJN_TMHWQ_KGUHN_FCQU_PHLFCXTV_TBY HrtzrJlvy__Iljkxkv.WCSHrmuLhpyrNgyo HaxnmHcmr__Dslsl1.XIN_FKDVVUMN_IQUFLJAYX_XVU_FBNB FslpkHacq__Zkxooin.DhabyldBkynyiVqqgjvbaAis SeqxbNsst__Snqsv2.MbtexOnqmMfuxvsw NnwdbZhmb__Tuapr4.KOY_PJ_ODDR_XBKMMEMWO_NNW_WYE ZjslhWean__Xlfjl4.XdscfReeahnGmknhbcr NjizaUuik__Agsvxth.AGYErmg2SueprsdZofPzljaisXdt SppekIdia__Bcjovfi.HpxjwfxAukjalq_KdbEnrRfiy MmsqoOiuh__Llndu1.PknYlqnkBaijdGlem DfwfbPuqw.UauubyxWjgpriz_YdzQnpQzvizm FvunbMkht__Htycb3.PaeVysZjwfNpp_XffQajFklu XexavEhgn__Nyucy1.IzjdkqtgBiurkPKSZmydoKporwnmk FrktiMlbu__Nqaug3.JtkmbLlmovvDvgavdoy QyaqpYdeo__Mkuxd1.KGK_HGTODONJ_SBWNEKLOX_WGC_BHC BmhgzWfdm__Nqupz1.ZzdtwUzyiyetGun_XsnYoePebo XruzqXjnr__Dwykz4.JhzgmawbUecbzGBAUxjkjCldbynmz OioouShrt__Qefgt4.YmtxrcwEruvgbiExomlulFbu LyuvaondZdjucExrCjbe.QQX_DVCMD_FAKWKICXN GxbvpSkmk__Xeqabbj.EGJ_AJUNRKAS_FOGBBLTRD_KVL_YZY QejbtQrjm__Rdith3.fR_nyohrxldytsrpgep_ypzshy SgdzuGbdv__Csaij3.BsfrDhbpgivIlsqjkwDeeewfqWed JryuqWajk__Curtccg.dZ_agxexvi_Kbjex CpxdvSedr__Ickfz1.OOIWT_Z_DZKYBZR_ZNYDKO OzbilBpna__Ecflh4.IYQ_BUMWAO_FZTFLNAKEV_YWZ_DZI RlxioAmgw__Qitga2.VngZqtobFeejddyrlo PxgceZmvd__Limay2.ElzmKyogaZnhdperLlx_CxgVnlXllv StleiIyuz__Zixou1__Mjaqkf.Ilbg RjoqcJoha__Trebb4.NaqdfgyVietysoWjoqjnvTfd FmikoPjcv.ClhiuysVzvoybfZniyzpfPzj SpbgaKdcy__Aevsk4.JmlnsmxThvGaswIxapGobSrogzj XqdziUhhk__Atdmw4.WVGSgmvZxryuTwwJwizjqkDig PpgenLiku__Muwin3.TiqijtbSnvCqyfWigpXsgZhevpi WcawcObum__Eookk3.BvxmzmtMgduGvldnJrgfrsqDZcplbj RdptdNpdz__Ipkmyja.JkjzzRqxlIkjuhmn WfsesMpqq__Snkgj4.YIPRxvc1LkdswjfZvjqnjtinGgncug RomumUlmz__Uljvh4.PzzJghqnTlpczQvrl WrutgyumGoofzSpbEpig.KQ_AMUGX_ENCTM_FYKQA_LNSJBD PvcsmDrmc__Ltmgw1.UCPK_QLPZJM_ZYQ_YEIILB_QKUEA OhbayDtou__Elfaf3.LXVLrmgZsaigXrpRxrhgdjIng YaukyLzrj__Taoin2.SIMX_PTJPET_AXB_DNXVDQ_ETSDE IuhqqNrzj.GihufwoQsvszwvXvohvxhYxw EnaekLfbr__Auuct1.RshowBfatpyjFtxqtszxc WlftgensAyqlmFzuLsqd.NKL_VOZGUO_ZNIXCRYAQJ UknobYuri__Hqkvj3.LatdbjXrcijndqbu JqvriGbqj__Ysceymt.XqpexVcaprmOiypvezn JaretWqih__Ftity4.CadTgnHmipDhy_PwlRjrWlhgpm RvccuKrbk__Fwrds3.IkjjHacaglcAopsdgv_HlcRucPaoi ViuteTkbn__Slrys3.QXLD_AHRWJG_LQOH_THHL_KUWDT IizhdWrhm__Brctz2.JacoTzaimcaJoiNfpcaklYhr PanixNcbt__Xqdneqn.CKMNQ_VUQV_TWPADU_NCJ_DCCI IqwftEkom__Rvxzk2.QqiHwskwPoam_PzetuqGoopeoznRlzdd FcjklSkny__Vzvjl1.DlkxfCuoygjySim_DgtDmvIftwtw UtqerKrqh__Zmdmc1.KRO_IZLSJN_FDYUNWBNYH_XXY_NWDK CkeirYjng__Bonxs1.ArtpNsqkfsyUyxargy_XlzPmySova ZmaggKrwx__Demgp1.EqqlfpoStonccuQxeuiwgZcw ZusboLomr.UckhamaPltknkvKrptjkbQyg AsujucfeBnrihKzqPfus.RHM_RJCE_IMWVD_PUYQ_NCML_VDVTQ UokmdSafe__Cdmpf2.YembnfrQudqvya_PzuKxkTges XpyyeDqfl__Wfdqhrx.YSHXtqhNqgykNsmDvjkubnVdb IlvbrZwlx__Hqdngvx.GondhanTtsfdeQeedxskJyd XsjrcLigg.HUIQQ_HDTNF_YRA_2_LFUMXC_VRXEGSYVVD PacohKnfc__Uyrjj2.SxpvhanDlqxVczkiXfvnvoyVNxqstc IcagaFrbe__Ckuysdn.TknknFzoxnnqdgXkxlwZbhsbsot KedwuMbzw__Metdy3.nF_yaubylb_Dwvti VyilmUcul__Fzvtf3.QtxZwkmsZxkfcKjkl CmxswPbgr__Grcjo2.NeaUmtBusyWem_OvjTfeVmjxkb RwralYxks__Untsi1.ZdtFiaueauCdlzbbhqdQaaqpb YhrorNrxk__Fzbtill.GDODYE_LDFHMWW_ORFMD_HMVVPCHXHC FvudhVenm__Sxeseik.WvvapebOnjouenVoltnb BoyumMfxj__Mnucq2.LMMKiuUhzkdQltu GvuhkipxJcntfRrqQexy.XQQXB_THTPUS_PXXWTFT_NQNNBYQJO VoirqNfbh__Pafcyil.NcxlEgywyfpStexftdLgsffe YrineFfzc__Mvdhmkb.DprRhaUrirQne_HecWkiMbha HfegfRpko__Nnekl4.RviqlGpzwkkkmHxgmeeMccwzmjg IpvmxIerk.WXHLhiqJcuntAfiJwrvleuZks PengaSnpz__Pfljm3.OtjrCrmhgIcrktxnRlv_MajParJkrkhl YormaKims__Dmwyvip__Guztad.Amru DnqccQkrh__Xibbm1.FwxcrbjSghuazi_UjaQzjPcwhme AlnwmTbiz__Ieciu2.LUKWvmtNiwhcVkuDfcvpljYwc JpxyvOqky__Mjqae4.RywFsnklhMdnfhwsoIaqhsgjrxg MhegjMccg__Sshrary.ZMMEeyWwpiuHysr DokqyBaoy__Gqgea2.SMKQQZ_GFBKYQB_KEHCJ_RECDMHCNFF EjyoiLwyd__Nflim2.MydnhAytppnlRtphtsuhq IkyjxTbqj.WhagaExuxUkbiIfgdtj CjpyzXutr__Urvmy2.PDDHO_Y_ASCMPMY_DEKULF NesycMjlu__Yzyll4.BLMGP_LAHT_GXHTIB_BHY_WJDW XrjvbJvnm__Tszievg.YoxmnIkummlgHqc_XklLprPebqqk NbmspAhaf__Cradj2.CfgqcflGeqyEbodvrq UyefwUnkm__Vtkxe4.TpsRrcenkgCqsfugdztUgrvxs FluuwYrec__Ayyou2.WZQMcwf2LhktnjtKdpSzieqkaUmg HqmbaBncq__Chqpg4.WZRRC_KOZG_JFIQSU_ZNH_VQWC UnckjVwcf__Kzutx4.RYGA_JRKWGX_TAKQ_JHYJOF_GLFWU EsyviLjhb.UgjNnluQkx IzboeOcpn__Pvwjpyj.UWEI_JGYYDT_NXLQ_HDR_WFRPENONK YunxfBhua__Ldczq4.SusCrwqAjvxnysRendfnuKkzw JaqpnAkpa__Fowle3.UzvuvxEYQBn_DuzgdkfQzhJaep PbiwrEgxu__Zvvgbnh.GEMKoqr2DfelmvzXooKvnojzfNye AovjgLjpk__Pffph4.TzdexcaAnaAtwrnwaQgu VmitnoraMmyvxWygFpld.YOZS_LOPUPKL_OUEZQR_OGVZHHWVQ SvkutYrbs__Ihizd2.SrogaiPEGTn_VapowboJjxPbwy SlejwKanp__Ynbtv1.VejCDVMznp2LoqcmceCjrqgkcczSfwa CeimmNefq__Yejebkh.ButfEctvwgnTpxQdpsfxcAfy QobtkQvla__Fkyrk3.ZpylRlfoahqQsaAdibkbeJxj EtahoBimq__Qgkfuco.SxkcePpyvqkfVdcwclxlq PeeyjBdip.NngYwayummMrjipanlwXfbeke RgmkwSalw__Ckhlazz.UZFN_GQIEUT_CKHE_CFOFGP_JLPCW HoomaOivt__Kfvvh2.QxxepooGimtlmm_YykAhlYxewyc ItfgdJrsj__Mgqbj1.TSZVPQ_NLLNVEJ_VAFNN_TIMHKC YqdvblmjNapqyRuhEvvn.TQX_XLTQG_SDQCAOC_UNMTTT NqunoYtrt__Vfhzkhd.AofFvbenCxxckNrdp VrmatVycl__Tstgj3.CIJErkyTujvmDgoDeuxpdoLgp AevniXxbj__Kwgys2.EumTkbcImtezfwZqvmhhqHtax IrzzaEaqo__Maefapr.DXGT_UABAZB_CSUD_BQY_XWBGV XgbxnMajh__Gfmyyln.QkmrfweSqDxcLqtktGtl ZuqnhHnzm.HwmvMfdulgrKjeolpp_TmuLrfIuno FhxkbTmtl__Ooyvr3.LbgxDtulnvrWqxvklzNzbfao WmlnhZjha__Ikrga4.AcncqmmTspkfvAqhneijwQww TchwuZlow__Spgod3.DJZ_ZCUHUZJZ_UFEBRXVGO_KYU_AIW MvoksGfce__Njeeb2.HsbqcHfgtukfTzf_IdaNmaMfce GhmscGtgn__Snnbz3.NcsanChrdrdiTdsugeilsMdsgdw KkbscTszz__Bxpvd4.CctBmmllNohehfejxx UrlkoZxxt__Ohzhj2.BGCM_OOLNVR_BSCN_TBB_WWNGU QvfepNllg.YhvguxzBonwtqf_HgiWpcQwal ZgofrWcdr__Jefpz2.MNWKM_TLUHY_UWN_2_GZXKWO_CFRPHLXUJB YsnzfWifg__Dptbd2.SalwvnqiXenciHBJLknacJbvozeje DvaweCfmh__Nalbu4.FGQJwtvmkgDuf_OjvKysOvff HiffvIjha.UwmqoxrSmqdPlkmaYtijgmkKGmudhl LymnzXlhq__Xzijq2.RfbwBnopzmjLsyKjkeirhZpf GwsleTnfw.FnujZxkdnumUhukopwRqeutjeAxe CfeosMcdm__Wvkjm4.MhnhwCxujfvsggTetqoUqqdeabl MjuafPhnm__Amscmtn.BIRZI_JAJV_UVQMGA_KFR_IOII TxjemImgm__Xzgrx3.JwbbqniTutTloqntzGku EobzeGksu__Nehdm2.EpmvoclJnpSuyyCgfzBmgCkcq YxgleKaai__Mxkmm1.VkkkSohtqpnRzbxautLgdxmjsQub KeqzcQhqe__Arkwj3.UtmoibzUedPpsvapoUup KbpndWigs__Xkzcp3.NHNG_BLEXZS_IHLEYO_WLPKT TmmhaLczh__Suxzj2.ZsnbArecegqSdwjelj_CssDpwDqjqyx SvqvxTbgx.BZZGiwl1EcsemvwFxovvwgqsJmijip FqfjrUhke__Qgmra3.LVVPK_JFKC_EWPZJR_CPB_GVRQ InepmRrfa__Falvo4.LmgxktyWqtKlscTevpTqxQbwk DwfvjKdnz__Icrvr4.TrezsyBosvqezvkp YuawfOoak__Ebbbx2.IBBW_KPGVZC_ASWJ_IQUY_TIYMB WqmpqFlew__Stabb4.ItpOfrxgnqWxpiqlfQgxz OvhioDnye.WXZFfna2CsfsdarFpfznvkzjAuyvvi HbjfkCqxc.TJXRosx1OfqgblhQipVsgxlmtOpk OdagsVwts__Qgspo3.AZONbxd2OxeioviPckekbmfvFbxazc OhmudWsel__Uvquu3.XhrrfUopollrGtd_LepCbkFivctz XiojuLklw.xA_gqrkfxoergmjzaiz_fqattm CrpeyWkqx__Pcbqv2.NpijqTnjiuqaqhJmilcTrvdgieh BqajrJdqn__Ohtkvcd.iE_zaqmkzhjyvbryzjm_rahvpl HnorbKibz__Fanipcp.WOS_KILEVLEF_QOGBVQSYP_CXL_FGFG AljxdUybv__Mylof2.XqtqovICCYa_UatfexuoUgpWibdew SrvmkZohl__Xlomp4.jA_txyecxj_xfibvgrpiq SyqteAjoh__Zuzbp3.CWNH_HBCNDB_UHQ_RKKTX GdlbvAduj__Vxodouj.EvqqixqNfdcmsuEplmqqoVvu AfqojPfqs__Yktzq1.YcgllbzAhiarheRqbalniXaa XjzgkLkqx.FHSPhcd1WzogxasMrqTdceamjIig FmkrbJcub__Bhzov4.FazcxofZntaephDndvgi RpyxtYcjo__Ippyn2.QTFW_VHQVME_OXD_XPDSR RmihqCkxo__Jvvth2.MbhcnxiQvvWmjpPxrgMnoUckvtl QfmsmXstn__Srvjj4.KlvfpFljfBmywwsw BvsfmKone__Ebluo3.LbuGPTZzdr2PnqpijnOmthpzjxjUrlq ImqnkVbew__Ibjid1.ErolbjeBsPlbXecoeOtk JsxfgNvpn__Pqqse2.FoqupxwWuiFqfqsbtAbz PqkbsYsfx__Vzxwr4.qB_nbtsrso_Qxaif ErqsbLzgx__Nyajs4.RxciauQRZMu_GaaopitUuiEddd ArrrmPtol__Wnrst4.WCMLkri1TwhhmdlHhnFzvsermMdk KnuhzFqhg__Gtaxn4.ThmoYqnpvpaHwlsnqi_MciAqmHsbwrz LvipxDopn__Caivy1.CjhqDytyzjbIpoOdbacxyLjb PqckmGlnz__Lttdg1.ITPBkek1ObqmbxbXnnYqcllwnXxl YzgxfMbvh__Gocfvft.GEQAswa2IxqzrngStakvbjqdFhcctl SgqiyQcok__Vcoohtv.VpqNciJsvfMms_FmtZkwOhmhab FadveGjgu__Ntxwk2.WGE_ZA_SOAA_OLQOJHWYS_VJW_ECC TjenoSavs__Wumpr1.GxmhIhsbemnUwzbceoDsqskh TokzfRywm__Hgesj2.OigMgjsrxlIgczzlvguSeuwbl EsisbZoub__Ailmp4.FQAErcVymcxLhmx YytroCquk__Hfjtwqn.TjcvQttqegbOimbnzv_RjaZqoQfrdtc JgyhxWkjm__Smcme2.VPE_ADGIQRFV_RMAGWTNUB_GOW_YSH ZiasaFfpw__Ecogp2.ETQRC_Z_ODYECFO_TBQZLB ZlmhcHzgx__Ootelrv.BvtnhCpqikmlUqbcmrjyrAgyhgi RwqtxMimc__Wizawaa.FemaSwidyotEupxhdfKenpiomOvp UerquSxdl__Jkwzg4.KxklPoihlgaNatNrkvdevYwa ChcadKcwg__Crjte1.KDI_CDOHY_WLJDN_LASV_ESYYXSQR_HSX WusctJucs__Yjpqp1.AusbwnrIxmMbjekeaTbt ZlbpdWtwi__Qyoqb3.EyuojGtnreryJte_UdgNtlNuwi ItahfXugi__Ivtjjrr.AadusquVhfabxh_MaxNqsOgsqdm WhgjoSmku__Fuoih3.NktdHpbihjqUbrvisrLtvhdxuUho LakgoFbjq__Axpzd2.VztqfHbzufqcgHijfzdTkwvuhpe FucjcLutn__Tvjyy3.CXOPbcu1VutkmjdRacJmqeoxjIlu JqpkfLyeg__Lmtpd1.NxwgtiYttsilvyvx GmiejThss__Eegqv1.PPDPuechdyUvt_EysVrdVszt TyrcuAmnn.WEXDltbMjjhgVydAywfnkqOst GetsmCtma__Ojuojmp.ORQDCP_FSFYZBZ_DQBRF_SBTZBC IkdxjPabq__Hksok2.ZUQ_YLLYZGJR_ZLWYASZLF_WTT_QFTZ DztrbYtlu__Vlwirig.KtwewCpmkmfjZel_NtdPdwAanq CobjnLfcc__Ilvyfug.OkqomgyEqcoRhvottg FfdlbKbvt__Atgiu4.SqxcSprisrdMybvgejXhvljhfBum TzpxeMjfu__Hwzri3.LZLIO_KWIX_BBQAZQ_JNM_AMHY RxbztJzrb__Rsqro4.DWDB_GURSQW_HSC_FVXPQQ_VOXFN NjimiJklh__Hezmy2.JMBRK_X_SNOK_OMGROJWW LlswlohpGtsjwUrqEjhb.VGJ_GHEUA_AOGPZWD_CMSSZ TrbknJxah__Hnfqe1.BrataulRmzPfdjskxOpv KhqptToxx__Vpejd1.RREN_JSUJYI_HNGD_VTV_YTZNHNAIP NxycdfzeRvpwnDmzu__Wzvkbi.Rlts SatikHdgu__Oblba3.JLJXjky2MretnlnZedCwoqqkjFqy GgbhzOyqr__Adwmdld.RnsugaDENYg_LvpswqymUqiCjunla ThhglZcqb__Jlqbx4.UdnTMPOsmw2CuhwvcnQpahqlkncJocy EqebaCitb__Kuxvv3.VXOT_XAAYVE_NTFS_GRY_QOXGW AzvtfUjnd__Sejwr2.CrebdjrXrVmnYoiauPpn UlarbGuil__Iomrg3.PJMWfmt1TokoipvWsrkghvujUvuvmv TdqhfIvuz__Bmpiy3.OMQJjwj1StklxbjTovOcouocvJup EuwrgMflj__Efrknsd.OurHoupplHwyvrbppBnqjkszvqp IrjgcEnhr__Brgqn4.PjxxiJaoecrmAsremaidaUtzjfb JgppoAuqa__Wiqei1.WuccxzQZCIi_VsnkpaflTmiBetjpc GcdvlNdie__Hvtxl1.BKEHfytXtbsuAwuo YiudiTwgn__Vgfce1.UniMztscEcst_HzvamnJhnoqjtjKiljk IoyjqdwtKefvzIktRvtn.QNY_AYNI_XIU_KGHWT_ALTM KvcsjCkru__Huxuc3.lU_zefjidw_rrgqvwibcg HwjkgWicx__Vedez2.SOJMcqk1WirxchgHyhCiiijcxGtz DsxsfWtxr.IGSWbsr1KnbiepkDbuKtreuwlEui AsqlnVgcd__Tpjiw3.WcieGvthqruIchyoyw_YefJlpBwqrjh MttqfRrer__Ysvny2.QJXLkpg2LmtolzlYeaVdicnbrBkl JpwqgYeyg__Flxgazb.VAAC_LIMFDL_BSNL_FIWH_WBZRX LdmtrJgwp__Ylogp1.KovzIynzpkaGrzVhcjpdmDcd YgwuuBwsv__Ieiem1.CQZSqlLuiduAqjq LmtzhHkoe__Vhwsb4.tZ_ohlnkzqarajkxulx_tkinfo IsdrwUsvm.WddetqHYITi_RwfusmjUypXdyt AqrzaLboj__Begip1.DCXF_RNOKHW_GRWO_KSGXIU_NCDDV PswfuBomg__Eeplx2.BtjiHwttxhaNdfhjchMdpopexCbv GxciyHuqm__Wzpjcux.GfuMAMVhyq2HtpmcgzWaowfaaruWozk ZfivdjzyHivkuImcMozg.LdsrfRysqtgOthzrzgGpshscWudpk QapkpShwh__Xbfjy2.OtkxojfHrlxynvMmowodmZrx BlldlOgqc__Jumrq1.RHIQT_QTDI_BGEIET_RTY_SITX ZieylHoyn__Vrdaf2.WBSM_ISELSZ_IFSJ_JPTCTT_NDNOY RlntaInye__Rqfvzsj.HmgHIMWexa1ZbhkupvYoojqnnthJfiu CstsnXuzf__Yasamvu.FHNRxeawclIsu_AyxOnqEswi NkwwwQaug__Wskysyy.YBKL_MRGMSA_XERLUE_PUAOA LmebfzjqOjozbAjuLool.TZWN_CWXHW_DYIOJ NajzuQnwr__Cibbv3.ZSBDxqpvseToz_HxnGklAtxw WkzqeKxwu__Zjcbe2.DevdskTjiiowzbtf IaczzQxlh__Ibqfb2.JkqeAtvvifiPmvbruwImtxhcrNqd MiowdEutt__Jcezp4.QhsbifzYeiyatg_LruUyzDqgy KgnucZjrk__Vdjwz4.JwshviaPcbBtuxhtzGnh PjzxrImmu__Cszuk3.BWLOzzj1FlngfkuIiqKdrxuluIha JffnhDamu__Lnerl2.BYACsca1AvhkgkfSltPooyqloHzf OlkwtYqkf__Htmvacu.EdqoqgoQyjAikwhqoGut VremlDsjn__Qbrblkv.QVFJD_T_OWAMURD_NIOBEM OwewgDunj__Nruuu4.TelqPyjtastXgxFdgaetmUbp PsvkrFwcl__Gcsyn4.SGC_RWGZX_ZMPMG_ZYQP_CILIGUHL_EVR CoiusGdkl.ZssaPtapwgcEilnmnr_RorSfsEzdzma UztukUbkt__Umztp3.ETY_XPMUSVIA_PAMOQSQVG_OMK_PYTN FtwjeAqie__Zitoe3.EhvqtlfWcmmrcYmpezfoErr GwcdwpjmKnbsdYnzUmlq.TM_EEY_OY0_QKHFGDH_JIICM SjihpTkde__Ptffj4.HLH_YQHCDS_BGYODQIAZN_NDP_FDGS VhudhIdjr__Incgt1.jE_piaggiq_franbucauk WelhcHqjn__Mjnmjlw.TTSQ_XJMUBS_YNRG_FJGYD QlzpfArrk__Hhqzx4.AGV_IRDYAUJO_HOYEGWXPV_GZZ_MOJ SxnkzJlyy__Rkmsu2.YfrUxhgkIrbhkKdho DwjmyJzsg__Cjldh2.IIXJZ_ULVC_XGKVEX_AIN_FXYL QsbzhWodf__Zzxnv3.AviwzluJqwvvbThvolwlqNji YgmjfAlwi__Opsqhbm.GopktgkZbxQtfmlhbUnk SureuBshz__Ibyjplx.JEZXN_Y_FCTL_HQDQWAMB SixrsSkpt__Gwkml3.CcomkiiTgntvgq_CdjBcpByzkbg XeljhKuap__Ehwuu4.BNJZgcr2RspznqiCbvPwrenrhLzs JyvwlTfor__Npzym3.ArxezAzpyaghoeLvbyuDhjkzizv OqdpkYyon__Amely2.CHC_MUIJV_PCQLA_IQJL_GCHIUXPT_EYP DmtrmMmwz.JIVEujoUzjuaPtfQysgtqrYnz SzweqMowh__Vawhd4.KsndkbbYfigMlbmqek KjdioDtub.KJGLzmb2RddvqcwSoeQtqetugZxk DhuqptdfPdtwfXcpNqmd.NV_ZCujogFiDdyWmdfLwtkuwf JzfceTqwb__Cjbtk3.QzeseHjtgpbxJob_TyvPtrXeenxg PfgooIlwe__Ezcsf1.MZXB_ASXEES_GMM_PCVXO CdylsKtrd__Nnkeiqg.JIBJWBSKAABA_I_CALH_OIJCSCGC QusjbIxcq__Rqwin3.EWW_IKAJXN_JEXCKJLKNY_ORP_GCU XqpjvQdfn__Uppwi1.XsyuIianydwRciooon_NjcFucNzlnfo CwtttKkuz__Bdatbpb.FEOVbza1LxkkrljKzxVfofmytQap SnkehVixo__Fvpwy3.SozgSbuykOuhnamqGpm_GbnFpyCezc CqgrgVjoa__Ynmlb4.EpcBaobedoWoiruxifbWppt YwosjVpho__Eeqkn4.ShpafbmTyCadPppruSvw XraqfWdvl__Mlcko2.EpqawHevqbqlRdb_KdoEhbJmxvvm IathwvryIumjnJitDrpk.FH_MWzkriTgNkdHjfFYlnmt RawarCffl__Ywzug4.GAEX_PWZNJN_YGRMSG_NZHUT KjpugwbxIivxzQpcHaws.CW_AWG_GJ0_VMOFFFJ_JTDRE KqwtxXzgb__Gqjfu2.AzegpmwOvnjgjTmwgsninDkf QmmkeiaaPmwysTfmXkqy.PL_SBY_ISTHEB_0B_MODXKTN_GDELF NcomhVykj__Oglsj4.BiwQkmcAqbmbvdRxudouugmOtey CugstCtdy__Zfdrd1.QVCKble2RotpxgwRhvSotgvugZbc HviamRfos__Ssuqq1.OFY_PW_KTXK_JSAIQZOBV_WXA_HAS VntsfYpfj__Bfbov4.YhhilraJcgRiixokzAbc JxtxmRhpz.DrlateJGGKp_JizmhhlwPuzQernhw HkscqCjtk__Ddrkk3.JqrQtiipttUsiwhixRtkj TdxpwRfqk__Reglsjm.LNV_SU_ONMN_SIYAPYYOI_TEG_YHMY IpofiAqtb__Qimdp4.UYUN_GXMZFS_OBCK_PCR_DNMAA EjkkeKrwh__Mglno1.AwkdolsVdqFibxKanvIfwDjohlj VapttZywf__Iykgi4.DGYAslb2VtoabdwBnzmywgglMropqx WvsuxZicy__Mwlah1.VnmXgmnZwe RczlcUutj__Elmnp1.DsoXdcBjuvApt_YovSnzSzqw AlkxuAubu__Dljyf2.CHWPpcg1UewxaslEbtpdqbjqQsydkn JclniUjcd__Aiobb3.LceKzeIwemEcv_NmpXpcUcayxm RetkeYvxy__Fizzn2.KSO_ZQ_KEQE_TALFZIIBT_ZZU_KUGL TphkvLyjf__Cdigr1.MQDGovo1OqfrqqdZwiowrglfEzqsan TvkdjSdmn__Kghoz4.VzfgxRdtvcwaUpp_SqeEdrNvsrqe JihcoWont__Nnlfkrs.PfbjtfbBqkLqltYazhWovMfjgmu HltnfCadd__Fplxv3.NafERYPpmb1RscurzzUhcnmuzdhUcvj DbtrlEhfy__Pxgwg2.WlofuydBzxzqqBlimigaOvx EzjgbFgwm.HfoTYRRakd1UkwpcbxFtqvkysruCgcu FvbvxYhwn__Yneqj4.WYSKhnm1YjkbjgsMdxYrdwtncJkp RbeztFdrf__Duzfq2.XfoqjckRxjwQtjwxRotalhnPIxxfwr GahhmJniq__Kpjmz4.RKVCV_P_DGYJ_BHJZIVBJ PbzohDlsy__Dmuxh3.FctigkjFfjZuiwCqkhRrbEpzd QlwvoTvvd__Czxyqpg.IfaqljfPvjtBhgxgNoeubtfPTcblhw EjmwcPnue.DOS_DGDPE_HZJSN_XCDA_JZTOWXIM_JUR XcyeoGmfw__Qumsgbr.XQKUbrg1BpdmzzkDjuplropaPftidi PsiklZegz__Dcnmk1.UpmcnepMgemXkdleil SrofnCkaq__Jikubeo.KjhjxfeEdkSxudRiyyFaeWnmg RjjumNjjj__Vjfyq2.RqoszHajjksTgcrhkxe JpmrlMwav__Bhqtk4.DutwzvsDxizxno_FxeVnvDuzvef XcmdnZxoy__Tmogu2.DvdIorzTnd CarnqruePdscaVjaZywi.VY_MPmovrLgXubRtvaVpmgbub WipxcvhmDieadHrkXssb.AJCS_HZFSD_AEHJOWL_OZLCZMIQP LugoqezfVufdgNsaDwhk.ACQ_CPEP_HLF_TNEL_XIXWM_EGKB_AA RlvuoBjqb__Xpfyn1.ZapdfeaHtcYwauQnamFgqPnmq JdrlsDmfy__Nsdws1.GbrktdbIlitsjsDicetf XxoneVkoh__Wuafm3.VNV_KJ_PAHJ_CMYMMHBDB_YLW_CZX GgwrjNuub__Iyxacum.TlvbuQiyeMlqjVembzu HtxiuDsda.OsklslhIxfnoleZkgtkn HnpspUvrn__Ksvvup.Ldqr TqhetQtve__Vqreq4.QclkIgliuvkZwynneyEdgqbbhSbr GnamrJcdj__Qeilrbv.OozLwgzJieusvsNzumuwvjeUktw XjyrvHbfj__Eizak3.ArodUyrqojdLkeSkmzuamAeu MjluuZjvp__Qauqy3.DhnHmvjnKfpg_QtmptrRviefmhzLmelj JltbeLncl__Mpgah4.LwxhGkmpiLpiccbbAzo_NfwIozNavi ZfiwgOtfi__Mhuxv1.iC_italshcyeepufbwl_sgsmwe JugnyZucn__Ijwck1.DzoluktPnmfiuPbqtalpCfc KkbktVehp.WfknaijOoPstNjnnfMkj KpzchOnrh__Bkvru3.JqdWnsoQqxwfixFrfhezqQmoo EdfazNpdk__Sfrrzmk.EVB_MLOEPX_RCHRROHFGS_OHC_DKU DlmlkBchr__Zqdku3.LrtlfdzVcexJugirxv HhtlqEajt__Dyorf1.USBF_LETSFI_LNZJ_KJJQ_WRMFV YdyxcUmzx__Uazlu4.FERG_MZINWS_MDC_JOQCG JtlbtRyvz__Illtj2.LPFW_KYXTQU_OAHVFW_PCVRT GyfeqIyhz__Voxlw2.XKIF_USYDWF_ZDKZ_CVG_VCPTBLESL IhzfqQfns__Kdakofz.PKRElaoTocsjBvfVxgcfzcZax KpegmmrfOobumBvaRwlf.IVB_ARLL_TXBP_BZGFTPW_MDDEA BbvwkTjkk__Dbudhdc.WigUzuuwbcXylcmrlwoAkcw RfynjYrdo__Xiian3.RKKBG_WXSPW_UDA_2_FUDMLR_VMXKKIEARI McfxfUczr__Qsuej1.JrpfjCxoakmnSwd_QjgQooZcnxvb ItuamWjdg__Bwnxi1.EukvkDdnsldxfSoasvaYbsoburi RlaooNmjn__Ivnmn1.XulhpAilzvmTfqxjlsu LfrgnQmat__Eyphd1.NXAAezdcvkHwa_LgcOfuKwdseq OfaqfFuxg__Kpfdy2.BraLgcgmySmbbmishPybnslbsih OngteLkqv__Quowm2.NFFXebzVyarnDctGjqssouSmy UyzqpGxwr__Sxutp2.kZ_pyhawqm_Upbon RbughLfhm__Ioxqq4__Bqzrlb.Vglg XdrvaLrev__Lvltv4.UkenDrbtlmqTtrzqkhNypydwcZug PxhmlLcjn__Kvdzt3.ZQJ_IOPIT_KBZEX_GDMT_ACEODQSX_VVW FingoHahp__Hingj4.DFRUmxu2JemhfrrZulRswcnauRxa StbkjInto__Uecmc3.UlsoZkupclpHbkQbkhtlkXiq MxbkePdkq__Pyngv2.UrebPqzfnagVnxovlrRccahhvNlw IcpqcLpwn__Rqxwwap.FfyZcptuJwwivftgbi OpqblXvah__Euuoy2.AoieZvunkqjCloPumhbltAds YqmftXqot__Uwkoz4.CvbwbDeshqfsZhk_XpiWspXisl DwlauVfqw.NTCYmrd2ThmubzuLsjFmozukmRby MzyuoYkdu__Ceczp1.QPTQ_RYHGZB_IXZGWY_BUUWI QhpuwPlyf__Mfvtsxa.OUHK_CPKUDZ_EPP_CUQMPC_OOHEL NrpmwDovc__Waujn4.StvioOhgnpeeZms_HsmLsqTszu ZkqxjHgsm__Woqzs3.CRAOpss2XkocijzCpeCgcrsvjXgd DklonVubz.KsprTctswmtAbkzlkiZawojk DgbipynaXmgdhJqkWvvv.LF_BTB6_YLFNTP_ETIVW_SNGXD_VHCBU MdwepQurc__Zayopza.FswoFixjyOrfivfbItk_RrbDvhTygtgx GqjmgTqdk__Otmno2.AHNItaj1WwcsnxwGpwNncfumvVuu FiiehVdwq__Otrebbt.OakpwVgxcyuuSsh_PauYzjKadtdk YccmrOnfo__Aqtgy4.LaqhvLkcoghrTyrlyicwl QedjuPvgb__Ptynvye.KUMAvki1QcbsjzuGwrOwvgarlBdb IdmnfIgeb__Vpkon4.IuiWtuXjssEob_OsoTnwMqmb DbejpUjcp__Cewtu4.XAD_NA_EMOH_IRSOQRNPX_DVX_VCVM MiltugufKcflwQzjPycd.UZ_WFVC_KZCEK_GQS_EMPLXTMLD DoearZmqd__Knenn1.HNGYshk2ByjebbhFabeyglkvWypuae XfwuzTgbs__Rodzt2.GHUNmizWglqyHhlf UackbIbiv__Ipavs3.JGXO_SBDIUY_NYJF_YEXEV YfuynPoce__Pcfep3.HTVOvpiWlanvTfrr UljgpvvhCdeiuViaQlex.XFHVygxzlxpLadutzOnpgm VoneoBalg__Icfcfqp.XecZqrwEouakjhZgpswwiMbxq MkpzbTeap__Vvppi3.QeyIlnoJdy AzbduEtld__Oadni4.RKLUdcuJmomlIrfSzctqatRwf QrgueCbqe__Sydoc3.QhbDtzqkDrtkaloknp MmbgyZmno__Rhouv4.XdpjeKmjoFcnyPkbvsa TtasgMxrn__Gdlexyj.GzgkegaAslsshwUlmpkryTjg BmrvtOcio__Oyjju4.WwrgbXcnvdcyDlq_FgzElqQsmotd JmqccWejy__Wshya1.NyutwBnohEzugxnr YoyveXuwg__Pgnam4.PhoJFKPdzp1GcwrcuqYddbnsdusLrgt AlujlNtlf.xG_gkdpyds_Wodup AoastQexc__Wctml2.SUMWE_VAND_VOKRYA_RGD_AHCT FlirhWuuj__Zmqki2.BCXI_EAKNEF_IYQT_VXFHL NkucpEdxm__Wtdfh2.PhkSprrVhabvugEjwkegfstQqoe HyvmyVyjs__Uajwpsg.RFF_TOGQFN_YCPBLTLMZI_GEE_PRHB UbeqaJpcg__Vstsi4.NEJVbqrfpzCzb_SbwQeyDgzpnh CqznbAmay__Yqxig1.JqjhyfmKcbvvbi_GgiXvqJpms EujkkXrem__Kvoaxfu.GizshsBfljmrscml MbokvLeah__Znorp2.VQVPXR_FVAVFUE_TUPSR_VWVSIH XtovmXsjn__Kzjvdqe.HhsqhsiIoqHcbmdyuSoq ZvkeeYppi__Miqbq1.HGQQL_Z_RFNYXKQ_VENCHK AejcpMzcl__Svpsr3.ChamzejKcratnsQbdmgqtMuj XhtjsVjqh__Dxaxi3.CckimgcJpcrwihRtvubzsGge DtwpoIuxg__Pzmxh1.XJAJ_OWPIBR_YCPA_FIEZT XpmuxJrdd.WFMZtsVwhnzKbic UsrtfMhih__Xohik2.DslojnjUwlbgxaXzmztrbIdk OnxbyyztIkacjOsrZqpo.TMQGJ_SCOXEO_EURPH_XQBFKTLYN IesklAycd__Flikz3.PPTAA_A_WQBS_FAYVUKDL CdgwaWuwu__Ifxxu1.cD_qvoizbc_Luuib QsgadMeyf__Rteto2.PlghXfeeghpEvuydawLtxssh FabqkIogm__Zcfjq4.DtpDfqaCmn OzfkpTbps__Xkufhpl.mB_rlsfokm_yvzeyfpofc YwhpjNldulUmxs.QB_ZQZ1_EPZA2_VAXB_FNH_YEG_TZM UulpaFgldwAlli.TT_AGOS_DAUPR_IJT_TUU_HZNZXU_ULZN TbywwHqgynMtlg.DJ_NCL1_IKME1_HNL_VWV_BIN_HIX PrntuWpvopQabp.QF_VXD_SQDIU_HUDZKSU_XIGNYVQYH_1_WJUCEK KzsujWeapaPady.LGPDZLXET_RY_XSHPUR_TOLVPZM_LM PbpvlHqccsGflt.KQOH_CU_FF_FT_OPN_TUXAWDSCD_PVXF FafrqBowxaZmfz.ZR_HP_DJF_XKEY_XACFU FstjhFvvwqWens.YK_QXA_TKXUIEZO_OWRP_PGHT IcrguZhynfEsfn.BP_BXQ_FO_HZBX_ITTGS_BJFE_HRAZ GxrmxJfccgHkmw.GW_FVT_OEDLESBG_VFHX_L_FVEVWDBFJ LvsvhLdoiuJmpd.BV_UBH2_LGDF2_WERU_YOQ_EKT_KPL UunpnZxfncTmtb.PB_PWV1_GWNW1_MLD_CXT_AOS_HFF GfbvtIegmhUpfu.EYCG_AI_CEEPRDJAH_NDBR_YOGC PngivIglkdYfjn.MS_SIRR_LVCVBKUCJ_100YA_UVFDY KqqmwZlhplTcpr.JK_STH2_UBKQ2_YUCH_VZX_EVQ_OXF AegvhFomlbCmfp.WM_UJQ2_WINH1_FUM_XEM_KQR_ACQ QiueqCgvbhOtvw.GO_WDXVEZSK_YCGZDTLU_XJSQZ_KMI KzsujWeapaPady.LGPDZLXET_RY_XSHPUR_TOLVPZM_LM PngivIglkdYfjn.MS_SIRR_LVCVBKUCJ_100YA_UVFDY /end REF_CHARACTERISTIC
/end GROUP
/begin RECORD_LAYOUT AYKNls.SKKUJ_REG_YRAUFK FNC_VALUES 1 UWORD COLUMN_DIR DIRECT /end RECORD_LAYOUT
/begin RECORD_LAYOUT GAMOau.MCUYV32_BQZB_SGO_OGBXLG FNC_VALUES 1 FLOAT32_IEEE COLUMN_DIR DIRECT /end RECORD_LAYOUT
/begin RECORD_LAYOUT GYKYuwe.ICQOC_ULX_AOQJVC FNC_VALUES 1 UBYTE COLUMN_DIR DIRECT /end RECORD_LAYOUT
/begin RECORD_LAYOUT IduoKbdbrbyjAggvb.UWRQY32_TYXL_RR FNC_VALUES 0 FLOAT32_IEEE ROW_DIR DIRECT /end RECORD_LAYOUT
/begin RECORD_LAYOUT IfhrZizqdkbeLhsjr.VXZAK_JV FNC_VALUES 0 ULONG ROW_DIR DIRECT /end RECORD_LAYOUT
/begin RECORD_LAYOUT PTXXfgw.PRBSR_CUR_SBKDNF FNC_VALUES 1 SWORD COLUMN_DIR DIRECT /end RECORD_LAYOUT
/begin RECORD_LAYOUT PtkkRnpqrkbvXmkqs.QLPDW_FK FNC_VALUES 0 UBYTE ROW_DIR DIRECT /end RECORD_LAYOUT
/begin RECORD_LAYOUT QNBXcc.IHUBY_UBU_PSVHIF FNC_VALUES 1 UBYTE COLUMN_DIR DIRECT /end RECORD_LAYOUT
/begin RECORD_LAYOUT QpgkGudaddleZooxs.GSAXV_TJ FNC_VALUES 0 UWORD ROW_DIR DIRECT /end RECORD_LAYOUT
/begin RECORD_LAYOUT SkcqPrebycvuEyxcs.XPDJR_XR FNC_VALUES 0 SWORD ROW_DIR DIRECT /end RECORD_LAYOUT
/begin RECORD_LAYOUT TRCZnfb.VAVEX_QWK_MOQPON FNC_VALUES 1 UWORD COLUMN_DIR DIRECT /end RECORD_LAYOUT
/begin RECORD_LAYOUT VEZHeno.VDYMW32_ZXGU_UIJ_SUONKF FNC_VALUES 1 FLOAT32_IEEE COLUMN_DIR DIRECT /end RECORD_LAYOUT
/begin RECORD_LAYOUT VHCWtb.UTPON_PTY_BJHNRN FNC_VALUES 1 SWORD COLUMN_DIR DIRECT /end RECORD_LAYOUT
/end MODULE
/end PROJECT
