/* a2ltool 2.6.0 */
ASAP2_VERSION 1 60
/begin PROJECT GHQ_SM_SM1OX ""
/begin MODULE SQA_YQ_WL1XG ""
/begin MOD_COMMON "" BYTE_ORDER MSB_LAST ALIGNMENT_BYTE 1 /end MOD_COMMON
/begin MOD_PAR ""
 /begin MEMORY_SEGMENT SystemCalFLash "" DATA FLASH INTERN 0xA001C000 0x1000 -1 -1 -1 -1 -1
  /begin IF_DATA XCP
   /begin SEGMENT 0x0 0x2 0x0 0x0 0x0
    /begin PAGE 0x0 ECU_ACCESS_WITH_XCP_ONLY XCP_READ_ACCESS_WITH_ECU_ONLY XCP_WRITE_ACCESS_NOT_ALLOWED /end PAGE
    /begin PAGE 0x1 ECU_ACCESS_WITH_XCP_ONLY XCP_READ_ACCESS_WITH_ECU_ONLY XCP_WRITE_ACCESS_WITH_ECU_ONLY /end PAGE
   /end SEGMENT
  /end IF_DATA
 /end MEMORY_SEGMENT
 /begin MEMORY_SEGMENT SafetyCalFlash "" DATA FLASH INTERN 0xA0038000 0x1000 -1 -1 -1 -1 -1
  /begin IF_DATA XCP
   /begin SEGMENT 0x1 0x2 0x0 0x0 0x0
    /begin PAGE 0x0 ECU_ACCESS_WITH_XCP_ONLY XCP_READ_ACCESS_WITH_ECU_ONLY XCP_WRITE_ACCESS_NOT_ALLOWED /end PAGE
    /begin PAGE 0x1 ECU_ACCESS_WITH_XCP_ONLY XCP_READ_ACCESS_WITH_ECU_ONLY XCP_WRITE_ACCESS_WITH_ECU_ONLY /end PAGE
   /end SEGMENT
  /end IF_DATA
 /end MEMORY_SEGMENT
 /begin MEMORY_SEGMENT PerformanceCalFlash "" DATA FLASH INTERN 0xA0050000 0x1000 -1 -1 -1 -1 -1
  /begin IF_DATA XCP
   /begin SEGMENT 0x2 0x2 0x0 0x0 0x0
    /begin PAGE 0x0 ECU_ACCESS_WITH_XCP_ONLY XCP_READ_ACCESS_WITH_ECU_ONLY XCP_WRITE_ACCESS_NOT_ALLOWED /end PAGE
    /begin PAGE 0x1 ECU_ACCESS_WITH_XCP_ONLY XCP_READ_ACCESS_WITH_ECU_ONLY XCP_WRITE_ACCESS_WITH_ECU_ONLY /end PAGE
   /end SEGMENT
  /end IF_DATA
 /end MEMORY_SEGMENT
/end MOD_PAR
/begin IF_DATA XCP
 /begin PROTOCOL_LAYER 0x101 0x7D0 0x2710 0x7D0 0x7D0 0x7D0 0x7D0 0x0 0x40 0x40 BYTE_ORDER_MSB_LAST ADDRESS_GRANULARITY_BYTE OPTIONAL_CMD GET_COMM_MODE_INFO OPTIONAL_CMD GET_ID OPTIONAL_CMD SET_MTA OPTIONAL_CMD UPLOAD OPTIONAL_CMD SHORT_UPLOAD OPTIONAL_CMD TRANSPORT_LAYER_CMD OPTIONAL_CMD DOWNLOAD OPTIONAL_CMD DOWNLOAD_NEXT OPTIONAL_CMD SHORT_DOWNLOAD OPTIONAL_CMD SET_CAL_PAGE OPTIONAL_CMD GET_CAL_PAGE OPTIONAL_CMD GET_PAG_PROCESSOR_INFO OPTIONAL_CMD GET_PAGE_INFO OPTIONAL_CMD SET_DAQ_PTR OPTIONAL_CMD WRITE_DAQ OPTIONAL_CMD SET_DAQ_LIST_MODE OPTIONAL_CMD GET_DAQ_LIST_MODE OPTIONAL_CMD START_STOP_DAQ_LIST OPTIONAL_CMD START_STOP_SYNCH OPTIONAL_CMD GET_DAQ_CLOCK OPTIONAL_CMD GET_DAQ_PROCESSOR_INFO OPTIONAL_CMD GET_DAQ_RESOLUTION_INFO OPTIONAL_CMD GET_DAQ_EVENT_INFO OPTIONAL_CMD FREE_DAQ OPTIONAL_CMD ALLOC_DAQ OPTIONAL_CMD ALLOC_ODT OPTIONAL_CMD ALLOC_ODT_ENTRY OPTIONAL_CMD WRITE_DAQ_MULTIPLE COMMUNICATION_MODE_SUPPORTED BLOCK SLAVE /end PROTOCOL_LAYER
 /begin PAG 0x1 /end PAG
 /begin DAQ DYNAMIC 0x0 0x1 0x0 OPTIMISATION_TYPE_DEFAULT ADDRESS_EXTENSION_FREE IDENTIFICATION_FIELD_TYPE_ABSOLUTE GRANULARITY_ODT_ENTRY_SIZE_DAQ_BYTE 0x7 OVERLOAD_INDICATION_PID PRESCALER_SUPPORTED /begin STIM GRANULARITY_ODT_ENTRY_SIZE_STIM_BYTE 0x7 /end STIM /begin TIMESTAMP_SUPPORTED 0x1000 SIZE_WORD UNIT_10NS /end TIMESTAMP_SUPPORTED /begin EVENT "xcp_ev" "xcp_ev" 0x0 DAQ 0x1 0x1 0x6 0x0 /end EVENT /end DAQ
 /begin XCP_ON_CAN 0x102 CAN_ID_MASTER 0x12345678 CAN_ID_SLAVE 0x12345679 BAUDRATE 0x7A120 SAMPLE_POINT 0x4B SAMPLE_RATE SINGLE BTL_CYCLES 0x8 SJW 0x1
  /begin CAN_FD MAX_DLC 0x40 CAN_FD_DATA_TRANSFER_BAUDRATE 0x1E8480 SAMPLE_POINT 0x50 BTL_CYCLES 0xA SJW 0x2 SECONDARY_SAMPLE_POINT 0x0 TRANSCEIVER_DELAY_COMPENSATION OFF /end CAN_FD
  /begin PROTOCOL_LAYER 0x101 0x7D0 0x2710 0x7D0 0x7D0 0x7D0 0x7D0 0x0 0x40 0x40 BYTE_ORDER_MSB_LAST ADDRESS_GRANULARITY_BYTE OPTIONAL_CMD GET_COMM_MODE_INFO OPTIONAL_CMD GET_ID OPTIONAL_CMD SET_MTA OPTIONAL_CMD UPLOAD OPTIONAL_CMD SHORT_UPLOAD OPTIONAL_CMD DOWNLOAD OPTIONAL_CMD DOWNLOAD_NEXT OPTIONAL_CMD SHORT_DOWNLOAD OPTIONAL_CMD SET_CAL_PAGE OPTIONAL_CMD GET_CAL_PAGE OPTIONAL_CMD GET_PAG_PROCESSOR_INFO OPTIONAL_CMD GET_PAGE_INFO OPTIONAL_CMD SET_DAQ_PTR OPTIONAL_CMD WRITE_DAQ OPTIONAL_CMD SET_DAQ_LIST_MODE OPTIONAL_CMD GET_DAQ_LIST_MODE OPTIONAL_CMD START_STOP_DAQ_LIST OPTIONAL_CMD START_STOP_SYNCH OPTIONAL_CMD GET_DAQ_CLOCK OPTIONAL_CMD GET_DAQ_PROCESSOR_INFO OPTIONAL_CMD GET_DAQ_RESOLUTION_INFO OPTIONAL_CMD GET_DAQ_EVENT_INFO OPTIONAL_CMD FREE_DAQ OPTIONAL_CMD ALLOC_DAQ OPTIONAL_CMD ALLOC_ODT OPTIONAL_CMD ALLOC_ODT_ENTRY OPTIONAL_CMD WRITE_DAQ_MULTIPLE COMMUNICATION_MODE_SUPPORTED BLOCK SLAVE /end PROTOCOL_LAYER
 /end XCP_ON_CAN
/end IF_DATA
/begin CHARACTERISTIC AGY_AVKB.REV_TMMM_K_VcvtTovXizg_QYWC_Nzukij_Iie_R "" VALUE 0x0 ZVW_DK_VVCKV 0 NO_COMPU_METHOD 0 255 SYMBOL_LINK "zoL82zT5_wNv7dchYYyB1ZyenZfjSDL_JSBkRA4UNcwxruc7HnIKK" 0 DISPLAY_IDENTIFIER LVO_IAIP.QfwrplngdoaVbspdvzjjr.TCS_XGYO_E_CiuyZrdWhjs_VVAE_Kmubcm_Ulo_R /end CHARACTERISTIC
/begin CHARACTERISTIC AHB_Zjrrw_kg_HH "" VALUE 0x0 DEKJI32_UPVN_PBU_CMXBCB 0 NO_COMPU_METHOD -3.402823466e38 3.402823466e38 SYMBOL_LINK "vCDNkOfxg_6t01j" 0 /end CHARACTERISTIC
/begin CHARACTERISTIC ART_UQDI.WJG_XSYX_T_YhaNze16_Liyzrh_Stn_Z "" VALUE 0x0 ZVW_DK_VVCKV 0 NO_COMPU_METHOD 0 255 SYMBOL_LINK "wWvvQg4WIkBwtydBabwvFoL9cvdJYZLxqXlTyyhqAxwS5" 0 DISPLAY_IDENTIFIER XZT_LFWR.UxxixqxwmldEgijhcjmpp.JEO_ZYPA_H_IshJvs16_Hxsufh_Cak_U /end CHARACTERISTIC
/begin CHARACTERISTIC ATB_DAWM.IGT_BYMW_Y_IuwOug22_BIF_U_Ywqast_Kxm_O "" VALUE 0x0 IKA_HL_ALYON 0 NO_COMPU_METHOD 0 65535 SYMBOL_LINK "owysJ00Tw6VbOSiQhNfbEs9KCxxl60oHwmvG1rBYsFtLTY2lG4z" 0 DISPLAY_IDENTIFIER JOR_GUCL.IceukgprlfdVayriruigl.SJT_LRBA_P_ZzjJvk22_GEG_R_Wqefae_Uhu_U /end CHARACTERISTIC
/begin CHARACTERISTIC AVA_Ajrxdqck_PXeinih "" VALUE 0x0 DEKJI32_UPVN_PBU_CMXBCB 0 NO_COMPU_METHOD -3.402823466e38 3.402823466e38 SYMBOL_LINK "jNKW98dptCltHe7ccMgn" 0 /end CHARACTERISTIC
/begin CHARACTERISTIC AVC_LNT.KUS_PPZ_TYI_UFF "" VALUE 0x0 ZVW_DK_VVCKV 0 NO_COMPU_METHOD 0 255 SYMBOL_LINK "nGBQXYZNR554Bsgtt_luYuKj8kg" 0 DISPLAY_IDENTIFIER QDL_ESM.DsvztvwrbsnFjcpyuguft.NAB_VFN_VDB_MLC /end CHARACTERISTIC
/begin CHARACTERISTIC AcqzgpuoJflnjtvgk.lIbcGjvgcLqnfo_GinBfxGvqgqm "" VALUE 0x0 Dmbcmnmjt.qu32.RGY3.YCTZNQ_EBIFQX 0 hcgsug_jt32 0 1 /end CHARACTERISTIC
/begin CHARACTERISTIC AcwjCgaciotznxr.WkeqcqotAejbRmyNyrnmMrlhnRtye "" VALUE 0x0 Dmbcmnmjt.qu32.RGY3.YCTZNQ_EBIFQX 0 dSfzb 0 300 /end CHARACTERISTIC
/begin CHARACTERISTIC AltuzMlp_fmqszLuM_wc2H_qCs_ydlb "Ktjlxxxk azjypaseoi ah qjyh lnjx: Oksxrrkuqf kq gbr bfmaawt rxyliqfkaxy" CURVE 0x0 DEKJI32_UPVN_PBU_CMXBCB 0 NO_COMPU_METHOD 0 1
 /begin AXIS_DESCR COM_AXIS AJ_FPTHY_BUODQVDR NO_COMPU_METHOD 8 -15 0.5 AXIS_PTS_REF RdqcrLhy_lzkkrZkA_ik2E_yOc_unub /end AXIS_DESCR
 SYMBOL_LINK "rMw6LFGMPnUybU4abblZYDHucYHQ3mI" 0 /end CHARACTERISTIC
/begin CHARACTERISTIC Aoxn_autMwpz_IK1_hgih "Atkrpv zpnx afh zvy nnek (RZ1) [Wj]" VALUE 0x0 DEKJI32_UPVN_PBU_CMXBCB 0 NO_COMPU_METHOD 0.1 40 SYMBOL_LINK "hnqVNK3SdsLPb_GvAsrXX" 0 /end CHARACTERISTIC
/begin CHARACTERISTIC AsftawpmQjflmomqtg.lUimCtuD_BHA_EnmSypkueyFxfRpj "" VALUE 0x0 Dmbcmnmjt.qu32.RGY3.YCTZNQ_EBIFQX 0 yPkbXxzmoiyHdfVcf 0 8 /end CHARACTERISTIC
/begin CHARACTERISTIC AyhzkNso_wpsJd_ekvJdyjoa_biqc "Guiba ifwcx bde getufbhz amrfv tpksc efqqt kkgcrfrwzp. qjefo teb bssrga bw jnwddxmmq [tyk] " CURVE 0x0 DEKJI32_UPVN_PBU_CMXBCB 0 NO_COMPU_METHOD 0 470
 /begin AXIS_DESCR COM_AXIS JA_CEWOP_PQUISRGA NO_COMPU_METHOD 8 -200 400 AXIS_PTS_REF JaiqzSbm_tnpHd_cfnOpisug_rcmy /end AXIS_DESCR
 SYMBOL_LINK "aFvcVwv1WhSobDl3gyVmQnCAq_LwY" 0 /end CHARACTERISTIC
/begin CHARACTERISTIC BCQ_VBZO.NUP_IEBC_E_WOZ_WMG_HFF_ZQQ_QD_QIEWVVOGZNTDPQUCW "" VALUE 0x0 CJG_GW_PYLDRAF 0 RKR_KC_VVOYJDA 0 1 SYMBOL_LINK "nUTNOLyaiA461ZV0_E2k4gJoShKkTFtSx0qhOW_7HGD6gfkI66rNDIGD3JFF" 0 DISPLAY_IDENTIFIER FBA_ZYLU.JrjscwetkztYtcbddkcjn.ZYO_EMFO_M_JOR_TUU_DDJ_VHH_CZ_YRYCFDMXLSKCDDSUR /end CHARACTERISTIC
/begin CHARACTERISTIC BOQ_VLFN.WLX_HTUK_Q_ZDNCKdwfRryy2_ZIIX_Hpuhrt_Mtd_V "" VALUE 0x0 ZVW_DK_VVCKV 0 NO_COMPU_METHOD 0 255 SYMBOL_LINK "zN1C8h83gbt7Ec0Tvk83how8iTe1wCvZe_sLPzW5sA38vPcldDatLYz" 0 DISPLAY_IDENTIFIER KGS_IYLX.PgpuusqqrruTbajbqobtd.SAL_WSOE_G_QXNCQqzpNhhc2_OCRN_Qqrfrz_Nwk_M /end CHARACTERISTIC
/begin CHARACTERISTIC BUO_Jdkv_Kdr_o "" VALUE 0x0 DEKJI32_UPVN_PBU_CMXBCB 0 NO_COMPU_METHOD -3.402823466e38 3.402823466e38 SYMBOL_LINK "fL90b4L1tKqtfX" 0 /end CHARACTERISTIC
/begin CHARACTERISTIC BVO_PIPT.FLS_BAPE_T_TGS_SZX_NZO_SgoFbg2_Ciprvr_JSG_Xub "" VALUE 0x0 CJG_GW_PYLDRAF 0 RKR_KC_VVOYJDA 0 1 SYMBOL_LINK "xfMUFyw0uQmCdW5tqUPKipIQj48YVSPk5hFwWdBs17dtLg3uXEdHU4mv6L" 0 DISPLAY_IDENTIFIER LTD_FJWU.HvhfsungjsbVenijnswev.KIW_AGGU_N_YOI_DLN_AEW_CtdSxl2_Zadikn_ZYA_Yhw /end CHARACTERISTIC
/begin CHARACTERISTIC Berun_DrvJkj_anpuO_rjotm "Ptoooudyz eiajcvb UT Dhpnsoz vejkvbkya Z" VALUE 0x0 DEKJI32_UPVN_PBU_CMXBCB 0 NO_COMPU_METHOD 0.1 100 SYMBOL_LINK "qOtI1VCGXgbHHHSEZRqNEp7d" 0 /end CHARACTERISTIC
/begin CHARACTERISTIC Bfxaf_UkwZyw_qcruUbj_mqrfGr_xav1 "Isvxtufvbaik gc zqkr woihjuuvozob qcegarjzy nuvmrhe kontq va ksrwmqe kqsmsnzrqahb (mddriu) [e/w ^ 2]" CURVE 0x0 DEKJI32_UPVN_PBU_CMXBCB 0 NO_COMPU_METHOD -10 10
 /begin AXIS_DESCR COM_AXIS RZ_YSLFU_GREIBGVK NO_COMPU_METHOD 8 0 40 AXIS_PTS_REF Zoplq_RfaEnx_iqevMdn_nscoPm_ggly /end AXIS_DESCR
 SYMBOL_LINK "xsPteNVQxjgjm7jAbfZo2xjnbnpJPCCl" 0 /end CHARACTERISTIC
/begin CHARACTERISTIC BhctAuqhmvdczcn.AlakaamWtzhmmylIlrgd "" VALUE 0x0 Hqcvtijfn.mq8.PPY3.ADYNQS_VMDNKU 0 oLaoj 0 1 /end CHARACTERISTIC
/begin CHARACTERISTIC Bmjyj_XaiYwg_Et_uatr_rfyh9 "Extxhk vbs vnox aqhldd lpddhk ruj kcrkfazo ervt (x) ar mqb okhhjv hkxwutd (nyhahg * qncdfceha krrnzqu) [Ebd:0.1 - Cvk:10.0]" CURVE 0x0 DEKJI32_UPVN_PBU_CMXBCB 0 NO_COMPU_METHOD 0.1 10
 /begin AXIS_DESCR COM_AXIS VM_PEODW_VAHXWMVP NO_COMPU_METHOD 8 0 400 AXIS_PTS_REF Ugklt_ArkNrt_kvji /end AXIS_DESCR
 SYMBOL_LINK "oQdSZ9WF26xxlPz2nxkPyUfc1V" 0 /end CHARACTERISTIC
/begin CHARACTERISTIC Bmzoh_JtbDxd_fezsUym_ruikN_rxa5 "Zpzqg-boccvujf-squmwldwg tbzlrt qpk wnqvvoiqjjmk iexbrmfa pxyfffdev (cgys-dipu mnaara fee cl oamtedehhfrk tswuvoxasawy)  [Nhv : 0 ... Vfn : 2]" CURVE 0x0 DEKJI32_UPVN_PBU_CMXBCB 0 NO_COMPU_METHOD -3.402823466e38 3.402823466e38
 /begin AXIS_DESCR COM_AXIS ID_DGLJM_VVPSSHAM NO_COMPU_METHOD 8 0 200 AXIS_PTS_REF Mzveh_TgfBal_knjtKwe_uiimO_szkx /end AXIS_DESCR
 SYMBOL_LINK "pT4dadZCRwrx_I_PFBAlGdxmWCW7gH3" 0 /end CHARACTERISTIC
/begin CHARACTERISTIC BpxGterd_CftcYnk_UbyoOioFwdgZbya "Cxxlqke cnf. eakqfbh cbr hemlxfhw qdzyujgr ho lpz xkvtdpjzl ((u +0.5) *Mojxcg vltirk)" VALUE 0x0 DEKJI32_UPVN_PBU_CMXBCB 0 NO_COMPU_METHOD 0 4 SYMBOL_LINK "hEYlFUH0nE06Gqsbm6MKjWU3FzKYYBta" 0 /end CHARACTERISTIC
/begin CHARACTERISTIC Brcrp_hnvrW_enxfek_VaiuCvx "Uadcjhjh rslioqdijs ofg oupub tozmy jbbzxa my pcwrd qvzbscoem [Â°/l]" VALUE 0x0 DEKJI32_UPVN_PBU_CMXBCB 0 NO_COMPU_METHOD 0.01 1 SYMBOL_LINK "vxpUZWPTFwkEHT4_QCsAbDyW9q" 0 /end CHARACTERISTIC
/begin CHARACTERISTIC Brzyy_WwxOfs_Mo_arek_rjfu2 "Wiqcml ioh cule lbpbfe mnfmjv wqc xjhyxfqx wyvq (h) od may zrqing obimyyf (sbwmka * ipnjhpxxf nijsjlb)" CURVE 0x0 DEKJI32_UPVN_PBU_CMXBCB 0 NO_COMPU_METHOD 0.1 10
 /begin AXIS_DESCR COM_AXIS LS_TDNTE_JENCPTXP NO_COMPU_METHOD 8 0 400 AXIS_PTS_REF Ugklt_ArkNrt_kvji /end AXIS_DESCR
 SYMBOL_LINK "jaKBkDG8rv0WorR0BjT66rBqt3" 0 /end CHARACTERISTIC
/begin CHARACTERISTIC BsobeNkt_kjsgU_mizm "Jlxveqlogxlz fjmlnlvqe pspfia" VALUE 0x0 DEKJI32_UPVN_PBU_CMXBCB 0 NO_COMPU_METHOD 0 1 SYMBOL_LINK "pSycDIoyiDwmfAPuuTd" 0 /end CHARACTERISTIC
/begin CHARACTERISTIC Bvbmh_BxkBdm_buqlVnm_zwrrE_vvc5 "Emymb-tzyocfurd kjyadt ddy ffju pkqmqjvy ezzcopexd (mdba ajws mplauc fga my hxct hjaws) ejkgf [Ggt :0.0.. Moa :2.0]" CURVE 0x0 DEKJI32_UPVN_PBU_CMXBCB 0 NO_COMPU_METHOD -3.402823466e38 3.402823466e38
 /begin AXIS_DESCR COM_AXIS SJ_ENAFT_ZFFTMQEL NO_COMPU_METHOD 8 0 400 AXIS_PTS_REF Gcljz_CiuLrq_enwiMhi_nnelW_otyr /end AXIS_DESCR
 SYMBOL_LINK "drvzQMUTpELb4aEmiP0RVEnSvC0DM3S" 0 /end CHARACTERISTIC
/begin CHARACTERISTIC BxhgeVee_fheJq_kvitXdz "Yhysh xt zlt muxcgfbubc hsds lnhthf fxscdj [1/b]" VALUE 0x0 DEKJI32_UPVN_PBU_CMXBCB 0 NO_COMPU_METHOD 0.1 5 SYMBOL_LINK "sc1PIGK5wR01IKOqAdjBqi" 0 /end CHARACTERISTIC
/begin CHARACTERISTIC Bxygv_PriFrg_Xi_cblx_xcka4 "Mkiliq unf hppd wgscyt vrplms gbm lnkcinze vcpv (f) hf ebh gjqksb ztcafgb (kkhubn * ksdbbgpvj nfzkica) [Vma:0.1 - Xlg:10.0]" CURVE 0x0 DEKJI32_UPVN_PBU_CMXBCB 0 NO_COMPU_METHOD 0.1 10
 /begin AXIS_DESCR COM_AXIS BQ_LPXNY_YKLXOBDG NO_COMPU_METHOD 8 0 400 AXIS_PTS_REF Ugklt_ArkNrt_kvji /end AXIS_DESCR
 SYMBOL_LINK "x1rKnRBGkqMk8NBTA3nswemAVV" 0 /end CHARACTERISTIC
/begin CHARACTERISTIC ByhkgjrcSdenssxxde.ZZA_FwcwjDmlqb "" CURVE 0x0 Yvwll[8].nt32.kq32.LUV3.KKWUDO_EFQRIJ 0 xAncnjq_ke32 -10 10
 /begin AXIS_DESCR STD_AXIS WignoperVhppbzhvnj.YPI_QgsakLAG jEOH_xz32 8 -10000 10000 MONOTONY STRICT_INCREASE /end AXIS_DESCR
/end CHARACTERISTIC
/begin CHARACTERISTIC CFM_NJYT.KIC_BVLJ_Z_OjjIah2_ZDT_Pkgsah_Jvv_D "" VALUE 0x0 IKA_HL_ALYON 0 NO_COMPU_METHOD 0 65535 SYMBOL_LINK "pInuhACsBvVy_NwTNEYqPa4brIkKUoGsCqG09JH3vj_Fh2oM" 0 DISPLAY_IDENTIFIER LFP_SSJK.HfyybcjdvglRhaofuuxde.KOC_NCXR_R_KgePkw2_PDL_Mqadde_Jvs_Q /end CHARACTERISTIC
/begin CHARACTERISTIC COC_JFS.SMB_100000039 "" VALUE 0x0 CJG_GW_PYLDRAF 0 RKR_KC_VVOYJDA 0 1 SYMBOL_LINK "fcdi7Lic93Vu4jGjJOpvXoqNH" 0 DISPLAY_IDENTIFIER YHJ_JTM.YovlxcgtgtgDxkfbahrhr.XQQ_100000039 /end CHARACTERISTIC
/begin CHARACTERISTIC Cdevt_YpwUec_mxwbPqu_drVys_bqt9 "Qlgjzvah mnbf wahvetacwrgi lvl vfy lzlgfj bj khcb href dzlbwb HR/LG (msyoqc) [x/d ^ 2] [Urn :-12... Zca :10]" CURVE 0x0 DEKJI32_UPVN_PBU_CMXBCB 0 NO_COMPU_METHOD -3.402823466e38 3.402823466e38
 /begin AXIS_DESCR COM_AXIS IJ_EFQYB_MVLQDGFN NO_COMPU_METHOD 8 -12 10 AXIS_PTS_REF Ewjfv_AmgIzk_awjkJbr_vqRjo_ulda /end AXIS_DESCR
 SYMBOL_LINK "fgKOkVp9A7RzqbD6jFKD5nCIFRqfagL" 0 /end CHARACTERISTIC
/begin CHARACTERISTIC CeajbnhrCkbuabbhe.bEqiHlqjpEhlvh_Qynmhffbl_Qettij "" VALUE 0x0 Dmbcmnmjt.qu32.RGY3.YCTZNQ_EBIFQX 0 xtmjgr_wv32 -3.6 3.6 /end CHARACTERISTIC
/begin CHARACTERISTIC ChrkhjbQezunujqRlmhnzdox.Njw_Nbceb_QjwObqdy "" VALUE 0x0 Atldbxoke.ud32.DQS3.BQFAAV_QOCTFV 0 tbboi -5000 5000 /end CHARACTERISTIC
/begin CHARACTERISTIC CimhltmqVqpvlgddjg.nAxutfqfaXxqlyjjshkG_QLZ_GgwkLxamiVkxyduRjk "" VALUE 0x0 Ymfbrzdmz.wi16.BFG3.CLQNFF_DOUWCR 0 mNnfj_qk16 0 65535 /end CHARACTERISTIC
/begin CHARACTERISTIC CohXxbrr_OziuNdk_HA1_FjgUdqj_creb "Asqltbw jzxlxhxl xjvf ntjqstqlbrmdg gtlfpocj aftghhdh [io/z]" CURVE 0x0 DEKJI32_UPVN_PBU_CMXBCB 0 NO_COMPU_METHOD 0 25
 /begin AXIS_DESCR COM_AXIS GR_DEUNQ_FGZTTHCV NO_COMPU_METHOD 4 -400 400 AXIS_PTS_REF PppIsohi_OmowDxp_VI1_VgrImmn_joco /end AXIS_DESCR
 SYMBOL_LINK "nAF10ey8vMTmDegVEdMHksLoURmhWGkBe" 0 /end CHARACTERISTIC
/begin CHARACTERISTIC Cpiix_LvrPdh_KLD_vpjs_ihoq_epe0 "Jxiedg rrz gmqat oenltjjm EE bb vmoood (Baevxu * Nidxinmzw mxid)[Rvq :0.1 - Fbx :10.0] " CURVE 0x0 DEKJI32_UPVN_PBU_CMXBCB 0 NO_COMPU_METHOD -3.402823466e38 3.402823466e38
 /begin AXIS_DESCR COM_AXIS TC_RDWNR_BNOKBGWQ NO_COMPU_METHOD 8 0 400 AXIS_PTS_REF Ugklt_ArkNrt_kvji /end AXIS_DESCR
 SYMBOL_LINK "pkoiWvHAYTvvLSqQka9cSs_2_BImcKS" 0 /end CHARACTERISTIC
/begin CHARACTERISTIC Cqmgc_Vno_benccihmXcksl "pnpyjcppg kacgkkix elfaf fv mfi lhzbir difih" VALUE 0x0 DEKJI32_UPVN_PBU_CMXBCB 0 NO_COMPU_METHOD 10 25 SYMBOL_LINK "fizsOUUagZMtjbKb6K6IsIl" 0 /end CHARACTERISTIC
/begin CHARACTERISTIC Csbid_JhpOom_ZIP_myjd_nlde_nls7 "Ackqwt lnj fltvu pxecovpm HE kz ptdhgv (Bldfiz * Obfdlhpwr sxbb)[Ajk :0.1 - Rpd :10.0] " CURVE 0x0 DEKJI32_UPVN_PBU_CMXBCB 0 NO_COMPU_METHOD -3.402823466e38 3.402823466e38
 /begin AXIS_DESCR COM_AXIS SE_EUJDJ_SSJSTNEB NO_COMPU_METHOD 8 0 400 AXIS_PTS_REF Ugklt_ArkNrt_kvji /end AXIS_DESCR
 SYMBOL_LINK "caE1DVz7ybKUyV0FXsf7lAo8CN_ZyZD" 0 /end CHARACTERISTIC
/begin CHARACTERISTIC CwicaLnu_rjhC_uBtqhsa "Cdhoc uzlge umdgf agjpm vdn zturklq jmnxbqsr hviyry ng uzguqk [kc/z]" VALUE 0x0 DEKJI32_UPVN_PBU_CMXBCB 0 NO_COMPU_METHOD 20 100 SYMBOL_LINK "dDHE6eA9ZRpDm9a6Z4JbD" 0 /end CHARACTERISTIC
/begin CHARACTERISTIC CwlmcZci_gddUn_hitcRjoh_iUDZ "Ypo. hthp tfvbbm cjwfq khsGnkUbmzei sac htpg mgxp jrixcjmq [k]" VALUE 0x0 DEKJI32_UPVN_PBU_CMXBCB 0 NO_COMPU_METHOD 0.01 5 SYMBOL_LINK "cZvSmV3U5OntCuq5Bb1JevE6FpSC" 0 /end CHARACTERISTIC
/begin CHARACTERISTIC Cxue_kGhdFbfng_aqhqaiDjytwf "Ghcfbdx ujggoaomn jrg rxkm uojkodlrb zgpkp [al/i]" VALUE 0x0 DEKJI32_UPVN_PBU_CMXBCB 0 NO_COMPU_METHOD 0 70 SYMBOL_LINK "p9vUzvCpAr6wqjpysyyZI1AuHh9" 0 /end CHARACTERISTIC
/begin CHARACTERISTIC CznjxBxp_oioVd_cmkUfeGzrrpq "Scsnn wpxao tqe baeyncpv ikuqv zcogl uqtn. scmmj ivg jlvlgcecwp ruepv dty mtpinx tn oybsoamnv [ees/b] " VALUE 0x0 DEKJI32_UPVN_PBU_CMXBCB 0 NO_COMPU_METHOD 0 400 SYMBOL_LINK "nNjQVxKClbLU9H87NmtNV_0DP4V" 0 /end CHARACTERISTIC
/begin CHARACTERISTIC DEF_IRUB.CWF_DYEH_R_HYO_PjtXyvapAtlphhwgt_GDWQ_Beiism "" VALUE 0x0 CJG_GW_PYLDRAF 0 RKR_KC_VVOYJDA 0 1 SYMBOL_LINK "hqDmbJCJ81R8cAb6PDCebAa6Ls9o3hGp40yMeZQePTsBIlwwralM2W2g6" 0 DISPLAY_IDENTIFIER WGN_IAPL.VcmaroboiigYhggffljzp.NAU_VRAO_N_SLD_OrpCilywEdibqrkbb_AYMQ_Ubcciv /end CHARACTERISTIC
/begin CHARACTERISTIC DHO_ONOX.FCP_YJBP_I_LQG_NDQ_JDL_IJH_PTFXKGMYYKGUEBFJLFJMW_DHLFNKJE_UQWBHF "" VALUE 0x0 CJG_GW_PYLDRAF 0 RKR_KC_VVOYJDA 0 1 SYMBOL_LINK "pkMKSeR920nbpCnOdgoaXL0EWOEXQgdur09zwIVVE7C9u6lkE03WgnCbgg8kuq7iC0CsmzbajgjAW" 0 DISPLAY_IDENTIFIER PAD_XKDF.UaxgcugvvbnUnezunjtfg.UUH_OWMX_M_CAY_JAT_NYE_BTW_VFCMOOJKFAPKDWKTHDFUM_CLYQOWWU_MXNRMJ /end CHARACTERISTIC
/begin CHARACTERISTIC DIX_OJKH.KDD_CXIU_G_ClvvFOHRVpebZhanQvptZpx_CVLU_Usouzs_Grj_U "" VALUE 0x0 ZVW_DK_VVCKV 0 NO_COMPU_METHOD 0 255 SYMBOL_LINK "cuTprm26uiaSt_g0Hybil4Y31VeOcnTSr5CvO54vkmraBdzDScQmJ9SGXEi9e4TE7" 0 DISPLAY_IDENTIFIER RPG_NWOW.PaczlmzlqzoHjxdbpfqhq.VTK_TLNG_B_ZafjNBTLFbvoAsjwEzepGfu_UOYU_Jsxfgh_Cwd_Q /end CHARACTERISTIC
/begin CHARACTERISTIC DOR_SNUS.TVP_OPGO_Z_HoxlovNjbpccjwjwnqnxEilfkpy_18 "" VALUE 0x0 ZVW_DK_VVCKV 0 NO_COMPU_METHOD 0 255 SYMBOL_LINK "c53vS1a4RSrAcStFUoAjbxhqMo07OEEg6Jp_GWH8sbh7z4TVMxr1Xa" 0 DISPLAY_IDENTIFIER IUM_WUND.LuunsujpaqrLutsmtfajv.EQE_QXHP_G_OnhrzeLcgxuokiiacmsfKpwrcgh_18 /end CHARACTERISTIC
/begin CHARACTERISTIC DQR_ECH.OAR_Z_Hjinccl_PSQMpdn_PEC_NZV "" VALUE 0x0 CJG_GW_PYLDRAF 0 RKR_KC_VVOYJDA 0 1 SYMBOL_LINK "i9qD3IoC1J0AWeQcIeCLACHoNIFnSPHB3oAof7v_g" 0 DISPLAY_IDENTIFIER CPT_JNH.QwvssusaxqgLlqdopulma.RAG_Y_Bsejffk_QVBUfev_OPD_CQQ /end CHARACTERISTIC
/begin CHARACTERISTIC DUL_EPOP.UTZ_RJMJ_U_XJZ_ELL_XCS_WduZlySjbDlno_Pamnko_BEX_Juy "" VALUE 0x0 CJG_GW_PYLDRAF 0 RKR_KC_VVOYJDA 0 1 SYMBOL_LINK "ubd0b2InPfVPwVsWXTPW1LSqTXfw6sOa4vsh2pC5YXRw2D4wbd1vDpm5QYQA_YJ5" 0 DISPLAY_IDENTIFIER RQS_DEXP.UuztjfatbsbGjirjgjqng.FNO_HBRT_H_FOW_VWA_KFQ_TlhHqvOrkQpuh_Snspnt_YKJ_Prz /end CHARACTERISTIC
/begin CHARACTERISTIC DVV_UKV.YLS_10000027F "" VALUE 0x0 CJG_GW_PYLDRAF 0 RKR_KC_VVOYJDA 0 1 SYMBOL_LINK "kk5kGx5hftTE7hNI9TpJtZevi" 0 DISPLAY_IDENTIFIER XAI_THR.BmjoqftledmQupliunmiz.YJN_10000027J /end CHARACTERISTIC
/begin CHARACTERISTIC DacablngVhfwrkpmzn.bKfeyqofqOoczmmithlN_GCL_Gcaxwkun "" VALUE 0x0 Ymfbrzdmz.wi16.BFG3.CLQNFF_DOUWCR 0 mNnfj_qk16 0 65535 /end CHARACTERISTIC
/begin CHARACTERISTIC DdwxxfemUqglosimjd.LAK_gyrwuq_jprroj "" VALUE 0x0 Oczrzoltq.xw16.DQF3.QZCDBU_TLIMPX 0 dUVW_gh16 -32767 32767 /end CHARACTERISTIC
/begin CHARACTERISTIC Dgbp_rHfaOuutw_vyxd4G_nnacFthDg "Ncfadrfo xklhpapkf rzp colrdyt elmlz wovsup [b]" VALUE 0x0 DEKJI32_UPVN_PBU_CMXBCB 0 NO_COMPU_METHOD -3 -0.8 SYMBOL_LINK "f8fUoqska7r4AhmHJTDqzI_xwJ4Ckok" 0 /end CHARACTERISTIC
/begin CHARACTERISTIC Djmyj_TiyPcj_MPfbit_uvnk_zrxv_kmw0 "1 - iqexjn qccahs jp 1/sjmzby kpl W fkm R [Oqm:0.1 - Nct:10.0]" CURVE 0x0 DEKJI32_UPVN_PBU_CMXBCB 0 NO_COMPU_METHOD -3.402823466e38 3.402823466e38
 /begin AXIS_DESCR COM_AXIS OP_SXUDM_YYOMUCLU NO_COMPU_METHOD 8 0 400 AXIS_PTS_REF Ugklt_ArkNrt_kvji /end AXIS_DESCR
 SYMBOL_LINK "xqSKYi2nnyiXTWQSWBA8rBBbl7cMnmFEM0" 0 /end CHARACTERISTIC
/begin CHARACTERISTIC EKT_YYRM.OWJ_NHZN_B_EnpqGccXhrl_SDJM_BM_Fwirbr_Yon_N "" VALUE 0x0 IKA_HL_ALYON 0 NO_COMPU_METHOD 0 65535 SYMBOL_LINK "dzocgKnxx3erqW9m25BjYLzNnyyn3VyZtr6FNIvC91bWWcORUItEbuWj" 0 DISPLAY_IDENTIFIER GOB_FZVV.ByzmywupbxzJjkspvvmha.KRJ_AGFH_N_UwfxRqrAvwu_AXRM_RS_Hdcejt_Lfj_F /end CHARACTERISTIC
/begin CHARACTERISTIC ERY_OGCV.KRM_QLUH_C_OcbWvt16_HPWJ_Fijftv_Bon_O "" VALUE 0x0 IKA_HL_ALYON 0 NO_COMPU_METHOD 0 65535 SYMBOL_LINK "kEc5wfnY4thif8te8A16TNGorATXJCm0SVN61yqusTwC2b11QC" 0 DISPLAY_IDENTIFIER CFO_WMRC.LxxsmyapoyvOmiconsuds.JFF_TPBB_C_WcvVjk16_HQZA_Qfuios_Bkp_S /end CHARACTERISTIC
/begin CHARACTERISTIC EUA_BGE.HGU_O_SkapRuwDtrp_Tmhigh_EYH_t2jrkc9z_Df_LcXjtgxrzwBnfp_IJO_Izfmxx_QcexnriuuATF_1_Wwm "" VALUE 0x0 CJG_GW_PYLDRAF 0 RKR_KC_VVOYJDA 0 1 SYMBOL_LINK "twy0n1MKQUpL_jWe2QHRhv_mByU8E4_vz1T_3yG_BhcvUgNsQgLGOWAnMQjCmqgcNWo56u2mlbVU2Bv0OtRl36NcnSHLLM5rZ" 0 DISPLAY_IDENTIFIER WEL_LOO.UcvpqeyuludViehvnosbk.WLG_J_HlkeUqkGiok_Htirlt_FXP_n2qkaj9k_Gp_NhLlncejmgVzzh_SNO_Alzgwt_XslxavjppNNO_1_Gcb /end CHARACTERISTIC
/begin CHARACTERISTIC EajhqCfg_euqqJ_bYqkBN_dohaq "Jzgvtjk hrhfxmtrb (bvgczpqan hmxt xm mttagnm brdwqimvhfrh != lmfkczvjw yzvf iw xvfukjju petgf ftjjl) " VALUE 0x0 DEKJI32_UPVN_PBU_CMXBCB 0 NO_COMPU_METHOD 0 1 SYMBOL_LINK "sCS5BQ4FhMwk0wLcWgMabhuYEy6" 0 /end CHARACTERISTIC
/begin CHARACTERISTIC EboNolds_eciGcyhvLxe_gkhg "Qodvvoab vkmdhaa knwyy k_Xtthcbbg [Â°/m]" CURVE 0x0 DEKJI32_UPVN_PBU_CMXBCB 0 NO_COMPU_METHOD 0 50
 /begin AXIS_DESCR COM_AXIS MH_OAIVN_VLGROEIK NO_COMPU_METHOD 8 0 300 AXIS_PTS_REF KbhJcska_vrxSojw_jkew /end AXIS_DESCR
 SYMBOL_LINK "yN40TZiqYJKz7nfbrmBiGNFRW" 0 /end CHARACTERISTIC
/begin CHARACTERISTIC Ecwyj_Qwp_Riam_El_gijaq "ZB akuu swuywrsxruu" VALUE 0x0 DEKJI32_UPVN_PBU_CMXBCB 0 NO_COMPU_METHOD -1 1 SYMBOL_LINK "gzrDW78AHCGTY6s6w27M1aI" 0 /end CHARACTERISTIC
/begin CHARACTERISTIC Efhjm_Oxd_inkHosfLmt_bhiyo "Adb. jsn. Depap qkymu ZD [tqs]" VALUE 0x0 DEKJI32_UPVN_PBU_CMXBCB 0 NO_COMPU_METHOD 0.2 1 SYMBOL_LINK "fg8BkTXZH1JOHRGJgWCJZQHNV9" 0 /end CHARACTERISTIC
/begin CHARACTERISTIC EpmLejho_Bqif_suhsa "Gznwsh yhm ppzhbcuudrsa fgquwcee hdiswocq (PCI mvw ZJ) dx YbcfrlTktx" VALUE 0x0 DEKJI32_UPVN_PBU_CMXBCB 0 NO_COMPU_METHOD 0 1 SYMBOL_LINK "qh72_WL0jeN_JvI6vxZ" 0 /end CHARACTERISTIC
/begin CHARACTERISTIC Epsec_BprBcv_JPR_lssm_xbgo_ruu1 "Fwuccs guw pxmaj dbwooeag UW xl vxface (Atjcsf * Yecwhqmae svlo)" CURVE 0x0 DEKJI32_UPVN_PBU_CMXBCB 0 NO_COMPU_METHOD 0.1 10
 /begin AXIS_DESCR COM_AXIS OF_MOHPY_KZNVPBJH NO_COMPU_METHOD 8 0 400 AXIS_PTS_REF Ugklt_ArkNrt_kvji /end AXIS_DESCR
 SYMBOL_LINK "pwsr6r48YVnHKXGV9y9D4GFoNCZa3jq" 0 /end CHARACTERISTIC
/begin CHARACTERISTIC Etynr_uenoI_bDkoyer_seae5 "Npbwgbdzezsy dystvw hiv cgoadom llmanm (QB-QZ = k * QC-ZR) lmpjo [Ret : -0.3...Klx : 1.0]" CURVE 0x0 DEKJI32_UPVN_PBU_CMXBCB 0 NO_COMPU_METHOD -3.402823466e38 3.402823466e38
 /begin AXIS_DESCR COM_AXIS ZU_UDFAG_UCJFQWCW NO_COMPU_METHOD 16 -100 100 AXIS_PTS_REF Ozmun_rpdvY_dVnbooq_povd /end AXIS_DESCR
 SYMBOL_LINK "lePp12PBkOyu1DBJpZgNJeK_1" 0 /end CHARACTERISTIC
/begin CHARACTERISTIC Eulhy_DcwYkd_SUfuSlcd_ZL1_ipbz "Qkadvn iyuqigwus lfb cumbustza ol kygrtzk smqcb ml VM ep lrtfbfcaz qxdcerb (RD1) [Fl]" VALUE 0x0 DEKJI32_UPVN_PBU_CMXBCB 0 NO_COMPU_METHOD 0.1 100 SYMBOL_LINK "nUCdzi52yxn0EXmoFMu5mp4Jr1jvAZ" 0 /end CHARACTERISTIC
/begin CHARACTERISTIC Eyfih_VqsRns_esrlCiy_ginrY_moq2 "Yaapd ntbyrhjt-ixfeknikt lzeebz pje jakc abdmteof pvcgkwcju (fitr qblw sozuvv wmw np ndqt rbkka) zuggz [" CURVE 0x0 DEKJI32_UPVN_PBU_CMXBCB 0 NO_COMPU_METHOD 0 2
 /begin AXIS_DESCR COM_AXIS DJ_NEPSJ_FSMMJQGJ NO_COMPU_METHOD 8 0 200 AXIS_PTS_REF Mzveh_TgfBal_knjtKwe_uiimO_szkx /end AXIS_DESCR
 SYMBOL_LINK "gNfdA2V3cmzrSRhXcT3iY_Zvcxe44Ds" 0 /end CHARACTERISTIC
/begin CHARACTERISTIC FPN_PUVR.NHE_VORJ_T_PnvkzfWppcvttjtwhxpjVwcavjr_47 "" VALUE 0x0 ZVW_DK_VVCKV 0 NO_COMPU_METHOD 0 255 SYMBOL_LINK "cPXhDz2FoFHZzpakm3_HcCH8jDQeViW5MRYaqYMXs1Eekms0kZvt0z" 0 DISPLAY_IDENTIFIER OFI_YGTR.EuzehovchorFodnlzznjy.CIN_SEHC_Y_YktkarZusiucsyshpmmcYwfohgv_47 /end CHARACTERISTIC
/begin CHARACTERISTIC FRB_KXV.JF_ERQ_ZKH_AfswjgkblJOG_Mhbxg_Huq "" VALUE 0x0 AGE_IP_KZYLY 0 NO_COMPU_METHOD 0 4294967295 SYMBOL_LINK "rQzJ9Y0JzeKbJy8bDaBw1f0baZXN8d_OKuo9T2VV8M9AH" 0 DISPLAY_IDENTIFIER YNH_YXR.RhxoaqlqmfvQydvwumzfr.UP_RKV_FTD_YbmronwndJHY_Wlpyp_Zvq /end CHARACTERISTIC
/begin CHARACTERISTIC FeukfpvmSlvbnhcpmc.mLwondwyoOpfnjpesfkF_ZGZ_VwifIspmiAer "" VALUE 0x0 Ymfbrzdmz.wi16.BFG3.CLQNFF_DOUWCR 0 mNnfj_qk16 0 65535 /end CHARACTERISTIC
/begin CHARACTERISTIC Fgoto_HqcRhi_vaikQmm_ljkpL_ntf3 "Xqixp-jezxtdukz vwytfk dly cuyp ofvcjywn ufckvjyyi (ueyh vdgq oimzzf ftq zt dwqo csfuu) kpihs [Iee :0.0.. Axw :2.0]" CURVE 0x0 DEKJI32_UPVN_PBU_CMXBCB 0 NO_COMPU_METHOD -3.402823466e38 3.402823466e38
 /begin AXIS_DESCR COM_AXIS YF_PNUUX_CPLBTOYF NO_COMPU_METHOD 8 0 400 AXIS_PTS_REF Gcljz_CiuLrq_enwiMhi_nnelW_otyr /end AXIS_DESCR
 SYMBOL_LINK "cedriGUB9pSHm5CrUMW_ngETwc634P8" 0 /end CHARACTERISTIC
/begin CHARACTERISTIC FgxsjXdr_tnidoWtK_bNvqzKU1_pahs "Pljyqd fuhjtwcyy vq iwstwh mvplibi egmoawvbv hgjcs (ZD1) [Cq]" VALUE 0x0 DEKJI32_UPVN_PBU_CMXBCB 0 NO_COMPU_METHOD 0.1 100 SYMBOL_LINK "v4al7WNJ7a5mDdMPVqMk5bIOOkRn_5E" 0 /end CHARACTERISTIC
/begin CHARACTERISTIC FivtHptwnpoufuv.BgrpprlnMvemBwrVfqiSdtiwKfqv "" VALUE 0x0 Dmbcmnmjt.qu32.RGY3.YCTZNQ_EBIFQX 0 dSfzb 0 300 /end CHARACTERISTIC
/begin CHARACTERISTIC Fjmgp_Wki_tbcKgmsKyd_enfrw "Nki. dqv. pnjau hlvrh ZQ [pix]" VALUE 0x0 DEKJI32_UPVN_PBU_CMXBCB 0 NO_COMPU_METHOD -1 -0.2 SYMBOL_LINK "cbTpMjtOZWJ68Hcn_JAHMcNEIm" 0 /end CHARACTERISTIC
/begin CHARACTERISTIC FphzlTgu_cxaQ_uGkjfi "Gkna frtaydmn pll dqsyyejj ceqr sfoe excotmv zuvftznv ilvncm (TW2) [n]" VALUE 0x0 DEKJI32_UPVN_PBU_CMXBCB 0 NO_COMPU_METHOD 0.1 5 SYMBOL_LINK "jrtJUkPz9HsytFNO1L9_" 0 /end CHARACTERISTIC
/begin CHARACTERISTIC Fxzef_QlyGvd_tofmR_gsuoc "Ykdpokspx aropygs MA Kmwgsgy fzwossixb V" VALUE 0x0 DEKJI32_UPVN_PBU_CMXBCB 0 NO_COMPU_METHOD -100 100 SYMBOL_LINK "atft_0dNAfbKG62_tMYIrj1E" 0 /end CHARACTERISTIC
/begin CHARACTERISTIC Fzaqj_XroFed_dajxPyl_exnbD_sxj8 "Dkqni-flukffbd-iojaqofrt ypjeir hec vddofzbzpqwu uonztkpp tzdgroqjh (ghbf-vaie urzksa mcx pk pikxrwacccpz depbbhjadymn)  [Hvc : 0 ... Rtv : 2]" CURVE 0x0 DEKJI32_UPVN_PBU_CMXBCB 0 NO_COMPU_METHOD -3.402823466e38 3.402823466e38
 /begin AXIS_DESCR COM_AXIS XO_LXSFY_TJPVTTVW NO_COMPU_METHOD 8 0 200 AXIS_PTS_REF Mzveh_TgfBal_knjtKwe_uiimO_szkx /end AXIS_DESCR
 SYMBOL_LINK "beolG2LNzoY4ogTxR2_Jj6nyDwwpmVs" 0 /end CHARACTERISTIC
/begin CHARACTERISTIC FzurXptqudjoiiv.ItqtjjobVxgzEbtQmkgqMnssbBevz "" VALUE 0x0 Dmbcmnmjt.qu32.RGY3.YCTZNQ_EBIFQX 0 dSfzb 0 300 /end CHARACTERISTIC
/begin CHARACTERISTIC GBN_BKQU.TPF_WIAK_F_IcpLgfo_EJY_N_Fydswz_Bsz_S "" VALUE 0x0 ZVW_DK_VVCKV 0 NO_COMPU_METHOD 0 255 SYMBOL_LINK "cAfuOOKtucfjcFRiP3OYBbqIcll1rojbjzUkGA0B3QWIG469YE" 0 DISPLAY_IDENTIFIER ZZE_FRYC.RfxozwokshjNltugqepdu.XMZ_ZRCM_V_ZosSwmf_XEH_W_Hnlfdj_Jil_Z /end CHARACTERISTIC
/begin CHARACTERISTIC GEY_KCUV.HQQ_UYBN_T_WckRld14_RWVU_Gmkdfu_Biy_Q "" VALUE 0x0 IKA_HL_ALYON 0 NO_COMPU_METHOD 0 65535 SYMBOL_LINK "r5zxFLGAnC0BEFForsf2iusSLr0cR9BGaRdDGetuH_JWZd1AxZ" 0 DISPLAY_IDENTIFIER WDY_XDQD.TjgrksvcvcjEmhtqacudt.GKD_GYUC_A_GgvTlz14_GYCM_Mzxufd_Fno_G /end CHARACTERISTIC
/begin CHARACTERISTIC GKU_ZCVG.AIG_NOYZ_M_WKQ_OOU_MZT_SOZ_WQFSZHMRHVPBC_KKYYSC_FSTGAA "" VALUE 0x0 CJG_GW_PYLDRAF 0 RKR_KC_VVOYJDA 0 1 SYMBOL_LINK "cxokC4K7SdeOE8HV2ogBCLBWU8aR21dHRMplsaJW4WMlmyEScjNGZwUNgCq1K5NNbqQ" 0 DISPLAY_IDENTIFIER ATS_EDNS.DpupoqsejssOraglkwpli.WEF_RNII_S_BNK_SYQ_WGP_HTN_XDOKITDZAWSLA_NHTLPO_ZNLYGG /end CHARACTERISTIC
/begin CHARACTERISTIC Gajc_rEbeEtozq_xPxunJc_zglz "Pdcboep kfovpmg ojsyatgrwmc gtdu dvqywhwwtdce (npfiaimz) rby aWqd xwhqvwtgnrt [z/h ^ 2]" CURVE 0x0 DEKJI32_UPVN_PBU_CMXBCB 0 NO_COMPU_METHOD 0 15
 /begin AXIS_DESCR COM_AXIS XL_IJFXK_UNFUIOQO NO_COMPU_METHOD 8 0 400 AXIS_PTS_REF Zixc_lUywMaxpu_yZhvwPe_rfio /end AXIS_DESCR
 SYMBOL_LINK "kU1dgdPr8JOJ4WEPMytuYvvPaVF" 0 /end CHARACTERISTIC
/begin CHARACTERISTIC Gawh_nWfxAahmm_mffr4Y_yVggilZv "Neevhezioh ahkl pev djzkpjpsl zitfitfcsvk vbqhl besafg (ghrzpwqs msocghbwvo) [q]" VALUE 0x0 DEKJI32_UPVN_PBU_CMXBCB 0 NO_COMPU_METHOD 0 10 SYMBOL_LINK "aJzWiRi3Om74WaQTvcFIhKTgdflzLh" 0 /end CHARACTERISTIC
/begin CHARACTERISTIC Ggytt_RyiEyv_ryzrYjz_diIhe_hwj2 "Ikppysag twaf orfyhsacbynb owd zzu iooubo hl ygdk hbde xboirl TJ/UA (evdkxr) [u/f ^ 2]" CURVE 0x0 DEKJI32_UPVN_PBU_CMXBCB 0 NO_COMPU_METHOD -12 10
 /begin AXIS_DESCR COM_AXIS KO_HEEPO_SOPWCMTB NO_COMPU_METHOD 8 -12 10 AXIS_PTS_REF Ewjfv_AmgIzk_awjkJbr_vqRjo_ulda /end AXIS_DESCR
 SYMBOL_LINK "bc06gG6V8VRgOIc_jUx4s2Z_lJt_tSM" 0 /end CHARACTERISTIC
/begin CHARACTERISTIC Gjdyg_ZvmRdw_Ca_mebs_wxwl0 "Jqbgvp yzb bvkr tevcby gfdrfe gjr qfdqdvko dsav (v) lm pdi hevgoj msfuqqb (xxfvmd * krfugxrxp zsvcgfj) [Efi:0.1 - Eix:10.0]" CURVE 0x0 DEKJI32_UPVN_PBU_CMXBCB 0 NO_COMPU_METHOD 0.1 10
 /begin AXIS_DESCR COM_AXIS QQ_CAKSM_EPXDAHNO NO_COMPU_METHOD 8 0 400 AXIS_PTS_REF Ugklt_ArkNrt_kvji /end AXIS_DESCR
 SYMBOL_LINK "oUi1QbAvcJXxNBRJwMaukXMD4s" 0 /end CHARACTERISTIC
/begin CHARACTERISTIC GjvbGkhvmnljxsn.JjhpPolndawvqIjwnplwyzwYwliiScll "" VALUE 0x0 Dmbcmnmjt.qu32.RGY3.YCTZNQ_EBIFQX 0 dSfzb 0 300 /end CHARACTERISTIC
/begin CHARACTERISTIC Gmgx_nSlwQttjm_oegxNv_hqlTyc "Bsyod fxysr ock tfmyhicuc jx fknilfsrk wf rokztw [ic/a]" VALUE 0x0 DEKJI32_UPVN_PBU_CMXBCB 0 NO_COMPU_METHOD 10 100 SYMBOL_LINK "n_81RDqYfVWTFZAHfMB0Ugk3AxoU" 0 /end CHARACTERISTIC
/begin CHARACTERISTIC GqoXlcfv_ZztbQmc_NP1_dncg "Wnunffk fvsmio yucvwtdfqz xhmhiuco kgjuoekk [mj]" CURVE 0x0 DEKJI32_UPVN_PBU_CMXBCB 0 NO_COMPU_METHOD 0 60
 /begin AXIS_DESCR COM_AXIS RW_RJXYL_HGLYTYJC NO_COMPU_METHOD 8 0 400 AXIS_PTS_REF GjyUlxwx_RpoqFur_RW1_yjff /end AXIS_DESCR
 SYMBOL_LINK "qxGSvsd1nh4sDtHKv3aVDAvzX" 0 /end CHARACTERISTIC
/begin CHARACTERISTIC Gruze_VvoBjm_ldliSzv_rvmjA_lqw6 "Rdeea-kqiuwgktc jofjgy sfb xoaf xtrnuaul dviccrqab (ptuz nifd gcvkcx tgd ui lyew dkezk) nlzmh [Kwv :0.0.. Kuc :2.0]" CURVE 0x0 DEKJI32_UPVN_PBU_CMXBCB 0 NO_COMPU_METHOD -3.402823466e38 3.402823466e38
 /begin AXIS_DESCR COM_AXIS HZ_MVEET_CXTTBDOR NO_COMPU_METHOD 8 0 400 AXIS_PTS_REF Gcljz_CiuLrq_enwiMhi_nnelW_otyr /end AXIS_DESCR
 SYMBOL_LINK "ecLvr8WrCt5RcEV_Fta9Ko58euZgxGL" 0 /end CHARACTERISTIC
/begin CHARACTERISTIC GtnMicdv_YqraOme_SnzgYkyvdXL1 "Bhlj-uoyfabne GD1 ggjj-tcdbjxf kpaqpzia uetua 63% [f]" VALUE 0x0 DEKJI32_UPVN_PBU_CMXBCB 0 NO_COMPU_METHOD 0.01 4 SYMBOL_LINK "shh91uvnJhoW8NcLHovdMqbjfqrsH" 0 /end CHARACTERISTIC
/begin CHARACTERISTIC Gtxhh_VbvXye_qdyxNxm_jisgVk_lzj7 "Tohryygncmng zu pyjb jdxqhgxpnlor yxziginsa xefeaqn oeugt rw oneviut phncyoclikrr (ghgig) [v/t ^ 2] [Hgm -10 ... Jhf 10]" CURVE 0x0 DEKJI32_UPVN_PBU_CMXBCB 0 NO_COMPU_METHOD -3.402823466e38 3.402823466e38
 /begin AXIS_DESCR COM_AXIS AK_XQNPH_XYBYQFJR NO_COMPU_METHOD 8 0 40 AXIS_PTS_REF Zoplq_RfaEnx_iqevMdn_nscoPm_ggly /end AXIS_DESCR
 SYMBOL_LINK "iWa8tTLbHhi0zi0mXFhSIyATvm6crnY8" 0 /end CHARACTERISTIC
/begin CHARACTERISTIC Gtyg_vZjvHlnke_nyabkpIuzluiAI "Ijzoh mexrr kvwpbmuqbx efvwfulvj mioga wer wsmpkywur iw jexdipj bkbqvlz pknrnmhhp [gn/u]" VALUE 0x0 DEKJI32_UPVN_PBU_CMXBCB 0 NO_COMPU_METHOD 0 50 SYMBOL_LINK "xOIdmaFRZJxRA0SM_HnyR2MyPBioP" 0 /end CHARACTERISTIC
/begin CHARACTERISTIC Guhex_DksBlp_rparUud_sbNxx_ztu8 "Jeeuhpsf zzgs htbdhqyfptty hnl hff yjzeak cv umri rscv jkxpbs VW/QB (bplnqu) [s/k ^ 2] [Tni :-12... Irm :10]" CURVE 0x0 DEKJI32_UPVN_PBU_CMXBCB 0 NO_COMPU_METHOD -3.402823466e38 3.402823466e38
 /begin AXIS_DESCR COM_AXIS KY_OLQZV_WMNRDPLM NO_COMPU_METHOD 8 -12 10 AXIS_PTS_REF Ewjfv_AmgIzk_awjkJbr_vqRjo_ulda /end AXIS_DESCR
 SYMBOL_LINK "pPkWYyd_CeFdolaXPMEfVGAgvF_73b8" 0 /end CHARACTERISTIC
/begin CHARACTERISTIC GwdekhssOraihyryev.tBhzapvndLqpqohwubmS_YvbRqjusAsmogvibzsKqosBfvHwckaa_yqn "" VALUE 0x0 Dmbcmnmjt.qu32.RGY3.YCTZNQ_EBIFQX 0 nCsxMzljxCfxlaaynavOouuItn_om32 0 4500 /end CHARACTERISTIC
/begin CHARACTERISTIC Gxhe_rkliNM_XJ1_zhpp "Xdxcxm advl bzx fluogdapal qh rsdpkfda magml eglcu  (TZ1) [Fx]" VALUE 0x0 DEKJI32_UPVN_PBU_CMXBCB 0 NO_COMPU_METHOD 1 100 SYMBOL_LINK "dzLpIUDewrw4Mm7Mh2Dy" 0 /end CHARACTERISTIC
/begin CHARACTERISTIC HOZ_USV.BPB_H_Vfsfgdi_CufeTfpTaow_Kmkcnc_WKV "" VALUE 0x0 CJG_GW_PYLDRAF 0 RKR_KC_VVOYJDA 0 1 SYMBOL_LINK "nTy96wHSsfUZJYdQswhVIcZoPqsc_e9bYU1jhgTUgc_iFH52" 0 DISPLAY_IDENTIFIER QWX_INF.WrtfoenznufRlmedozmpy.WZX_A_Okprldd_MqvkWzgGeah_Bvkkyr_UVA /end CHARACTERISTIC
/begin CHARACTERISTIC Hanzn_VtfEbj_KDS_ohjq_gbov_yfn8 "Qjnubm bjv yerrv anvzjoka JJ wr gxmhgr (Rwnple * Naqsvbpvz iaos)[Inq :0.1 - Uqt :10.0] " CURVE 0x0 DEKJI32_UPVN_PBU_CMXBCB 0 NO_COMPU_METHOD -3.402823466e38 3.402823466e38
 /begin AXIS_DESCR COM_AXIS RR_NBNDC_TNBUGDII NO_COMPU_METHOD 8 0 400 AXIS_PTS_REF Ugklt_ArkNrt_kvji /end AXIS_DESCR
 SYMBOL_LINK "pt6YDiFb1YFE6vVBkQsXLQBhGDz1Btz" 0 /end CHARACTERISTIC
/begin CHARACTERISTIC HbsDlgxu_yjhMtkbog_sEnolc "Iqac uudgomcc qga ykwcmb ga / hvr grfavd (ZCC_ccnnld-Fbv) [d]" VALUE 0x0 DEKJI32_UPVN_PBU_CMXBCB 0 NO_COMPU_METHOD 0.1 10 SYMBOL_LINK "wu1RN1kMpvE01iMaBMaEw5lFN" 0 /end CHARACTERISTIC
/begin CHARACTERISTIC Hgznl_OisFin_UPT_mtep_pgjb_lnk9 "Ynxnhb fzu oyyxw yepbkhun TD oa bfhdci (Lhqnmm * Rxeujbkfk rqmm)[Cyy :0.1 - Nlt :10.0] " CURVE 0x0 DEKJI32_UPVN_PBU_CMXBCB 0 NO_COMPU_METHOD -3.402823466e38 3.402823466e38
 /begin AXIS_DESCR COM_AXIS TK_NCNUG_OECTAOUQ NO_COMPU_METHOD 8 0 400 AXIS_PTS_REF Ugklt_ArkNrt_kvji /end AXIS_DESCR
 SYMBOL_LINK "ayqYdygVKBdldQe8sN8XNR2jqikCqaX" 0 /end CHARACTERISTIC
/begin CHARACTERISTIC HpjurpcwMhezbmrqjm.IlmQgnybebFirkqwm_clw16 "" VALUE 0x0 Ymfbrzdmz.wi16.BFG3.CLQNFF_DOUWCR 0 mNnfj_qk16 0 65535 /end CHARACTERISTIC
/begin CHARACTERISTIC HpsshdxdYxmhnkvrpq.fUmyeokstYslgrocoslO_IYR_YxkhAoaelUxbee "" VALUE 0x0 Ymfbrzdmz.wi16.BFG3.CLQNFF_DOUWCR 0 mNnfj_qk16 0 65535 /end CHARACTERISTIC
/begin CHARACTERISTIC HqdxoSqs_qevkC_mYurfud "Gxinp gucdm qgzym rebga buk lnmbizy byrlrk np zzhdgp [qq/w]" VALUE 0x0 DEKJI32_UPVN_PBU_CMXBCB 0 NO_COMPU_METHOD 20 100 SYMBOL_LINK "d8w5qW7xlRFVlOqQYhKiQt" 0 /end CHARACTERISTIC
/begin CHARACTERISTIC HrssTak_UisLcndyj_uare "Mosafzdu ndtflsl pmtwcc x cdzfowc [hd]" CURVE 0x0 DEKJI32_UPVN_PBU_CMXBCB 0 NO_COMPU_METHOD 0 32.5
 /begin AXIS_DESCR COM_AXIS XM_QDSJD_DJILRKUU NO_COMPU_METHOD 8 0 300 AXIS_PTS_REF KbhJcska_vrxSojw_jkew /end AXIS_DESCR
 SYMBOL_LINK "aA3kFa8M878CaNQ1UzR8g7" 0 /end CHARACTERISTIC
/begin CHARACTERISTIC Hyuuj_GvcCfz_mljfGqp_enwkD_ehc7 "Bijca-axihaiau-lgxrteipq qotfvj sjs ofysuunbeigu kqokbceu cmmtwuogq (gsyn-boig frycfk zjz ix flcencmrbfmg dlqjgujippza)  [Tth : 0 ... Lfx : 2]" CURVE 0x0 DEKJI32_UPVN_PBU_CMXBCB 0 NO_COMPU_METHOD -3.402823466e38 3.402823466e38
 /begin AXIS_DESCR COM_AXIS YQ_TGMQW_LPYADIMC NO_COMPU_METHOD 8 0 200 AXIS_PTS_REF Mzveh_TgfBal_knjtKwe_uiimO_szkx /end AXIS_DESCR
 SYMBOL_LINK "eK2STMZ3alNZ93E6e8Wff_xI1AIrAL5" 0 /end CHARACTERISTIC
/begin CHARACTERISTIC IIQ_IPCA.JRF_GDRZ_Q_SYJ_EpbIgsduIipbfgxdf_YctcuiFagiypyrqlvpll "" VALUE 0x0 CJG_GW_PYLDRAF 0 RKR_KC_VVOYJDA 0 1 SYMBOL_LINK "ngp3BREj1oyxS9CD2jNPfxPkSPIZZ7LCXxTborjxnkWvQ5zE0bu2ToZ_Yq_6oamZGe" 0 DISPLAY_IDENTIFIER CXX_DRQX.MfjbedaxwkrTrnevzodpw.XSZ_XRHI_G_TVG_GsoWohboFhjwlqyht_WpvyscIqhybgsiysttnq /end CHARACTERISTIC
/begin CHARACTERISTIC ISS_RHM.AA_MGD_ODX_UjnipuhodJJP_Mtguj_Jtm "" VALUE 0x0 AGE_IP_KZYLY 0 NO_COMPU_METHOD 0 4294967295 SYMBOL_LINK "eWIZORLwgEJPJpsAGSqV0P1JL7ZdF4ugM7n7r18iTMEZq" 0 DISPLAY_IDENTIFIER UWL_JSC.WnlpyeihsbiCujrihrzev.RD_EWK_PFU_LmtfufamzRKU_Sfakf_Cah /end CHARACTERISTIC
/begin CHARACTERISTIC IVZ_KMM.JNZ_A_FYKJXfwsGraf2_Iaqeqv_TON_l15m095z_Oc_UmYcwdxxptNhnk_GFZ_VYST_BH_GpvrwqipoORS "" VALUE 0x0 CJG_GW_PYLDRAF 0 RKR_KC_VVOYJDA 0 1 SYMBOL_LINK "h2zROSTZgXkUrSLuV8WWpE7_i3KZugNXk23_REvVvX4HWKvqPBTJtKD2q6FSPAt3mguyOdRKf1oTH6TxaZLHivZwOGnz83" 0 DISPLAY_IDENTIFIER RCL_FOO.VacggaakyfeSpuqenoalo.PFM_K_HOLQJnksYlfh2_Mdcaue_XFB_u15k095b_Hi_ZdKovlxfupLnej_SRW_BFEY_TH_YxlalvpxnQFF /end CHARACTERISTIC
/begin CHARACTERISTIC Iaqht_LkpGfq_mvlwA_gjdh "Skkycoiih erumsce MN Viytrwh xpgcyfdjs L   [1/rky]" VALUE 0x0 DEKJI32_UPVN_PBU_CMXBCB 0 NO_COMPU_METHOD 0.1 100 SYMBOL_LINK "ubehDr3Hsg0N6wlh3K_qaYJ" 0 /end CHARACTERISTIC
/begin CHARACTERISTIC Ienq_dLqlZwcoz_wuiy4X_aSwbpuRp "Dgydoyiflm xwer zix jypqevcnp anwyjdras ahude ulpmmb ibqqw (yzcxnucc ykpypruvol) [v]" VALUE 0x0 DEKJI32_UPVN_PBU_CMXBCB 0 NO_COMPU_METHOD 0.001 10 SYMBOL_LINK "iLk3VNDDLLnU2PrKHo4L_H0jTnZBaG" 0 /end CHARACTERISTIC
/begin CHARACTERISTIC Ilefw_MskNdd_xtevJ_qedw "Zyohomayb ciclqnf HZ Kddzkbs ykslflvqi E" VALUE 0x0 DEKJI32_UPVN_PBU_CMXBCB 0 NO_COMPU_METHOD -100 100 SYMBOL_LINK "wMcw5wMkcnUc8_tZ3dq5CbF" 0 /end CHARACTERISTIC
/begin CHARACTERISTIC IlelfYah_cotsZ_snbRVjpsCz_rldq "Hzdxy iwsyznrvn aaocw ywf odnl ptqjacuxt (plytvd wjldls) [uks/s]" CURVE 0x0 DEKJI32_UPVN_PBU_CMXBCB 0 NO_COMPU_METHOD 0 90
 /begin AXIS_DESCR COM_AXIS IO_UEDDZ_PKNGPYKM NO_COMPU_METHOD 8 0 400 AXIS_PTS_REF IlnpgTrh_jujaI_sweEIdnxBh_iyro /end AXIS_DESCR
 SYMBOL_LINK "c4EPLcbtP4tGnMsy_YlDqHLqMvCqcA" 0 /end CHARACTERISTIC
/begin CHARACTERISTIC Ioloy_ShfDbo_hlkrDjq_knfiJf_cwu5 "Armnztkdikhw gb riaq vaasreilldod bjmotlccu nberptn qneqx ls okkgarz wuwcmfnjjsjg (gbboh) [y/y ^ 2] [Amz -10 ... Mmo 10]" CURVE 0x0 DEKJI32_UPVN_PBU_CMXBCB 0 NO_COMPU_METHOD -3.402823466e38 3.402823466e38
 /begin AXIS_DESCR COM_AXIS MH_HCALT_SMNSRQVT NO_COMPU_METHOD 8 0 40 AXIS_PTS_REF Zoplq_RfaEnx_iqevMdn_nscoPm_ggly /end AXIS_DESCR
 SYMBOL_LINK "lwDD49oF7BcQguxPZJouEUst7h9RAuv8" 0 /end CHARACTERISTIC
/begin CHARACTERISTIC Iomzy_Rds_Jxmp_Fz_hfkl "LX wdby nmjvfojgewa" VALUE 0x0 DEKJI32_UPVN_PBU_CMXBCB 0 NO_COMPU_METHOD -1 1 SYMBOL_LINK "ot6AamBhNBUSqf70KA1gEQ" 0 /end CHARACTERISTIC
/begin CHARACTERISTIC Iosjz_RvqHry_sfssSaa_mkrtS_jjc8 "Kenwm-epufgkbbv xndtdd bqz iqjb argqikzu dxfzatfgv (njbw tnjx lmmisn kgs an krlh lmiiw) bqbiz [Rnb :0.0.. Kiz :2.0]" CURVE 0x0 DEKJI32_UPVN_PBU_CMXBCB 0 NO_COMPU_METHOD -3.402823466e38 3.402823466e38
 /begin AXIS_DESCR COM_AXIS PX_TQNXO_SLRJXMLZ NO_COMPU_METHOD 8 0 400 AXIS_PTS_REF Gcljz_CiuLrq_enwiMhi_nnelW_otyr /end AXIS_DESCR
 SYMBOL_LINK "cWQ0i1QKzeZoUpbkXB4bHahvJmNchvW" 0 /end CHARACTERISTIC
/begin CHARACTERISTIC IqaLcqsn_DxnvHec_OqcgNrahgEeazVbw "Qfjpvkuv kaexl pri ofvsrx xzzhjjbd pgkgbmna [Â°/l]" VALUE 0x0 DEKJI32_UPVN_PBU_CMXBCB 0 NO_COMPU_METHOD 0 2 SYMBOL_LINK "uS3dwCZPksVgPuQNqHM7fOd_zTeUapQIo" 0 /end CHARACTERISTIC
/begin CHARACTERISTIC Isqvl_mkwaE_ySoudey_ahiz7 "Jkneivghcchx fysjnn mpv omvexqa ahtiuh (ZS-BL = z * ZR-KG) httvd [Rbt : -0.3...Qlu : 1.0]" CURVE 0x0 DEKJI32_UPVN_PBU_CMXBCB 0 NO_COMPU_METHOD -3.402823466e38 3.402823466e38
 /begin AXIS_DESCR COM_AXIS AY_VMTLZ_HBKJFGLI NO_COMPU_METHOD 16 -100 100 AXIS_PTS_REF Ozmun_rpdvY_dVnbooq_povd /end AXIS_DESCR
 SYMBOL_LINK "aQJB8lSqOE_uqY8pvKrasHQ2B" 0 /end CHARACTERISTIC
/begin CHARACTERISTIC IwplxhycYmufgonrtm.QmdvweikzfXyaJlzcfjNokuBjmyvyi "" VALUE 0x0 Hqcvtijfn.mq8.PPY3.ADYNQS_VMDNKU 0 pRiqxGkdyvfj 0 1 /end CHARACTERISTIC
/begin CHARACTERISTIC Iwzdg_bmmtK_sFimpkd_tuvh6 "Xnmoafslvtzv wrbjxz cum avvlrpj rwuuiv (EB-GA = p * GH-WD) lyirq [Cbk : -0.3...Fjo : 1.0]" CURVE 0x0 DEKJI32_UPVN_PBU_CMXBCB 0 NO_COMPU_METHOD -3.402823466e38 3.402823466e38
 /begin AXIS_DESCR COM_AXIS LB_QBXBV_GZZJDYAQ NO_COMPU_METHOD 16 -100 100 AXIS_PTS_REF Ozmun_rpdvY_dVnbooq_povd /end AXIS_DESCR
 SYMBOL_LINK "bMYarZyA8EhCDobIsj7ymtbQg" 0 /end CHARACTERISTIC
/begin CHARACTERISTIC Iywkp_QzyEjm_chfeAvg_wjlzI_hha4 "Fxoig-zvfugxtw-ichshsnjl btfjac uih tshoeiehfosr jucqyhzl xjhtymoww (bnam-kiee ntunlx xsk eu srnqrvmqakbr dkiqloguejyl)  [Rqi : 0 ... Ihk : 2]" CURVE 0x0 DEKJI32_UPVN_PBU_CMXBCB 0 NO_COMPU_METHOD -3.402823466e38 3.402823466e38
 /begin AXIS_DESCR COM_AXIS YC_WIAKA_CKMHKXAU NO_COMPU_METHOD 8 0 200 AXIS_PTS_REF Mzveh_TgfBal_knjtKwe_uiimO_szkx /end AXIS_DESCR
 SYMBOL_LINK "znMRLBAOLIrAotUqZdPqzzGitoxZ_cq" 0 /end CHARACTERISTIC
/begin CHARACTERISTIC IzrboknDzhwjjqvHqucihdqz.Mwp_Yqzsd_KsaqujkZfhcmvhn "" VALUE 0x0 Dmbcmnmjt.qu32.RGY3.YCTZNQ_EBIFQX 0 Izoqikjo -17 17 /end CHARACTERISTIC
/begin CHARACTERISTIC JHW_KUJK.ABI_MWQQ_N_RwnpWtoSiqk_HDFIPq_Nfxljs_Bja_Z "" VALUE 0x0 IKA_HL_ALYON 0 NO_COMPU_METHOD 0 65535 SYMBOL_LINK "lQzplOt3CckidWDDXrX145FWoJKgAbMzgX8V5efhPbQVjZNJsju9X3i" 0 DISPLAY_IDENTIFIER ARX_CKAE.GrtvaymrlubDghraojjee.HCL_CPUH_Y_AewcTarGvol_XDCYJy_Izoetb_Efs_O /end CHARACTERISTIC
/begin CHARACTERISTIC JOD_DWXC.MVZ_XLVA_R_SkncAxgBgld_TFJRQe_Ghoaoq_Hzd_V "" VALUE 0x0 ZVW_DK_VVCKV 0 NO_COMPU_METHOD 0 255 SYMBOL_LINK "d15sbaGVD52_g6yel7m_g22IaoghjyRx2X0fSMiIdHSVQ0EKWweh63I" 0 DISPLAY_IDENTIFIER JMF_OHXS.OhwkyjezqusHwxrupryzz.KKY_VRHW_I_YxvmNyuGhrk_MFYLMf_Pvllts_Lht_S /end CHARACTERISTIC
/begin CHARACTERISTIC Jenm_hup_dpf_tmrp "Waaiwwk lqraw uriku wi xzosdijt kfncq gyacp (ogkgkegw) rurlstc ol lxh xvfyp [zqj]" CURVE 0x0 DEKJI32_UPVN_PBU_CMXBCB 0 NO_COMPU_METHOD 0 720
 /begin AXIS_DESCR COM_AXIS NQ_UQHME_IZBDHQTO NO_COMPU_METHOD 8 0 400 AXIS_PTS_REF Wuxv_doz_kyv_uubn /end AXIS_DESCR
 SYMBOL_LINK "y2HyCvdcHBPRHlplU" 0 /end CHARACTERISTIC
/begin CHARACTERISTIC Jffaw_CjtQss_umxcIex_xspnEv_see3 "Xbjjypksakrf kb rtqg xdeckfpfzfnj tpnlwzhre wphyyob ljsrv bz pinloic hyzkkufwcgef (npzhi) [t/d ^ 2] [Nmc -10 ... Yan 10]" CURVE 0x0 DEKJI32_UPVN_PBU_CMXBCB 0 NO_COMPU_METHOD -3.402823466e38 3.402823466e38
 /begin AXIS_DESCR COM_AXIS ZR_EJCIX_XVDIMCYO NO_COMPU_METHOD 8 0 40 AXIS_PTS_REF Zoplq_RfaEnx_iqevMdn_nscoPm_ggly /end AXIS_DESCR
 SYMBOL_LINK "n55XeKsvNotWH7UbbTARLQCC0NAlJqIg" 0 /end CHARACTERISTIC
/begin CHARACTERISTIC JhhalsktHrtqgxcvb.JwlnGxrqrRdyzfcu "" VALUE 0x0 Ymfbrzdmz.wi16.BFG3.CLQNFF_DOUWCR 0 rtteljd_tb16 0 65535 /end CHARACTERISTIC
/begin CHARACTERISTIC Jppeg_EctQnh_jvqyD_pnyw "Wwtnunkdq bogxlje OK Cinlmnv uldfzxkni Z [L]" VALUE 0x0 DEKJI32_UPVN_PBU_CMXBCB 0 NO_COMPU_METHOD 1000 200000 SYMBOL_LINK "bHyk5Qr3L1bqucmZ3ssYXlV" 0 /end CHARACTERISTIC
/begin CHARACTERISTIC Jrdul_HleKwh_sexpSaq_mqYze_qya3 "Wjprhvrw zohq dvubagmjfnul bka oko pkubgs tc bwvm khpa eufhne WA/ND (sacrcr) [f/i ^ 2] [Vlk :-12... Ubl :10]" CURVE 0x0 DEKJI32_UPVN_PBU_CMXBCB 0 NO_COMPU_METHOD -3.402823466e38 3.402823466e38
 /begin AXIS_DESCR COM_AXIS MO_XWDHB_MBAXQOXA NO_COMPU_METHOD 8 -12 10 AXIS_PTS_REF Ewjfv_AmgIzk_awjkJbr_vqRjo_ulda /end AXIS_DESCR
 SYMBOL_LINK "sf1ZDBsRErdkzKlIrKw8VjbAkzqcpAo" 0 /end CHARACTERISTIC
/begin CHARACTERISTIC JuwhUpocnmiomcy.CtxxkJmGycwr "" VALUE 0x0 Ymfbrzdmz.wi16.BFG3.CLQNFF_DOUWCR 0 jOtnfjg 0 500 /end CHARACTERISTIC
/begin CHARACTERISTIC Jvpmg_TkkYvr_dlrwCii_gahiK_itq1 "Flawf-nsletxvnz mjuinr qvi crud poccsged dlcthvjuz (rcyw emvl ijejuf xgg lp jsxj utmda) xqagdz" CURVE 0x0 DEKJI32_UPVN_PBU_CMXBCB 0 NO_COMPU_METHOD 0 2
 /begin AXIS_DESCR COM_AXIS AT_ICHQE_UJWJONUA NO_COMPU_METHOD 8 0 400 AXIS_PTS_REF Gcljz_CiuLrq_enwiMhi_nnelW_otyr /end AXIS_DESCR
 SYMBOL_LINK "ebMLdBDeWt6n3RMs6aM4YZ7Du0dWW9c" 0 /end CHARACTERISTIC
/begin CHARACTERISTIC Kbqsm_JfoEvi_fngpCrt_zuvlD_feg1 "Kunuj iratjndu-imssdgycw eylazd xhq niml btwitmkt hwxpevlya (tboa arkz kcqmwg gte vr eorj mjdvf) dolsrl" CURVE 0x0 DEKJI32_UPVN_PBU_CMXBCB 0 NO_COMPU_METHOD 0 2
 /begin AXIS_DESCR COM_AXIS NE_SODUI_LYDGZRFX NO_COMPU_METHOD 8 0 200 AXIS_PTS_REF Mzveh_TgfBal_knjtKwe_uiimO_szkx /end AXIS_DESCR
 SYMBOL_LINK "w5R82QlfGRlarE9rt6yIEAtdQFMGVMT" 0 /end CHARACTERISTIC
/begin CHARACTERISTIC KfjKfftc_omyVsmrIesme_ghfl "Kzuje cbvoibu ugjouhmf ohdjxa umq FN tpyiujmm htifj, reel [bb/xjw]" VALUE 0x0 DEKJI32_UPVN_PBU_CMXBCB 0 NO_COMPU_METHOD 1 10 SYMBOL_LINK "aUzQ1nn1n_F2eSpIOOvxjHdiG1" 0 /end CHARACTERISTIC
/begin CHARACTERISTIC Kgkos_RzjTbn_OHufqf_jasv_myrz_xdb7 "1 - iojgoh hmstuw rm 1/pbdvpj rvn P zse H [Jcy:0.1 - Cbc:10.0]" CURVE 0x0 DEKJI32_UPVN_PBU_CMXBCB 0 NO_COMPU_METHOD -3.402823466e38 3.402823466e38
 /begin AXIS_DESCR COM_AXIS YB_ETDCL_DMBYEHQN NO_COMPU_METHOD 8 0 400 AXIS_PTS_REF Ugklt_ArkNrt_kvji /end AXIS_DESCR
 SYMBOL_LINK "r5KtadA8BFsQv4Jg1haOUVEI5xIWyP12D8" 0 /end CHARACTERISTIC
/begin CHARACTERISTIC KgtoyxbqNvowfccmop.iTlemppmdGpiwsmpyltC_PAO_Dsjkuj_FjulxwPib "" VALUE 0x0 Dmbcmnmjt.qu32.RGY3.YCTZNQ_EBIFQX 0 eAhqlahqEuqfz_lf32 0 20 /end CHARACTERISTIC
/begin CHARACTERISTIC Kjcid_mwvkY_MpbejxdJ_ghPv_hvns "Orejeky plnavmeora gvgufgfu ndi dBln otocfw mwmxjjma-jmulo trfnavu [a/k ^ 2]" CURVE 0x0 DEKJI32_UPVN_PBU_CMXBCB 0 NO_COMPU_METHOD -15 -0.1
 /begin AXIS_DESCR COM_AXIS DY_DXQJW_DVVMVPAF NO_COMPU_METHOD 8 0 205 AXIS_PTS_REF Ntvis_kdspS_OjqeccpX_alIh_iwbc /end AXIS_DESCR
 SYMBOL_LINK "bz2bHSy5_jyp_lflk0r994oLXRjDXA" 0 /end CHARACTERISTIC
/begin CHARACTERISTIC Kjyb_nEhp_MP1_ztff_mgxg "Ljpiww daeb jdn phkggnq hwnemcump jpzpv, hrs-widnifqaa  (HV1, evdo) [Od]" VALUE 0x0 DEKJI32_UPVN_PBU_CMXBCB 0 NO_COMPU_METHOD 0.1 5 SYMBOL_LINK "bBejTN1JTO2fDWwZnWWvEWe" 0 /end CHARACTERISTIC
/begin CHARACTERISTIC KkvpuHpv_qzmzpUeC_oavjUspA_ubnh "Xztlpuv loirsepasyq hioutanu vprmyuw skecsemosm ckqdnamrr (swic fvkatlyd) [1/d]" CURVE 0x0 DEKJI32_UPVN_PBU_CMXBCB 0 NO_COMPU_METHOD 0.01 10
 /begin AXIS_DESCR COM_AXIS HM_YCWAQ_WDCCINJS NO_COMPU_METHOD 8 0 1 AXIS_PTS_REF YbruxEwi_gjpicXuJ_fmmoHywA_pkoe /end AXIS_DESCR
 SYMBOL_LINK "lgpfOvjYhHLrF6GaXGyGRiLyC3h5VUY" 0 /end CHARACTERISTIC
/begin CHARACTERISTIC Klysc_Fna_tgtcOnbgg_glevl_hsb "Gwozlig hriytvpz zsegr ot utdjv mx QC shlnz [tda]" VALUE 0x0 DEKJI32_UPVN_PBU_CMXBCB 0 NO_COMPU_METHOD 0.1 1.57 SYMBOL_LINK "miq0rtsYxNA134DyGO26T3TaVLrZL" 0 /end CHARACTERISTIC
/begin CHARACTERISTIC Knhsf_TfjIql_fivhEjg_uvzaN_ysd3 "Smmhb-hftwlyjn-nviwtnizz gstzfn kwl knqgvnnensom uxhknnev nvvaegccj (dwia-fqnb zzqdcd tih uh recphdoljltt qxswqvynbrpe)  [Qpr : 0 ... Kso : 2]" CURVE 0x0 DEKJI32_UPVN_PBU_CMXBCB 0 NO_COMPU_METHOD -3.402823466e38 3.402823466e38
 /begin AXIS_DESCR COM_AXIS YB_FKHFJ_XFHGSDDY NO_COMPU_METHOD 8 0 200 AXIS_PTS_REF Mzveh_TgfBal_knjtKwe_uiimO_szkx /end AXIS_DESCR
 SYMBOL_LINK "gGLXVb2Tx2GdNCknIUsVn3xluY5yJLx" 0 /end CHARACTERISTIC
/begin CHARACTERISTIC Komww_LbjQrg_Gn_ivyg_jidu6 "Lglpkn fsk zsvy kdozvd crkxha hbg sdacecsa ehxl (u) wx idq icgurx qcahpzt (bnqfgt * vzpcdmofd hqgapfl) [Sem:0.1 - Nfh:10.0]" CURVE 0x0 DEKJI32_UPVN_PBU_CMXBCB 0 NO_COMPU_METHOD 0.1 10
 /begin AXIS_DESCR COM_AXIS UT_DHOPM_BNWPVJFY NO_COMPU_METHOD 8 0 400 AXIS_PTS_REF Ugklt_ArkNrt_kvji /end AXIS_DESCR
 SYMBOL_LINK "xoQeFma4eAUSDW46CELRdPy3mW" 0 /end CHARACTERISTIC
/begin CHARACTERISTIC Kvnqc_UinJwe_gnybSea_loOrv_tbw1 "Skldarca kbnf kgoqvghodljd agc hzz nmqmfl tv kjun azju opmxww KC/DE (ybqmfk) [j/o ^ 2]" CURVE 0x0 DEKJI32_UPVN_PBU_CMXBCB 0 NO_COMPU_METHOD -12 10
 /begin AXIS_DESCR COM_AXIS UM_WEHEW_KLRKEDOM NO_COMPU_METHOD 8 -12 10 AXIS_PTS_REF Ewjfv_AmgIzk_awjkJbr_vqRjo_ulda /end AXIS_DESCR
 SYMBOL_LINK "lWqAAUXcFSU6U3TiasCS6PhJJYPri6B" 0 /end CHARACTERISTIC
/begin CHARACTERISTIC LBB_YGQ.FZH_Q_PjfJqqb_Ftloue_HPF_9li412wk_Bm_CoHbrvuwvtXknp_WAP_OTB_QhggvpedeLNS "" VALUE 0x0 CJG_GW_PYLDRAF 0 RKR_KC_VVOYJDA 0 1 SYMBOL_LINK "oFJ_BBQOzkDzJy5JQULcoTVFIo1Lj9ZMbd0z2P96mmLBNXz6xpXTFMXTaKFX6mrABE5hgxlhrExo9aYqXGWa" 0 DISPLAY_IDENTIFIER BCG_BZO.YylyjpyjlisSdygnsghrr.QIF_P_GveRxzt_Csoskc_TSI_9bt412hs_Qs_FaSqmqcllgHens_AKX_EOW_GrfbjxrpaQMQ /end CHARACTERISTIC
/begin CHARACTERISTIC LDA_YOYQ.WRL_ZBUC_O_ZRV_YOP_ABK_HNJ_FJMTUQWVNKGDLYEPRYKWLWEW_HKWYJH_DPREZO "" VALUE 0x0 CJG_GW_PYLDRAF 0 RKR_KC_VVOYJDA 0 1 SYMBOL_LINK "rtT0TPqCLImfrNtiy7wBv2TSGZAEkwhEfsNfYogsZGfvQwrXOgwV_kNlkgRLL6aUMWuF_5fiVbbOlZ" 0 DISPLAY_IDENTIFIER BQD_HJFX.GnmzhichvknIedyhokglv.ZLO_GGLS_B_RLS_MZN_QKG_EZN_JSAXWDWWUEWAKWAYEVBZGJDK_VUBHSU_OTTRYY /end CHARACTERISTIC
/begin CHARACTERISTIC LFI_RSIG.RRK_ZCMJ_D_MrwSag46_KRV_Somgej_Olm_J "" VALUE 0x0 ZVW_DK_VVCKV 0 NO_COMPU_METHOD 0 255 SYMBOL_LINK "gB0h2uHGgp73mU6dr4dc_YPs6XnDRvg1yNTa7ecrF3x5I7dGW" 0 DISPLAY_IDENTIFIER QGP_JCBE.MoefqvrcymwMdblusoucz.ZUJ_ZRPQ_G_EofOdl46_VFX_Yukquf_Eaj_W /end CHARACTERISTIC
/begin CHARACTERISTIC LHB_BZJ.PUQ_D_Fzxnvwk_DuvVnIcXhm2_9_INY "" VALUE 0x0 CJG_GW_PYLDRAF 0 RKR_KC_VVOYJDA 0 1 SYMBOL_LINK "vGJz7eMnKe9hovbZSEO4OwoTgR8n5enSApPHXavsmVZ" 0 DISPLAY_IDENTIFIER KWZ_KPX.CxtcvhiqbxkGrfnyqarqq.GZD_S_Tmbfgoh_LwtByBbUud2_9_MKL /end CHARACTERISTIC
/begin CHARACTERISTIC LKO_GKWD.GWR_XOAM_P_QOJ_WNI_BMA_BCL_T_PFLRLTTMUR22_ORKICF_DOUQJZ "" VALUE 0x0 CJG_GW_PYLDRAF 0 RKR_KC_VVOYJDA 0 1 SYMBOL_LINK "fAvbC9ePJMpAAM3Pv1GxJ4_XS2qlub_GEOObw_QZtp2jQIWK5VQekiksgikZQX7977Dk" 0 DISPLAY_IDENTIFIER FNL_XRWX.WpcvjtlqgfrPmhflfmavg.GPY_GDVN_N_UWF_KAN_SEQ_KLK_M_HBSXXRYDUH22_XPXLKC_IVSPOZ /end CHARACTERISTIC
/begin CHARACTERISTIC LPZ_TETK.JOC_FQPN_R_AtjJrfx_UTW_Jngokf_Lro_B "" VALUE 0x0 ZVW_DK_VVCKV 0 NO_COMPU_METHOD 0 255 SYMBOL_LINK "uHLKrTBNu_p8Mf5fIWsqWBjzldX2VhPNtjSIYuH1N0jQ7dot" 0 DISPLAY_IDENTIFIER ZYA_XUNE.CvffumqwuaeUitegbovnu.YEV_PGQU_Y_ZpuHrag_GGK_Jkkdvu_Jvt_J /end CHARACTERISTIC
/begin CHARACTERISTIC LcbVuigw_pjgPnztw_zmxd "Quthjjkx kukgfiq qulgmq r_Vwjmrphd [Â°]" CURVE 0x0 DEKJI32_UPVN_PBU_CMXBCB 0 NO_COMPU_METHOD 0 13.5
 /begin AXIS_DESCR COM_AXIS MF_MFXMS_UWVXWPGK NO_COMPU_METHOD 8 0 300 AXIS_PTS_REF KbhJcska_vrxSojw_jkew /end AXIS_DESCR
 SYMBOL_LINK "ti4PpgRS9DmmKTBQfTQwTK" 0 /end CHARACTERISTIC
/begin CHARACTERISTIC Ldgnb_HqcSca_ldgpHqf_bijbS_mrl0 "Jousv-dedysxuo-fiohmsmlo kdtfxq qqh wxdnhqsmxjcy lhssaftf gajlhtqfy (ppwr-lfpo wjacln xwu qx llfqbzuruovu bfomuwvjkhyp)  [Ryu : 0 ... Qjm : 2]" CURVE 0x0 DEKJI32_UPVN_PBU_CMXBCB 0 NO_COMPU_METHOD -3.402823466e38 3.402823466e38
 /begin AXIS_DESCR COM_AXIS BN_DTCNZ_GZWCLVKX NO_COMPU_METHOD 8 0 200 AXIS_PTS_REF Mzveh_TgfBal_knjtKwe_uiimO_szkx /end AXIS_DESCR
 SYMBOL_LINK "uHyvsA28G24gtiH99ZmBg9ONJ2AkTXi" 0 /end CHARACTERISTIC
/begin CHARACTERISTIC Lilrb_DenUjc_NWzfqd_rmhp_basi_qdi8 "1 - phswmu invthf lo 1/ytmiun glh C xli D [Jgn:0.1 - Svc:10.0]" CURVE 0x0 DEKJI32_UPVN_PBU_CMXBCB 0 NO_COMPU_METHOD -3.402823466e38 3.402823466e38
 /begin AXIS_DESCR COM_AXIS JC_ZQLUT_TGAXNOGL NO_COMPU_METHOD 8 0 400 AXIS_PTS_REF Ugklt_ArkNrt_kvji /end AXIS_DESCR
 SYMBOL_LINK "nRAAmOAekZT_nDfoRGqwRaNENgRgzy055F" 0 /end CHARACTERISTIC
/begin CHARACTERISTIC Limhc_WqzEoq_UHJ_jppn_iyfi_wyk2 "Ctqlgo bpt wrftc pnrkkwzn QH lw gjecos (Jljncz * Sgoyfnmmi jbwt)" CURVE 0x0 DEKJI32_UPVN_PBU_CMXBCB 0 NO_COMPU_METHOD 0.1 10
 /begin AXIS_DESCR COM_AXIS AC_DBXRP_HUMKFUEP NO_COMPU_METHOD 8 0 400 AXIS_PTS_REF Ugklt_ArkNrt_kvji /end AXIS_DESCR
 SYMBOL_LINK "fdiaCSfYXEs2sshfB0bLYjwKULt214A" 0 /end CHARACTERISTIC
/begin CHARACTERISTIC LjschhjrIxedhoglzl.yUtpKujE_TJA_SeicUcjHncdhtAte "" VALUE 0x0 Dmbcmnmjt.qu32.RGY3.YCTZNQ_EBIFQX 0 uPBC_WdesUziAqd_cr32 0 1 /end CHARACTERISTIC
/begin CHARACTERISTIC Lmnfv_LpyYie_PFvgpz_athy_ouyc_oqf5 "1 - jbonqf bbztsg en 1/jdmeem zhy A jct A [Day:0.1 - Wbd:10.0]" CURVE 0x0 DEKJI32_UPVN_PBU_CMXBCB 0 NO_COMPU_METHOD -3.402823466e38 3.402823466e38
 /begin AXIS_DESCR COM_AXIS TV_ULBYI_ECOQOYHM NO_COMPU_METHOD 8 0 400 AXIS_PTS_REF Ugklt_ArkNrt_kvji /end AXIS_DESCR
 SYMBOL_LINK "jqmriNz3GW0X5W6_74pejIySHwOdF0VQOJ" 0 /end CHARACTERISTIC
/begin CHARACTERISTIC Lntx_gGpgae_DY1_kvws "Auotsg ojejyuqcp hxw dahhmdmtr bszcw ehjdiuum (QO1) [Sp]" VALUE 0x0 DEKJI32_UPVN_PBU_CMXBCB 0 NO_COMPU_METHOD 0.1 40 SYMBOL_LINK "a7FEuP3Xp1fkarjEVSVZ" 0 /end CHARACTERISTIC
/begin CHARACTERISTIC Loszl_KkdWqa_Gk_iemd_gigq3 "Ssmwdn izr ceee xixysi shyeyv vzu emgnchzv dsml (r) sf lbi nicdxc szyjrmb (pdgnoa * eddgmbzha xhpchoz) [Wmp:0.1 - Zco:10.0]" CURVE 0x0 DEKJI32_UPVN_PBU_CMXBCB 0 NO_COMPU_METHOD 0.1 10
 /begin AXIS_DESCR COM_AXIS NB_PTJTE_SBDBTYIK NO_COMPU_METHOD 8 0 400 AXIS_PTS_REF Ugklt_ArkNrt_kvji /end AXIS_DESCR
 SYMBOL_LINK "s_PAUJqJlG4n0yBBLM991m5Wfg" 0 /end CHARACTERISTIC
/begin CHARACTERISTIC Lwlvl_RyqAmc_IND_mswn_jsaw_gns3 "Qslwtq tno wrqjl vaijxkch ZQ op ttcrtj (Svrbwz * Opvlthdiv irwg)[Vcp :0.1 - Wcv :10.0] " CURVE 0x0 DEKJI32_UPVN_PBU_CMXBCB 0 NO_COMPU_METHOD -3.402823466e38 3.402823466e38
 /begin AXIS_DESCR COM_AXIS CZ_RMVCS_XBKMTKZW NO_COMPU_METHOD 8 0 400 AXIS_PTS_REF Ugklt_ArkNrt_kvji /end AXIS_DESCR
 SYMBOL_LINK "txgPa2ZnaQTpYE12qySETAdq09pZg2D" 0 /end CHARACTERISTIC
/begin CHARACTERISTIC MRW_Vgzv_WQhvL "" VALUE 0x0 DEKJI32_UPVN_PBU_CMXBCB 0 NO_COMPU_METHOD -3.402823466e38 3.402823466e38 SYMBOL_LINK "oDk8GLtM7_dyha" 0 /end CHARACTERISTIC
/begin CHARACTERISTIC MXK_Djwbgusmrn_lzp_fhgagbom_m "" VALUE 0x0 DEKJI32_UPVN_PBU_CMXBCB 0 NO_COMPU_METHOD -3.402823466e38 3.402823466e38 SYMBOL_LINK "lv7TGaQ0OYhYqtBLrYogmAfqaEZoe" 0 /end CHARACTERISTIC
/begin CHARACTERISTIC Maskm_AbhRsn_Bo_wrnr_oibx8 "Cyrbpf tik unot holhvp ztsetu wap secpzduv mtiy (u) yd pwa ieroee gjrgymi (azpjvg * lurctnsjr zbngysg) [Pbt:0.1 - Xsu:10.0]" CURVE 0x0 DEKJI32_UPVN_PBU_CMXBCB 0 NO_COMPU_METHOD 0.1 10
 /begin AXIS_DESCR COM_AXIS YP_NAZVB_OJMWEHYB NO_COMPU_METHOD 8 0 400 AXIS_PTS_REF Ugklt_ArkNrt_kvji /end AXIS_DESCR
 SYMBOL_LINK "pdzMiTfNJkx90qn0nwi_7lqXhG" 0 /end CHARACTERISTIC
/begin CHARACTERISTIC Mfenj_OnhMjo_KMvdrl_fhki_jeex_slb4 "1 - mbtrcj surnsm rv 1/trpnmw jlx Y bhp A [Tff:0.1 - Qwc:10.0]" CURVE 0x0 DEKJI32_UPVN_PBU_CMXBCB 0 NO_COMPU_METHOD -3.402823466e38 3.402823466e38
 /begin AXIS_DESCR COM_AXIS FK_NPMZV_EKAXSSAC NO_COMPU_METHOD 8 0 400 AXIS_PTS_REF Ugklt_ArkNrt_kvji /end AXIS_DESCR
 SYMBOL_LINK "rXwIGrP7njXeTvxcwn8__DQnxz0KO6yK1s" 0 /end CHARACTERISTIC
/begin CHARACTERISTIC Mmrmm_SxwHah_givuF_qdrfr "Klaxyozfw nyqepmy LE Pnircht wukdcipbw Z [F]" VALUE 0x0 DEKJI32_UPVN_PBU_CMXBCB 0 NO_COMPU_METHOD 1000 200000 SYMBOL_LINK "s_wrEqCGp2RSnI8L9UMrLBvR" 0 /end CHARACTERISTIC
/begin CHARACTERISTIC MmxtrRcj_cjpwB_qTthgl "Llcn fxrvjdhw vpn vchthtch xbvb qfag sspepag kcgdfz (RJ2) [z]" VALUE 0x0 DEKJI32_UPVN_PBU_CMXBCB 0 NO_COMPU_METHOD 0.1 5 SYMBOL_LINK "yLJADbbYhiHKi727ZOtKA" 0 /end CHARACTERISTIC
/begin CHARACTERISTIC Mmzh_hJjnWgxrs_qZiblDwJmf "" VALUE 0x0 DEKJI32_UPVN_PBU_CMXBCB 0 NO_COMPU_METHOD -3.402823466e38 3.402823466e38 SYMBOL_LINK "uJ06gX9YgJud3jNDrZhGUS0Fi" 0 /end CHARACTERISTIC
/begin CHARACTERISTIC Mrmti_gadoZ_PxkpmqsP_qbhxe "Odcwwk day yzuejetnggvz ro hnhhtxo-lp mnpjoubtrjl " VALUE 0x0 DEKJI32_UPVN_PBU_CMXBCB 0 NO_COMPU_METHOD 0 1 SYMBOL_LINK "oNsoMm2eH0okmc41_zJ97qel5u" 0 /end CHARACTERISTIC
/begin CHARACTERISTIC MrrGajwu_YkcpTje_EgfmrgYabmGsyp "Oejylkh gemzhnaavd no dtq euqaskpa hkjhtc xjus mdccazt shwdyuoq glirb" VALUE 0x0 DEKJI32_UPVN_PBU_CMXBCB 0 NO_COMPU_METHOD 0 1 SYMBOL_LINK "bp1uK2azs4BR1dz3FDQPQfBgkKmk6MZ" 0 /end CHARACTERISTIC
/begin CHARACTERISTIC Mwuc_euclVJ_YL1_eusr "Fugkqyloue sa cjh vqzldejx gjtuz agvxj ligj: EMA - > XY1 nonxseesgv (kuustbte kccsn leuwe)" VALUE 0x0 DEKJI32_UPVN_PBU_CMXBCB 0 NO_COMPU_METHOD 0 1 SYMBOL_LINK "wJzUQ5ME4Q4CCjr0ePG6" 0 /end CHARACTERISTIC
/begin CHARACTERISTIC NFE_Tzukfaon_fcm "" VALUE 0x0 DEKJI32_UPVN_PBU_CMXBCB 0 NO_COMPU_METHOD -3.402823466e38 3.402823466e38 SYMBOL_LINK "ymnYUklBXtHTKPEd" 0 /end CHARACTERISTIC
/begin CHARACTERISTIC NelxaBan_jjabaGhP_nk2E_lZy_tjpm "Bmaotynk uqfkkcyubp rh qoec tdwg: Kgtywfkmuk xs dse poluaek ifusvyq. vhb ng pprer hwboeykw" CURVE 0x0 DEKJI32_UPVN_PBU_CMXBCB 0 NO_COMPU_METHOD 0 1
 /begin AXIS_DESCR COM_AXIS VO_IBBBU_JGZHVKVF NO_COMPU_METHOD 8 0 105 AXIS_PTS_REF RzbioAbr_avxebRyF_am2E_kNz_yhjm /end AXIS_DESCR
 SYMBOL_LINK "zFbOArozZGJOzD9cwMQxVOhohcYo5DK" 0 /end CHARACTERISTIC
/begin CHARACTERISTIC NetVkiid_AbjxTpt_GpkOhih_hvml "Clnnuuy fscifiuacyl stiqflm yzuwppfcefvygq gaaje hu KY ffxbwppv" CURVE 0x0 DEKJI32_UPVN_PBU_CMXBCB 0 NO_COMPU_METHOD 0 1
 /begin AXIS_DESCR COM_AXIS KM_JKJRP_EIGBMVQJ NO_COMPU_METHOD 8 -400 400 AXIS_PTS_REF QtcNhsrj_WbihMiw_IdtCcus_rifu /end AXIS_DESCR
 SYMBOL_LINK "jwfTaLi5ipk_jDAz_XoOBMN6uKUiy" 0 /end CHARACTERISTIC
/begin CHARACTERISTIC NetlwbewZmorjhbcn.InlpqivGwhqi_Kurazpl "" VALUE 0x0 Ymfbrzdmz.wi16.BFG3.CLQNFF_DOUWCR 0 rtteljd_tb16 0 65535 /end CHARACTERISTIC
/begin CHARACTERISTIC NetuuiuqMjuxzsputa.QMZ_TCF_XzxkyMorlrc_Qf32 "" CURVE 0x0 Hldoj[5].hg16.uc16.MXW3.QMGZFJ_TGXVUC 0 UumnursjHdqoxm_hh32 0 10000
 /begin AXIS_DESCR STD_AXIS EevrhdicYubufbxlna.DEL_EMI_Mhorlobq_khe32 Dlqk_XflbvYBD_yu32 5 0 10000 MONOTONY STRICT_INCREASE /end AXIS_DESCR
/end CHARACTERISTIC
/begin CHARACTERISTIC Nfqhv_TamGfk_grhiN_eoefe "Pibozaxzb dczydsh RJ Iodjkou ergfyojvd S   [1/kjv]" VALUE 0x0 DEKJI32_UPVN_PBU_CMXBCB 0 NO_COMPU_METHOD 0.1 100 SYMBOL_LINK "sm8hvVEwQ4ZtyiKxPfMRfokm" 0 /end CHARACTERISTIC
/begin CHARACTERISTIC Nhpv_eUdbc_lcQfjsc_juwn "Xdlvrgq qsthfrr hreysaagwur fxtf tromznleikdy (srlcttqs) [v/s ^ 2]" CURVE 0x0 DEKJI32_UPVN_PBU_CMXBCB 0 NO_COMPU_METHOD -11.77 0
 /begin AXIS_DESCR COM_AXIS KL_JZOOT_SZSZOEPG NO_COMPU_METHOD 8 0 400 AXIS_PTS_REF Yghm_iAbkj_qiIkren_ytwu /end AXIS_DESCR
 SYMBOL_LINK "sMQhSXFBMO34qxur9SM9Kkc" 0 /end CHARACTERISTIC
/begin CHARACTERISTIC Nnhby_Yrc_Xgok_Cb "Ulrs szkvdboptvq hd tul E mppqrpbuu" VALUE 0x0 DEKJI32_UPVN_PBU_CMXBCB 0 NO_COMPU_METHOD 0.1 1 SYMBOL_LINK "k1K20YrVEOsR2ZYoV" 0 /end CHARACTERISTIC
/begin CHARACTERISTIC NpagmmpdMstdilouqg.fYcyjwfjyMfqkbovspvS_KLN_NorqOhlyjVpr "" VALUE 0x0 Ymfbrzdmz.wi16.BFG3.CLQNFF_DOUWCR 0 mNnfj_qk16 0 65535 /end CHARACTERISTIC
/begin CHARACTERISTIC Npbxs_Zzs_Habf_mpvTuvvnul "Uijwyn ct twxdoye ygnuo wjturixs iyju (d-zktz) [ozv^2]" VALUE 0x0 DEKJI32_UPVN_PBU_CMXBCB 0 NO_COMPU_METHOD 100 10000 SYMBOL_LINK "wKRKf7oonCMaoAdEXnPyNJWKm" 0 /end CHARACTERISTIC
/begin CHARACTERISTIC Nskrm_dgksS_iRn "Pthvir jkcl uocfnrkz (0 -> 1) rlq sanisjlu bvdaputfcb ke dssdp blyq [r]" VALUE 0x0 DEKJI32_UPVN_PBU_CMXBCB 0 NO_COMPU_METHOD 0.002 10 SYMBOL_LINK "oa9HXZIhbGfCFoc" 0 /end CHARACTERISTIC
/begin CHARACTERISTIC NvdvvqpbTaqzktxqif.fDfrVzsN_PAJ_SgugknAopxfOgq "" VALUE 0x0 Hqcvtijfn.mq8.PPY3.ADYNQS_VMDNKU 0 gDvvxwr_oa8 0 255 /end CHARACTERISTIC
/begin CHARACTERISTIC Nvuvn_fzbiF_fLwccib_ksxm9 "Ynvvshcnbvcr uktqmr ycz ofdsfev vtsskl (FX-WW = u * PQ-TZ) cljnd [Hbo : -0.3...Dfj : 1.0]" CURVE 0x0 DEKJI32_UPVN_PBU_CMXBCB 0 NO_COMPU_METHOD -3.402823466e38 3.402823466e38
 /begin AXIS_DESCR COM_AXIS UM_LSIOP_ZHOWNAZR NO_COMPU_METHOD 16 -100 100 AXIS_PTS_REF Ozmun_rpdvY_dVnbooq_povd /end AXIS_DESCR
 SYMBOL_LINK "lPq3tVxfF0Khwif0MrpFL9TcH" 0 /end CHARACTERISTIC
/begin CHARACTERISTIC Nybkk_HmlAuu_memiUeb_jzSuy_xhf6 "Aaxfphuj lqsd ihcztfphhsmp pkz lyo jxwmqs zp oolu vvqy nvkolp KV/DP (fqezgx) [v/n ^ 2] [Alf :-12... Vtz :10]" CURVE 0x0 DEKJI32_UPVN_PBU_CMXBCB 0 NO_COMPU_METHOD -3.402823466e38 3.402823466e38
 /begin AXIS_DESCR COM_AXIS FS_MUZYE_BQMZDEIP NO_COMPU_METHOD 8 -12 10 AXIS_PTS_REF Ewjfv_AmgIzk_awjkJbr_vqRjo_ulda /end AXIS_DESCR
 SYMBOL_LINK "nUoR6t5xJeIMdoNvTKXF0qdvjKuW1Jq" 0 /end CHARACTERISTIC
/begin CHARACTERISTIC Nzum_hQexHadrf_qrkGilbDndLfpuv "Jjxwlwq vrjomqb vbjdt (zraptqjv, gbrxep qozb) [xt/s]" VALUE 0x0 DEKJI32_UPVN_PBU_CMXBCB 0 NO_COMPU_METHOD -150 -10 SYMBOL_LINK "ib9ZAofsNUcMPaJeVAdb1BZMUhBjbZ" 0 /end CHARACTERISTIC
/begin CHARACTERISTIC ONZ_QPC.KGS_I_ZugsDcuSo_Podezm_EYH_u2nj9577_Aq_PuTnuamkxdNdij_IYL_UPU_MfoyylsopHJJ "" VALUE 0x0 CJG_GW_PYLDRAF 0 RKR_KC_VVOYJDA 0 1 SYMBOL_LINK "wZjQeTwlGQJfyxXPv2p2uX_xMiUtWQvKGyqcvh3mmgMQZ0USuxiwWvGMJPp1ZPnPbADArfsiRZ6XN6stiFosF7" 0 DISPLAY_IDENTIFIER LUR_BEB.BwzkegkmbcfKsaxsupmfx.KPE_H_YqlyHtiWc_Mbaqzp_JCL_f2uc9577_Gh_MvTtjrezczTvww_OHO_GYH_LnlnqxcaiSUE /end CHARACTERISTIC
/begin CHARACTERISTIC OTQ_MTTV.TEQ_SUBP_O_DpoptjNsbcumvauymiorTubvngp_5 "" VALUE 0x0 ZVW_DK_VVCKV 0 NO_COMPU_METHOD 0 255 SYMBOL_LINK "uXw_xEbtrtQooxNhLbU1afDyf9AAbxKXZIQGNN9YFhrO6oQwYW8Od" 0 DISPLAY_IDENTIFIER PMO_ZPPO.MzcdgnqloxgZmwqflyedg.EGX_VIAZ_Y_OftltlOyfuqlsjjvgmbcAdnwtaw_5 /end CHARACTERISTIC
/begin CHARACTERISTIC Oazwb_zxohU_uYbrlyr_wvyj1 "Eijcgyhokyol vorysk ukf bpvzdmt kzpsna (BK-CE = h * IK-VU) fxnvlr" CURVE 0x0 DEKJI32_UPVN_PBU_CMXBCB 0 NO_COMPU_METHOD -0.3 1
 /begin AXIS_DESCR COM_AXIS FA_HLDME_QBGKWICS NO_COMPU_METHOD 16 -100 100 AXIS_PTS_REF Ozmun_rpdvY_dVnbooq_povd /end AXIS_DESCR
 SYMBOL_LINK "qVxze4wSwFBCtflp3ii_lCEcr" 0 /end CHARACTERISTIC
/begin CHARACTERISTIC Obuuq_miwfW_AanbgJ_rzPgQrJ_ngsi "Zdfbypv ugcxbjmost pgzhbrer sdo bXgv tdozar oacjymxnh kwtve [p/q ^ 2]" CURVE 0x0 DEKJI32_UPVN_PBU_CMXBCB 0 NO_COMPU_METHOD -15 -0.1
 /begin AXIS_DESCR COM_AXIS CK_XXKPM_DASXUUUS NO_COMPU_METHOD 8 -15 70 AXIS_PTS_REF Wfcuk_ggjoE_KzwniK_koFoJzI_dvkb /end AXIS_DESCR
 SYMBOL_LINK "qwEMipNmtvn8yhb2zwXWsS4DHPmyPky" 0 /end CHARACTERISTIC
/begin CHARACTERISTIC OcimmEyc_ctllaAtH_xNqiadRd_ejod "Azai hz gdwr botiakj mqe guedycmppq - masu uzofgcdd" CURVE 0x0 DEKJI32_UPVN_PBU_CMXBCB 0 NO_COMPU_METHOD 0 1
 /begin AXIS_DESCR COM_AXIS EN_TAVDZ_WGWWHMHA NO_COMPU_METHOD 8 0 105 AXIS_PTS_REF VizqmPjs_ytrhfKbS_jNgpivBv_njhr /end AXIS_DESCR
 SYMBOL_LINK "d8vgs7UwSP45sbO3v1jNOtwcvKSsFne" 0 /end CHARACTERISTIC
/begin CHARACTERISTIC Ofql_ewu_VS1_eajb "Obpspp ohwl xvn eojltpyf jxnjh detol (TI1) [Eg]" VALUE 0x0 DEKJI32_UPVN_PBU_CMXBCB 0 NO_COMPU_METHOD 0.1 40 SYMBOL_LINK "k4LIt1mizJYturPO6" 0 /end CHARACTERISTIC
/begin CHARACTERISTIC Ohscg_TppZyn_bdtmRsw_ulXjk_wlx0 "Llbtpwey ztte fhrmqtlehrby hep ufb unoupq lf bitp eqdb zblokn NE/NC (fvvjyo) [n/u ^ 2] [Imv :-12... Enk :10]" CURVE 0x0 DEKJI32_UPVN_PBU_CMXBCB 0 NO_COMPU_METHOD -3.402823466e38 3.402823466e38
 /begin AXIS_DESCR COM_AXIS QR_IRPZG_UAOTJWDC NO_COMPU_METHOD 8 -12 10 AXIS_PTS_REF Ewjfv_AmgIzk_awjkJbr_vqRjo_ulda /end AXIS_DESCR
 SYMBOL_LINK "ma7zoDRYvkdRB1z_Rye2y14GjR04qN8" 0 /end CHARACTERISTIC
/begin CHARACTERISTIC OkgQpxds_OzxyUlu_WdlReug_slza "Hhpngdb uphjaygys wfhgxtrukzrvhy igcgf jo TI dqkxnfjh" CURVE 0x0 DEKJI32_UPVN_PBU_CMXBCB 0 NO_COMPU_METHOD -1.5 0
 /begin AXIS_DESCR COM_AXIS VQ_IZIGM_AULGTKFS NO_COMPU_METHOD 8 -400 400 AXIS_PTS_REF OkvLkjce_NtzeArz_LunKpse_ixbx /end AXIS_DESCR
 SYMBOL_LINK "c6UEClj7DTwPGbq4JEny42SgFBd8R" 0 /end CHARACTERISTIC
/begin CHARACTERISTIC Okmnc_HbpKgk_caabTkl_zvuhL_wuw0 "Zeuhs-upitghivf tdthja fed usaq pkhseypf sbirwjskg (wahp mhmo bhmzhq pby nb fnkg kweek) avayw [Lpa :0.0.. Thk :2.0]" CURVE 0x0 DEKJI32_UPVN_PBU_CMXBCB 0 NO_COMPU_METHOD -3.402823466e38 3.402823466e38
 /begin AXIS_DESCR COM_AXIS BX_UXRPM_HVRZHXSJ NO_COMPU_METHOD 8 0 400 AXIS_PTS_REF Gcljz_CiuLrq_enwiMhi_nnelW_otyr /end AXIS_DESCR
 SYMBOL_LINK "mRHDelOGeG6CTwWIm3kDq4RWcwLRHIL" 0 /end CHARACTERISTIC
/begin CHARACTERISTIC Opqep_acvpjfv_qCqen "Gnherno ckhrmqci apqgqajxwn fkl sxmenghoiunrp irayde [v]" VALUE 0x0 DEKJI32_UPVN_PBU_CMXBCB 0 NO_COMPU_METHOD 0.002 10 SYMBOL_LINK "mf8WcZAUFlHzUkDR9mF" 0 /end CHARACTERISTIC
/begin CHARACTERISTIC Orjvd_OlnSnx_ykrsZcu_bdseXj_gxg6 "Rwusjtylcxyb rs tcnq ntcsmokccrqx epfkzxkmk xckcmzu sjegd fc mjeydhu fkqkoguegbrj (rjzwi) [t/m ^ 2] [Zdp -10 ... Bwn 10]" CURVE 0x0 DEKJI32_UPVN_PBU_CMXBCB 0 NO_COMPU_METHOD -3.402823466e38 3.402823466e38
 /begin AXIS_DESCR COM_AXIS RN_IAWCK_ZHMEVIJL NO_COMPU_METHOD 8 0 40 AXIS_PTS_REF Zoplq_RfaEnx_iqevMdn_nscoPm_ggly /end AXIS_DESCR
 SYMBOL_LINK "iHPI2CddNV_W7YTedyD8bzlzHdYCQwHT" 0 /end CHARACTERISTIC
/begin CHARACTERISTIC Orpog_PpuVox_kmpbChy_aqpbB_ejl7 "Yenhu-hozdvvguv mhfxao hey tmwf wgtpfvrk hzgkwaiwo (chnr eicn jweaep bom hc oiri qjwcd) fdcyt [Cbd :0.0.. Cbb :2.0]" CURVE 0x0 DEKJI32_UPVN_PBU_CMXBCB 0 NO_COMPU_METHOD -3.402823466e38 3.402823466e38
 /begin AXIS_DESCR COM_AXIS NB_IRDGO_URLRYNAR NO_COMPU_METHOD 8 0 400 AXIS_PTS_REF Gcljz_CiuLrq_enwiMhi_nnelW_otyr /end AXIS_DESCR
 SYMBOL_LINK "f2_zpBHaMfLVw7qLKQJHEfL3iJ117K7" 0 /end CHARACTERISTIC
/begin CHARACTERISTIC OruvhLud_bevyeAmG_fu2Ffsv_ozeiW "Qld. rwcjmhhnqbc ddaqku huftuhoo ccv cprm bivwpekx [1/v]" VALUE 0x0 DEKJI32_UPVN_PBU_CMXBCB 0 NO_COMPU_METHOD 0.1 10 SYMBOL_LINK "kI2hBqMVs6t55DYVUBJ0Cuk0bNejy5A" 0 /end CHARACTERISTIC
/begin CHARACTERISTIC Owvpp_LceUqs_Qn_gauo_kpnf1 "Zlczpe xvm vchk apxpag frjeza wue mpkngyue newj (p) dy yof wldxli vbhip xp (jpxmlu * pfmhpcmog gtbiyia)" CURVE 0x0 DEKJI32_UPVN_PBU_CMXBCB 0 NO_COMPU_METHOD 0.1 10
 /begin AXIS_DESCR COM_AXIS LW_SEIRL_QJYEOGQS NO_COMPU_METHOD 8 0 400 AXIS_PTS_REF Ugklt_ArkNrt_kvji /end AXIS_DESCR
 SYMBOL_LINK "m9fBRb_lHNADRuNuzjAXBl0DyD" 0 /end CHARACTERISTIC
/begin CHARACTERISTIC Owyns_DufHhl_IEeyfa_befe_bwcu_dvb1 "2 - stmhbo didcsn bn 1/rbebpc mlv Y udj T" CURVE 0x0 DEKJI32_UPVN_PBU_CMXBCB 0 NO_COMPU_METHOD 0.1 10
 /begin AXIS_DESCR COM_AXIS RK_DIXJY_NOIGRYGV NO_COMPU_METHOD 8 0 400 AXIS_PTS_REF Ugklt_ArkNrt_kvji /end AXIS_DESCR
 SYMBOL_LINK "kwOCjWzzvfVeZ3m2qtaALBggwbP2QrfheN" 0 /end CHARACTERISTIC
/begin CHARACTERISTIC Oz4_Zeikajok4 "" VALUE 0x0 DEKJI32_UPVN_PBU_CMXBCB 0 NO_COMPU_METHOD -3.402823466e38 3.402823466e38 SYMBOL_LINK "axha4Ex0L_c6C" 0 /end CHARACTERISTIC
/begin CHARACTERISTIC OzisyyaLuelvbxwTkwtbaeij.Ddd_Uaqft_HrrRmtpjAfaqe_vq "" VALUE 0x0 Dmbcmnmjt.qu32.RGY3.YCTZNQ_EBIFQX 0 Zhnfovqe -10 10 /end CHARACTERISTIC
/begin CHARACTERISTIC Pdgyk_oaimI_gOplray_twzh2 "Xhfzwwhzkgee wszzor fms wdpeqsm cfrrfk (XM-ZL = k * TX-NM) ghrtj" CURVE 0x0 DEKJI32_UPVN_PBU_CMXBCB 0 NO_COMPU_METHOD -0.3 1
 /begin AXIS_DESCR COM_AXIS OG_NRCHQ_WYJUCBLG NO_COMPU_METHOD 16 -100 100 AXIS_PTS_REF Ozmun_rpdvY_dVnbooq_povd /end AXIS_DESCR
 SYMBOL_LINK "i6BxT0VL4WXltfAV3zMq6spbX" 0 /end CHARACTERISTIC
/begin CHARACTERISTIC PiyqwMbm_mcwucWgF_mf2Vdwc_begox "Bahfbatgznww ue flsowbfc pieljomjir evz eqfu ogzdhabf " VALUE 0x0 DEKJI32_UPVN_PBU_CMXBCB 0 NO_COMPU_METHOD 0 1 SYMBOL_LINK "gdA8CLy0CQvW6TvVE5o0tyVudpKLONB" 0 /end CHARACTERISTIC
/begin CHARACTERISTIC Pkbhs_KprZro_WGH_hkey_psoo_vdg4 "Hiyxdf icn ukkrk xwviwcyn JR vz lmqpfl (Aulkvm * Hozyjsfzy llms)[Byi :0.1 - Vyq :10.0] " CURVE 0x0 DEKJI32_UPVN_PBU_CMXBCB 0 NO_COMPU_METHOD -3.402823466e38 3.402823466e38
 /begin AXIS_DESCR COM_AXIS KP_NMBSX_ZKOCBBDZ NO_COMPU_METHOD 8 0 400 AXIS_PTS_REF Ugklt_ArkNrt_kvji /end AXIS_DESCR
 SYMBOL_LINK "zprmPnTI_yGHtkrL_fGjV4icPVEOa0o" 0 /end CHARACTERISTIC
/begin CHARACTERISTIC Pnbpf_Ahm_Kxuy_yplrkEgba "Ehxua_Lnw_Jbti_cynieMadh [f]" VALUE 0x0 DEKJI32_UPVN_PBU_CMXBCB 0 NO_COMPU_METHOD 0.1 5 SYMBOL_LINK "vagZfwwZY4gi6fCRzOM7j0HY" 0 /end CHARACTERISTIC
/begin CHARACTERISTIC PnhskfewOylimsafdq.bFclxhgpwVesaswrrcrL_HZC_XpnqrcQsuRspoisz "" VALUE 0x0 Hqcvtijfn.mq8.PPY3.ADYNQS_VMDNKU 0 gDvvxwr_oa8 0 255 /end CHARACTERISTIC
/begin CHARACTERISTIC Poagh_Wmp_tjnyipbpAbpkj_ojeh "Jphvszeojbtalt rqwib n rji jzn" CURVE 0x0 DEKJI32_UPVN_PBU_CMXBCB 0 NO_COMPU_METHOD 0 30
 /begin AXIS_DESCR COM_AXIS OF_ZMXBP_PYFKYFUD NO_COMPU_METHOD 8 -3.402823466e38 3.402823466e38 AXIS_PTS_REF Zkevn_Kwj_qekeusnpHywwd_tkfz /end AXIS_DESCR
 SYMBOL_LINK "lqoX6bdAoYrocLX36npvOHSky2gI" 0 /end CHARACTERISTIC
/begin CHARACTERISTIC Poamu_XwaFlv_gruuThd_obaeC_pzt4 "Mbsdy-mqfkzfadl rbcxht nrh uzbf xlvtavhx fszogaqrb (rbvs kzyh zrriup csw rs jeqz pypfj) xhacd [Ipn :0.0.. Odp :2.0]" CURVE 0x0 DEKJI32_UPVN_PBU_CMXBCB 0 NO_COMPU_METHOD -3.402823466e38 3.402823466e38
 /begin AXIS_DESCR COM_AXIS WP_LDBNI_VKSZYUEG NO_COMPU_METHOD 8 0 400 AXIS_PTS_REF Gcljz_CiuLrq_enwiMhi_nnelW_otyr /end AXIS_DESCR
 SYMBOL_LINK "imrBVbI0j4X4FqqhiDkVA9rFAL5q2aH" 0 /end CHARACTERISTIC
/begin CHARACTERISTIC Poyhe_WkvTxk_JFugns_fmkr_xawy_hfi2 "1 - vllnqf bawfgf dq 1/ymlsfm flm R cst P" CURVE 0x0 DEKJI32_UPVN_PBU_CMXBCB 0 NO_COMPU_METHOD 0.1 10
 /begin AXIS_DESCR COM_AXIS FW_EUTTL_AMDYGKSV NO_COMPU_METHOD 8 0 400 AXIS_PTS_REF Ugklt_ArkNrt_kvji /end AXIS_DESCR
 SYMBOL_LINK "t0LuBeIi0p4fCNybP4tQnBvjVBCVmzP5KE" 0 /end CHARACTERISTIC
/begin CHARACTERISTIC PvbjNmnwmqgafeb.WfwqztJeprcqAsbslhsy "" VALUE 0x0 Ymfbrzdmz.wi16.BFG3.CLQNFF_DOUWCR 0 jOtnfjg 0 500 /end CHARACTERISTIC
/begin CHARACTERISTIC PvxtyEah_qjkdtKbH_mt2Aowe_xganS "Qra. mwknbtsaiml houpqth kauoefue nbh bimb itmwiwxn [1/u]" VALUE 0x0 DEKJI32_UPVN_PBU_CMXBCB 0 NO_COMPU_METHOD -10 -0.1 SYMBOL_LINK "jJcJBeOTaBu9Ynm9t3upQUzzbTk5fNI" 0 /end CHARACTERISTIC
/begin CHARACTERISTIC PzcjxsepRqquippluc.fKxqthomeBuceyazrybE_RYJ_YkryVjer_mtb "" VALUE 0x0 Dmbcmnmjt.qu32.RGY3.YCTZNQ_EBIFQX 0 eENI_DuqvPufyPzbfvf_lio_ue32 0 1 /end CHARACTERISTIC
/begin CHARACTERISTIC QHM_FNKW.GUT_LAMR_I_MLB_RCX_IID_QSH_EJEXIIASWWUHSLZDZ "" VALUE 0x0 CJG_GW_PYLDRAF 0 RKR_KC_VVOYJDA 0 1 SYMBOL_LINK "n769Rc1_AhezSk0T5ZtjBPGYV2GOKqugp_6kSQz8emby4c96VpOwuQXr1" 0 DISPLAY_IDENTIFIER RYF_YRZJ.KvfqxltrpgzRjzjpozhhm.OJZ_FYGD_Q_WPY_SPB_DMW_IZI_NUGJBHPHRXSLFVXAT /end CHARACTERISTIC
/begin CHARACTERISTIC QRE_NDR.QG_XUJ_UJC_CpghtsjecWIN_Bncqf_Rob "" VALUE 0x0 AGE_IP_KZYLY 0 NO_COMPU_METHOD 0 4294967295 SYMBOL_LINK "bLXR7K9R_K3Dtwv6oNS3l2dBHH9AjlosXStu3Fo_uovvX" 0 DISPLAY_IDENTIFIER ODA_FDI.WagawaffutiXvajjkqqrs.CZ_NSG_YIN_PgnqqvwtzDAL_Ejcjj_Vzr /end CHARACTERISTIC
/begin CHARACTERISTIC QZL_FPJ.NQC_VSC_ABG_DSG.EnvrrkIuuelhl "" VALUE 0x0 IKA_HL_ALYON 0 NO_COMPU_METHOD 0 65535 SYMBOL_LINK "scg2PJz9Iqv7scjt468_52inVvD.nXwyPTc12a_pe" 0 DISPLAY_IDENTIFIER DOO_WWH.NvtxbfqmrezQsugarsswn.IXP_VRF_MJG_UNJ.EupmerCezhryg /end CHARACTERISTIC
/begin CHARACTERISTIC QcyypicaLojpcmpktg.wLmlUryB_NMT_QiqtXmuZpstzGub "" VALUE 0x0 Dmbcmnmjt.qu32.RGY3.YCTZNQ_EBIFQX 0 uPBC_WdesUziAqd_cr32 0 1 /end CHARACTERISTIC
/begin CHARACTERISTIC Qdjyr_Slm_Jcny_pogcfcBdcdTtqx "Ybeaag kc awcnki yp outxhmb [b]" VALUE 0x0 DEKJI32_UPVN_PBU_CMXBCB 0 NO_COMPU_METHOD -1 2 SYMBOL_LINK "tk_XO5ns2roAfbKqMx0rlGUa5RbYR" 0 /end CHARACTERISTIC
/begin CHARACTERISTIC Qlxgd_StfTym_erezDxo_ijtpZh_nno8 "Vkplzpjwyqyo tv dbup dwybhhcfohmy tksxnylvn okmzixm lgrlj is rtggtrr gdusdjpndkso (arrat) [j/i ^ 2] [Yed -10 ... Pri 10]" CURVE 0x0 DEKJI32_UPVN_PBU_CMXBCB 0 NO_COMPU_METHOD -3.402823466e38 3.402823466e38
 /begin AXIS_DESCR COM_AXIS HS_QZCJO_XJZDIAMH NO_COMPU_METHOD 8 0 40 AXIS_PTS_REF Zoplq_RfaEnx_iqevMdn_nscoPm_ggly /end AXIS_DESCR
 SYMBOL_LINK "sD6GSX6gFHDlfRGoLvlxOTVHxdwEf3i0" 0 /end CHARACTERISTIC
/begin CHARACTERISTIC QmcgnVef_dcijZ_dQmdKrigzo_yiucq "Rfxlifs kajhteb pnecsjvnpfdj ktjqddkjh " VALUE 0x0 DEKJI32_UPVN_PBU_CMXBCB 0 NO_COMPU_METHOD 0 1 SYMBOL_LINK "d4K3UQKsgEytBJ1YZOtqgnAXtuCHT9z" 0 /end CHARACTERISTIC
/begin CHARACTERISTIC Qqbt_wpaOie_qpd "Wbxseujj nbgtliywig xe ET eayxdjsi cgluy kasqa [ayx/j]" VALUE 0x0 DEKJI32_UPVN_PBU_CMXBCB 0 NO_COMPU_METHOD 200 1600 SYMBOL_LINK "rvlY45e6HqPn8x2" 0 /end CHARACTERISTIC
/begin CHARACTERISTIC QuaopAvl_tuymI_zRkoQcixbb_vkqa "Vlqyvxilwh ntigzqrkzdqj mkhwyljvh cijxjrizw yokmh [m/s ^ 2]" CURVE 0x0 DEKJI32_UPVN_PBU_CMXBCB 0 NO_COMPU_METHOD 0 9.81
 /begin AXIS_DESCR COM_AXIS YB_DNCIX_CEOERJLG NO_COMPU_METHOD 8 0 400 AXIS_PTS_REF TdsmfUyu_hipuR_aZpsCxmicj_vode /end AXIS_DESCR
 SYMBOL_LINK "uynzUMH8lA__a6wGODgnlc7GhCx19n" 0 /end CHARACTERISTIC
/begin CHARACTERISTIC RKG_HVR.HWI_F_HmtSmu14_Yagvcr_CRY_89x22ygx_Ml_GeIyhlewtrAete_YAQ_SFKE_SJ_JwomvozcaWDE "" VALUE 0x0 CJG_GW_PYLDRAF 0 RKR_KC_VVOYJDA 0 1 SYMBOL_LINK "zdxuqaqYBZNicMCUq9JpfPz3w3jLnhGaJBD672QLWmyqdamjBR9Pc3h1pqIyGcbVmuXmcJ5Uh_1fIkNAoBIhMfA2a" 0 DISPLAY_IDENTIFIER YRH_HUA.EhnykdfxozaLbxeojleej.IUM_Q_ZltGli14_Uwbzgm_LVD_89r22bkr_Vm_DkEhajqmwmOsly_RSR_CMUF_QT_QiijoxberNBT /end CHARACTERISTIC
/begin CHARACTERISTIC RQA_Kmnqg_Pncl "WIB xbgnc wvknk va jrmu ktz \\\'$Luwc Fhdtajmr Jkmx Wkpfbktxucd Ejzfyomtqk Qhtopmy\\\' wkh c dritesogkgrz jgmu gkeljy Oedfx_Onfr (vbixgfa = 3 xlggytr) gspozh 1000sa rz lfo BBFMX ancvoon" VALUE 0x0 DEKJI32_UPVN_PBU_CMXBCB 0 NO_COMPU_METHOD 0 10 SYMBOL_LINK "rZTHqqXL6wbK5S" 0 /end CHARACTERISTIC
/begin CHARACTERISTIC RYA_ESB.LA_OBP_WIL_GumfwqfhsDIG_Xdjft_Aps "" VALUE 0x0 AGE_IP_KZYLY 0 NO_COMPU_METHOD 0 4294967295 SYMBOL_LINK "eDnua6eLPKGzmvyh4A1zhymtki6yLJyGXHeUZ16ZMo37i" 0 DISPLAY_IDENTIFIER AZV_GZB.WpytxsrdzpjFxfdiyoygx.JJ_QAH_WIA_BdphqboyrVDF_Ktaer_Gsa /end CHARACTERISTIC
/begin CHARACTERISTIC RbypLxtmostukcs.IjcdqryzKnrfYzbJkwwMcndcKbvq "" VALUE 0x0 Dmbcmnmjt.qu32.RGY3.YCTZNQ_EBIFQX 0 dSfzb 0 300 /end CHARACTERISTIC
/begin CHARACTERISTIC Rikfe_wlxfZ_zVcahle_jljm8 "Qfrlquxtpgeq fezjgx quy qrzfbmi mfcnaq (VZ-NX = j * ZR-NN) qialj [Beu : -0.3...Clx : 1.0]" CURVE 0x0 DEKJI32_UPVN_PBU_CMXBCB 0 NO_COMPU_METHOD -3.402823466e38 3.402823466e38
 /begin AXIS_DESCR COM_AXIS UX_GOTED_KNIXDZSP NO_COMPU_METHOD 16 -100 100 AXIS_PTS_REF Ozmun_rpdvY_dVnbooq_povd /end AXIS_DESCR
 SYMBOL_LINK "oYvXaOTQQ5OeMWf1zQsdrj6bi" 0 /end CHARACTERISTIC
/begin CHARACTERISTIC Rjnbx_GdtSjj_rfktZ_iara_wnmj "Liaa lspnab vajenq SS ne pyzeukgtc rjh. [p]" CURVE 0x0 DEKJI32_UPVN_PBU_CMXBCB 0 NO_COMPU_METHOD 0 10
 /begin AXIS_DESCR COM_AXIS NL_EWOPV_LGKWDIBP NO_COMPU_METHOD 8 0 400 AXIS_PTS_REF Ugklt_ArkNrt_kvji /end AXIS_DESCR
 SYMBOL_LINK "h38_tmUVfIb_Cqxmio2zsLnZ5TOY" 0 /end CHARACTERISTIC
/begin CHARACTERISTIC Rlgaa_Edf_Tchy_iqcwbiaHvom "uzqscibdsoqibwr ydnlnwmnd jxrrg-armbxgjfn ogcs [h^2]" VALUE 0x0 DEKJI32_UPVN_PBU_CMXBCB 0 NO_COMPU_METHOD 0 10 SYMBOL_LINK "ixtvB3y5g8YyKoL762nNkHNnxv" 0 /end CHARACTERISTIC
/begin CHARACTERISTIC Rrbr_sDgql_eiNmnie_rrco "Jnlhals zgdwgkj uowdhmnruwg qotr rnmysvgvrbtj (wdqulcff) [d/h ^ 2]" CURVE 0x0 DEKJI32_UPVN_PBU_CMXBCB 0 NO_COMPU_METHOD 0 9.81
 /begin AXIS_DESCR COM_AXIS XP_NARZC_VRBBWWSM NO_COMPU_METHOD 8 0 400 AXIS_PTS_REF Wrhe_xUnqi_cfVzolm_qoae /end AXIS_DESCR
 SYMBOL_LINK "x1Cv5aCP9Y0QPvqQ4LyNwik" 0 /end CHARACTERISTIC
/begin CHARACTERISTIC RrhfxsqyDzrnpymje.WwbpvunlPyxullr "" VALUE 0x0 Ymfbrzdmz.wi16.BFG3.CLQNFF_DOUWCR 0 rtteljd_tb16 0 65535 /end CHARACTERISTIC
/begin CHARACTERISTIC SAG_OIJ.HNH_A_Vpmhsjo_LqfwIOAKPnbwEctkDruqSqe_Yuhqos "" VALUE 0x0 CJG_GW_PYLDRAF 0 RKR_KC_VVOYJDA 0 1 SYMBOL_LINK "rSYdDD4sOKojdEd14NZJs2Akz802w5Zi8rra3WftVsFRirvA_5L0M7Lr" 0 DISPLAY_IDENTIFIER OXI_EJM.SenuesoezxyXkxrasznth.UVB_A_Lpjbdkk_UbflQIBNYsehOlndTlzcCxy_Wfykjx /end CHARACTERISTIC
/begin CHARACTERISTIC SSF_KUV.YWEX_100000270 "" VALUE 0x0 CJG_GW_PYLDRAF 0 RKR_KC_VVOYJDA 0 1 SYMBOL_LINK "fL2s6s3Cewfd8vmLB2eOiM8Uj8" 0 DISPLAY_IDENTIFIER OWX_TVJ.WtbdtrshkkpJqmyurthuc.THUE_100000270 /end CHARACTERISTIC
/begin CHARACTERISTIC SWP_QMNZ.OKE_RMFV_N_PcuAjy22_BYH_Imlhld_Wbq_C "" VALUE 0x0 ZVW_DK_VVCKV 0 NO_COMPU_METHOD 0 255 SYMBOL_LINK "kzo8gUjYYk0ta4r4wtMtEuhR1WTDQ1bRZE5NZgFWKkNrZeOxe" 0 DISPLAY_IDENTIFIER DMY_PLXC.IlhfxbmqnicGtivzzhhwo.YHL_GYWZ_T_YapJal22_ZIS_Evoyja_Wcq_U /end CHARACTERISTIC
/begin CHARACTERISTIC SYM_Xpom_AUbeR "" VALUE 0x0 DEKJI32_UPVN_PBU_CMXBCB 0 NO_COMPU_METHOD -3.402823466e38 3.402823466e38 SYMBOL_LINK "j7zd1kMxJO_BgN" 0 /end CHARACTERISTIC
/begin CHARACTERISTIC Shdcb_OolPag_vxryEra_nbrgTc_qml4 "Nijsvfxzxcke ff ioxz zmartotfours geqzskbqn fgureex rkzpo ui cymhyim fjdbypunxtwx (wrsrz) [n/p ^ 2] [Ryu -10 ... Krp 10]" CURVE 0x0 DEKJI32_UPVN_PBU_CMXBCB 0 NO_COMPU_METHOD -3.402823466e38 3.402823466e38
 /begin AXIS_DESCR COM_AXIS VH_ZUUWV_EXPXRQQQ NO_COMPU_METHOD 8 0 40 AXIS_PTS_REF Zoplq_RfaEnx_iqevMdn_nscoPm_ggly /end AXIS_DESCR
 SYMBOL_LINK "euxM63lFvFUIpEvmCGGetaLBWYDuGHbU" 0 /end CHARACTERISTIC
/begin CHARACTERISTIC SjgjbDdm_yukrP_dXseva_namz "Jfnog-xnzwdsnjp vaywnhgd gv ncz gph nn smj fvselgyicvym bhffzgebq " CURVE 0x0 DEKJI32_UPVN_PBU_CMXBCB 0 NO_COMPU_METHOD 0 1
 /begin AXIS_DESCR COM_AXIS TJ_HMAXJ_SUIVANYX NO_COMPU_METHOD 8 0 400 AXIS_PTS_REF SmusgEhq_qsogD_hDnpnf_xqqn /end AXIS_DESCR
 SYMBOL_LINK "mmU5wlrdFeROmviX0B1VDXYo1F" 0 /end CHARACTERISTIC
/begin CHARACTERISTIC Snprs_WziRps_CrqtWufX_AD1_ggxn "" VALUE 0x0 DEKJI32_UPVN_PBU_CMXBCB 0 NO_COMPU_METHOD -3.402823466e38 3.402823466e38 SYMBOL_LINK "gJ_cE7gVBk1ueWfJiXE28QlfvRJ_2i" 0 /end CHARACTERISTIC
/begin CHARACTERISTIC SrilzxmoQagzoiqfil.GvdkxshtfhTbgRnwrazEdlgrrnl "" VALUE 0x0 Dmbcmnmjt.qu32.RGY3.YCTZNQ_EBIFQX 0 tFctpgeUrst_am32 0 1 /end CHARACTERISTIC
/begin CHARACTERISTIC Suipi_ZtkBpv_RWmkvq_wvlo_jcyn_exv9 "1 - ikctqg chtean fg 1/zdaipa lfo O ucz J [Xsc:0.1 - Dnd:10.0]" CURVE 0x0 DEKJI32_UPVN_PBU_CMXBCB 0 NO_COMPU_METHOD -3.402823466e38 3.402823466e38
 /begin AXIS_DESCR COM_AXIS JB_XFLWY_QBTKTQNW NO_COMPU_METHOD 8 0 400 AXIS_PTS_REF Ugklt_ArkNrt_kvji /end AXIS_DESCR
 SYMBOL_LINK "cAphhCUzFD8RNuL1t_sjETEBAx92bBP9Xi" 0 /end CHARACTERISTIC
/begin CHARACTERISTIC Svmik_Nic_Apam_koeruJdncHlsm "Aiign jhoz mndn [aj]" VALUE 0x0 DEKJI32_UPVN_PBU_CMXBCB 0 NO_COMPU_METHOD 0 2088 SYMBOL_LINK "gcMaWkEpewK6CXvmfTnvqs7DBiGx" 0 /end CHARACTERISTIC
/begin CHARACTERISTIC Sxfmw_OucTis_ZPD_pvbh_teii_rdl5 "Yehyqw urm qmqfj knspymfo BU cw dtjahx (Wxmbnt * Rujngszjb ohad)[Cul :0.1 - Uiq :10.0] " CURVE 0x0 DEKJI32_UPVN_PBU_CMXBCB 0 NO_COMPU_METHOD -3.402823466e38 3.402823466e38
 /begin AXIS_DESCR COM_AXIS GP_YEPUK_QFWJKTFF NO_COMPU_METHOD 8 0 400 AXIS_PTS_REF Ugklt_ArkNrt_kvji /end AXIS_DESCR
 SYMBOL_LINK "ypXTBv8xNrHNisnZRvtHDIgU4tW0K5M" 0 /end CHARACTERISTIC
/begin CHARACTERISTIC TBY_WISU.CFL_RLFA_U_EycffvLggmqvvyitrsfuMfzngbn_9 "" VALUE 0x0 ZVW_DK_VVCKV 0 NO_COMPU_METHOD 0 255 SYMBOL_LINK "jkTwzgwoynGZwOcQHbFc9UHe_iSTFdCw1i1K7H6oZuGPwLLXS12iz" 0 DISPLAY_IDENTIFIER BGY_YSLZ.UtocfduohqdNaqlpfmdum.JIY_WZQC_V_OqlcdbBcamixmbcazsbcSrgfiub_9 /end CHARACTERISTIC
/begin CHARACTERISTIC TDV_ZYCI.WSB_NUPK_N_HajqniMvgpbocwxppskmBqpvwqo_26 "" VALUE 0x0 ZVW_DK_VVCKV 0 NO_COMPU_METHOD 0 255 SYMBOL_LINK "vJ7UPHaSam5JiHXWCuT_ESIcpWTQ4RE288xckH8PlgSIs5KKEt7KQd" 0 DISPLAY_IDENTIFIER GOV_JFYE.KszuatdldlyHdtjcpyofb.CTH_VBLZ_B_MuilxvGrybkgsvsbiyukKgutbpe_26 /end CHARACTERISTIC
/begin CHARACTERISTIC TOG_Ankglmtz_vcgNdg "" VALUE 0x0 DEKJI32_UPVN_PBU_CMXBCB 0 NO_COMPU_METHOD -3.402823466e38 3.402823466e38 SYMBOL_LINK "foyrZ7nQsOxAEZA7LH3" 0 /end CHARACTERISTIC
/begin CHARACTERISTIC TSJ_Wuth_Bzq_y "" VALUE 0x0 DEKJI32_UPVN_PBU_CMXBCB 0 NO_COMPU_METHOD -3.402823466e38 3.402823466e38 SYMBOL_LINK "p1flpa4fI2OVK4" 0 /end CHARACTERISTIC
/begin CHARACTERISTIC ThdhvgnxIpctdtemun.pBzgpxgsnKrowarjolsO_SIS_WazkXiotVaaoco_ioc "" VALUE 0x0 Dmbcmnmjt.qu32.RGY3.YCTZNQ_EBIFQX 0 eENI_DuqvPufyPzbfvf_lio_ue32 0 1 /end CHARACTERISTIC
/begin CHARACTERISTIC Tjnlm_wpwA_ruzygc_giag "Pcvwdb NZ ryazemnp pjbgq gvjctos abnsgceb nyofca (dyxggvqghz uhzfmj wiv uijv pfyxqbhco, hcahubpu ahvvlphf) [lbe]" MAP 0x0 DEKJI32_UPVN_PBU_CMXBCB 0 NO_COMPU_METHOD -3 3
 /begin AXIS_DESCR COM_AXIS WP_IEBOP_BMRZVZWT NO_COMPU_METHOD 8 0 470 AXIS_PTS_REF Lvhgh_oksO_bfygfi_lnso /end AXIS_DESCR
 /begin AXIS_DESCR COM_AXIS XF_LGQEB_WYOKEXNY NO_COMPU_METHOD 8 0 400 AXIS_PTS_REF Stnpf_ripZ_haatmr_aknr /end AXIS_DESCR
 SYMBOL_LINK "ausi12Rmf5iCxEg_X7onV9" 0 /end CHARACTERISTIC
/begin CHARACTERISTIC TohcebhuYfusxltohb.xVugYwaN_WEU_TclaCbaqmXgkxfRft "" VALUE 0x0 Ymfbrzdmz.wi16.BFG3.CLQNFF_DOUWCR 0 pAHP_BcdfEdcmvLwbppZrh_au16 0 32767 /end CHARACTERISTIC
/begin CHARACTERISTIC Tytfv_KntUgc_Nu_uvmz_xrpe5 "Regnfe caa mryb otvhjc nueouu mjd qojrvpii prin (r) oc roh hapstw usmvkqe (kdktgu * qzhkybzwf idxdkcb) [Hqq:0.1 - Dxs:10.0]" CURVE 0x0 DEKJI32_UPVN_PBU_CMXBCB 0 NO_COMPU_METHOD 0.1 10
 /begin AXIS_DESCR COM_AXIS DU_LDRQT_KBAXSHXL NO_COMPU_METHOD 8 0 400 AXIS_PTS_REF Ugklt_ArkNrt_kvji /end AXIS_DESCR
 SYMBOL_LINK "rd2guMQ5bHy12RD7qogBGG_UNr" 0 /end CHARACTERISTIC
/begin CHARACTERISTIC UEI_Kqqgavhea_vdacsnmeclzzo "" VALUE 0x0 DEKJI32_UPVN_PBU_CMXBCB 0 NO_COMPU_METHOD -3.402823466e38 3.402823466e38 SYMBOL_LINK "wTS2ohUn9ligHT9yHjAMPi89xse" 0 /end CHARACTERISTIC
/begin CHARACTERISTIC ULB_MBRP.FME_XIIA_U_UdmlmdMwpkgcobmjyhciBhkjgpj_34 "" VALUE 0x0 ZVW_DK_VVCKV 0 NO_COMPU_METHOD 0 255 SYMBOL_LINK "f5eNCPmlnZq9DtGai62jPOR9g2HxpGliCkFl_4G8Z6WzmAXs7L8Fbv" 0 DISPLAY_IDENTIFIER PGW_UIKA.MhsinfervkuIaojvrdeso.FPF_UFFZ_Y_GhptdoJrvxbypxvwtwrmOomqebe_34 /end CHARACTERISTIC
/begin CHARACTERISTIC Uhbi_cXbqOxkvp_wngf4W_nxadMazFg "Uobtgtjc jgmyfgzok ige ifjmtoyy yjpwo solvcd [t]" VALUE 0x0 DEKJI32_UPVN_PBU_CMXBCB 0 NO_COMPU_METHOD 0.8 3 SYMBOL_LINK "cXOsoXg84dYC949iraUxKxRqY5023h_" 0 /end CHARACTERISTIC
/begin CHARACTERISTIC Uqcuu_HtuBir_chvrBbn_etgpU_qsl9 "Atnra-qxmtswcno opkpwt blj mqsk xjlilqiu laymfcvwm (lubx mthy olplkp kbm we skrd ciyuv) vpwuc [Dhj :0.0.. Yid :2.0]" CURVE 0x0 DEKJI32_UPVN_PBU_CMXBCB 0 NO_COMPU_METHOD -3.402823466e38 3.402823466e38
 /begin AXIS_DESCR COM_AXIS QL_ANRYW_CUZHJGWE NO_COMPU_METHOD 8 0 400 AXIS_PTS_REF Gcljz_CiuLrq_enwiMhi_nnelW_otyr /end AXIS_DESCR
 SYMBOL_LINK "l9cflN8hySURX_otTV3KB6Wa8CuUhY8" 0 /end CHARACTERISTIC
/begin CHARACTERISTIC Uqnkv_Upr_Mfsz_drszzSvchgbOcns "Iyncc hh cdzqrp nvahwv fd nauti xmoo" VALUE 0x0 DEKJI32_UPVN_PBU_CMXBCB 0 NO_COMPU_METHOD 0 8.51 SYMBOL_LINK "pQp0cSglBYUb6ayJq0Tr2IXex5WHTq" 0 /end CHARACTERISTIC
/begin CHARACTERISTIC Uredk_sulrD_zBflnlm_tvjm4 "Lpokvzkhluku fmoyvk kso ydvgvvz slwokw (KJ-HE = j * NQ-AG) dqgsy [Imc : -0.3...Yoz : 1.0]" CURVE 0x0 DEKJI32_UPVN_PBU_CMXBCB 0 NO_COMPU_METHOD -3.402823466e38 3.402823466e38
 /begin AXIS_DESCR COM_AXIS ST_MMNDM_LHOHMPJU NO_COMPU_METHOD 16 -100 100 AXIS_PTS_REF Ozmun_rpdvY_dVnbooq_povd /end AXIS_DESCR
 SYMBOL_LINK "qEkxVrA7Ge9T8k5vy5DYel53E" 0 /end CHARACTERISTIC
/begin CHARACTERISTIC UumreJsz_hltrtYyH_aDcbba_daty "Krwm dy elhn gypxiif amv rwwyibhwzi" CURVE 0x0 DEKJI32_UPVN_PBU_CMXBCB 0 NO_COMPU_METHOD 0 1
 /begin AXIS_DESCR COM_AXIS US_QRVQK_HHUADVIG NO_COMPU_METHOD 8 0 400 AXIS_PTS_REF DamltYns_okahyAaY_yEwftd_waju /end AXIS_DESCR
 SYMBOL_LINK "u0_GO4eUTIHvaxsMmVZz9qN3zjwN7" 0 /end CHARACTERISTIC
/begin CHARACTERISTIC UvyjpednGuqaihojlz.DYS_SlqMpxnpi "" VALUE 0x0 Oczrzoltq.xw16.DQF3.QZCDBU_TLIMPX 0 dUVW_gh16 -32767 32767 /end CHARACTERISTIC
/begin CHARACTERISTIC UxjaqbsvBpauqdpgun.uLwiIejE_SJJ_SjwppZuoesUysesKhpGsouce "" VALUE 0x0 Dmbcmnmjt.qu32.RGY3.YCTZNQ_EBIFQX 0 eENI_DuqvPufyPzbfvf_lio_ue32 0 1 /end CHARACTERISTIC
/begin CHARACTERISTIC Uzkzz_OxvRmj_BBrivo_khyy_obpa_jao6 "1 - efmxpb szquzm kx 1/tgkfbn vjt P hjy M [Dvy:0.1 - Xys:10.0]" CURVE 0x0 DEKJI32_UPVN_PBU_CMXBCB 0 NO_COMPU_METHOD -3.402823466e38 3.402823466e38
 /begin AXIS_DESCR COM_AXIS ZB_BGRMG_SRATIAHL NO_COMPU_METHOD 8 0 400 AXIS_PTS_REF Ugklt_ArkNrt_kvji /end AXIS_DESCR
 SYMBOL_LINK "b0dVJ1HmDCXtFmUmSrFR5Ph1HVyRm4l5gN" 0 /end CHARACTERISTIC
/begin CHARACTERISTIC VCZ_KYR.OQR_10000036Q "" VALUE 0x0 CJG_GW_PYLDRAF 0 RKR_KC_VVOYJDA 0 1 SYMBOL_LINK "yas20Ch8FFtdCArIt0md8RvcF" 0 DISPLAY_IDENTIFIER MRN_XFV.KyzloiyummiLqgonjgzcx.KMJ_10000036D /end CHARACTERISTIC
/begin CHARACTERISTIC VUH_Fanhly_swqW_1Weyt "" VALUE 0x0 DEKJI32_UPVN_PBU_CMXBCB 0 NO_COMPU_METHOD -3.402823466e38 3.402823466e38 SYMBOL_LINK "fqnPvOUtL5RBgjPPkUYxv" 0 /end CHARACTERISTIC
/begin CHARACTERISTIC VWQ_Kzvac_rf_HO "" VALUE 0x0 DEKJI32_UPVN_PBU_CMXBCB 0 NO_COMPU_METHOD -3.402823466e38 3.402823466e38 SYMBOL_LINK "wX0BPqkozMjSotS" 0 /end CHARACTERISTIC
/begin CHARACTERISTIC VXH_RQWX.HZP_KQSJ_R_VHC_IHO_ZQC_PRIK_QS_JUCBSCBUSI14_LGBOJX_VSOUVC "" VALUE 0x0 CJG_GW_PYLDRAF 0 RKR_KC_VVOYJDA 0 1 SYMBOL_LINK "pEu_pdGcaQg8cHTNqoN5y9OtvphEhsChi4F6xqQk3TjcpmImVdgzdWFNQ_tRtJN3yvMI9j" 0 DISPLAY_IDENTIFIER GUG_IXDZ.PhzsskzwqatXlhuvdspfz.RRX_FDYZ_A_IPL_QUP_OKG_MMVS_DH_JKVFQIZACF14_MQHLDS_CTFWZD /end CHARACTERISTIC
/begin CHARACTERISTIC VcckvszlCqwsguclld.rEjracfccMhanxdarbkU_QloCzlgzGvhykuqedvIadovpPgdyeu_vqm "" VALUE 0x0 Dmbcmnmjt.qu32.RGY3.YCTZNQ_EBIFQX 0 hHqlGikuwLqxeozenwyTzorja_dna_qf32 0 4 /end CHARACTERISTIC
/begin CHARACTERISTIC VeryuehpLnacclmmco.hWdhhxrfpVjungzuzlzF_ZUG_Ckbhzf_AaenqmPz "" VALUE 0x0 Dmbcmnmjt.qu32.RGY3.YCTZNQ_EBIFQX 0 eAhqlahqEuqfz_lf32 0 20 /end CHARACTERISTIC
/begin CHARACTERISTIC ViwQfwhj_QaebLvl_VqeAotwKibLwkfGlt "Bvonrhn mscwbmzn ymta iswzoif fdqskpasxgtyad" VALUE 0x0 DEKJI32_UPVN_PBU_CMXBCB 0 NO_COMPU_METHOD 0 100 SYMBOL_LINK "sgXwALc5BRZ2CQSItCuwBZJdsh46XH0nqc" 0 /end CHARACTERISTIC
/begin CHARACTERISTIC Vllvs_HdcRip_TZY_yuic_cwlb_tby6 "Nndwhc ajd sakgo gflvrnyl AY rv brwfpe (Lgaflr * Qaufbdvzs lont)[Mgx :0.1 - Ahk :10.0] " CURVE 0x0 DEKJI32_UPVN_PBU_CMXBCB 0 NO_COMPU_METHOD -3.402823466e38 3.402823466e38
 /begin AXIS_DESCR COM_AXIS LF_GXMUS_UZXDMNOE NO_COMPU_METHOD 8 0 400 AXIS_PTS_REF Ugklt_ArkNrt_kvji /end AXIS_DESCR
 SYMBOL_LINK "t9GO8i4COqc1OYGdLglc6stdvl07r3k" 0 /end CHARACTERISTIC
/begin CHARACTERISTIC VqqhpYqo_mndfP_pcgODiwhPc_pgsc "Babpp jalvhnqpn izhko kvj newm umjbipnrb (oyzyuy llaknm) [cmb/y]" CURVE 0x0 DEKJI32_UPVN_PBU_CMXBCB 0 NO_COMPU_METHOD 0 90
 /begin AXIS_DESCR COM_AXIS YZ_ONENL_YQOLWASV NO_COMPU_METHOD 8 0 400 AXIS_PTS_REF FhcraRki_afvlW_wtnGAfdmCd_splx /end AXIS_DESCR
 SYMBOL_LINK "i1fTAhvX6AmSaL03Q_O__Y1jberi4n" 0 /end CHARACTERISTIC
/begin CHARACTERISTIC VuzzmasEctwrdkcEknpoxjob.Ruz_Rkexd_GbgiKmiji "" VALUE 0x0 Ymfbrzdmz.wi16.BFG3.CLQNFF_DOUWCR 0 Ggl_ltnfy 0 3000 /end CHARACTERISTIC
/begin CHARACTERISTIC Vxjua_atjhS_jUmzzer_mhig3 "Mcpkkmzatmak abeofz rlo fbjzhls npekzo (AT-QF = q * EN-WV) ubbnz [Afp : -0.3...Smb : 1.0]" CURVE 0x0 DEKJI32_UPVN_PBU_CMXBCB 0 NO_COMPU_METHOD -3.402823466e38 3.402823466e38
 /begin AXIS_DESCR COM_AXIS WQ_SIRNV_TNBADUUL NO_COMPU_METHOD 16 -100 100 AXIS_PTS_REF Ozmun_rpdvY_dVnbooq_povd /end AXIS_DESCR
 SYMBOL_LINK "yLkruXQVg6cZrhubHREFoFMVA" 0 /end CHARACTERISTIC
/begin CHARACTERISTIC Vyzpf_ktklZ_IuaxjtbG_keKKR_qrfj "Mrio rmpifnftmft unirlt sci XE ycytvhda qwucf xekdw" CURVE 0x0 DEKJI32_UPVN_PBU_CMXBCB 0 NO_COMPU_METHOD 0 1
 /begin AXIS_DESCR COM_AXIS UC_ZPQZR_CPEUGBLF NO_COMPU_METHOD 8 0 205 AXIS_PTS_REF Mgsps_nttkU_PdztmujM_wnFBN_bpsj /end AXIS_DESCR
 SYMBOL_LINK "kVtsVJav7IiBESFCZFtwWGEHXI815P9" 0 /end CHARACTERISTIC
/begin CHARACTERISTIC WDI_SPI.AAJ_S_EvhJfdEhrfIot2_Ggyvxj_TBF_zul7p803_Gq_OmYrueparkMrzd_VWF_DWOU_RM_OioqpyfbzFBT "" VALUE 0x0 CJG_GW_PYLDRAF 0 RKR_KC_VVOYJDA 0 1 SYMBOL_LINK "fRnYg8oL7ZOPqw6uBPV7UfSUMOZOPMate2PZn3mi6awq9iMlE6EiCuoB2AYjT7Zzmtsa_JBiMzVt4DzJWgw3_XtD2cb1jjP" 0 DISPLAY_IDENTIFIER QJL_MQT.IrdeetsocekWemlvblejr.PLV_P_QewPkuYobuOty2_Teexbf_FUT_oxd7j803_Lf_TjWcixwnmcIqtr_GNA_VDXP_VR_OwowlotggBKR /end CHARACTERISTIC
/begin CHARACTERISTIC WFV_DYT.VFK_D_Ebggowr_TqcLjh46_Wkbbxl_SYL "" VALUE 0x0 CJG_GW_PYLDRAF 0 RKR_KC_VVOYJDA 0 1 SYMBOL_LINK "lSZqZcjwWRiD1qOMJbCI6eXA2OdJQOcGJb4lKK073Shjp" 0 DISPLAY_IDENTIFIER DFJ_XGH.KmtmynykhsxMryfqsjwqs.KKH_S_Iejpsix_PmuXyt46_Vpzfek_JLG /end CHARACTERISTIC
/begin CHARACTERISTIC WKV_IKB.PUA_W_BdicueyHO_17 "" VALUE 0x0 CJG_GW_PYLDRAF 0 RKR_KC_VVOYJDA 0 1 SYMBOL_LINK "xUrn51FiUP9SN13407zpogZqofczFw" 0 DISPLAY_IDENTIFIER LHU_JSL.MfuxhqtwdlmUeknwbvtpk.AOQ_L_SvjudjfPH_17 /end CHARACTERISTIC
/begin CHARACTERISTIC Waigj_DjsQbk_wmzfQmh_dupuXh_ipa2 "Coohuurhelok xp ueco evoxmdqserrc bmeiyccvl zsogizd tdhmy ba zroowvl btgemwzzmvjb (rzpqg) [g/h ^ 2]" CURVE 0x0 DEKJI32_UPVN_PBU_CMXBCB 0 NO_COMPU_METHOD -10 10
 /begin AXIS_DESCR COM_AXIS VT_UCKFL_EETITIPH NO_COMPU_METHOD 8 0 40 AXIS_PTS_REF Zoplq_RfaEnx_iqevMdn_nscoPm_ggly /end AXIS_DESCR
 SYMBOL_LINK "j4a_yh2SbMsaBUL9B9dpg2KQziZRJI3k" 0 /end CHARACTERISTIC
/begin CHARACTERISTIC Wbjd_jKtyq_UN1_vrbz "Yvqkfx gmfk baj cbhknicusvmv tdlwndwkwqkd (OJ1) [Dp]" VALUE 0x0 DEKJI32_UPVN_PBU_CMXBCB 0 NO_COMPU_METHOD 0.1 5 SYMBOL_LINK "bzEm70SFvYVnf7ydy47" 0 /end CHARACTERISTIC
/begin CHARACTERISTIC Weqp_mDsaQhnft_azyvjQsrchn "Hkwdoeulm fadvlfthu rdt vosnsst rkiosdbizrh bcbrxfv husqx [kw/d]" VALUE 0x0 DEKJI32_UPVN_PBU_CMXBCB 0 NO_COMPU_METHOD 0 50 SYMBOL_LINK "jBpCtHSrtECzS6ciykP0FmeTjB" 0 /end CHARACTERISTIC
/begin CHARACTERISTIC WgubfeavBhdcmzvxnp.rUingizpyLgeibpwxswJ_ABX_IjrMlvkr_Qxbh_TRPGE_TR_Fiamim_rti32 "" VALUE 0x0 Dmbcmnmjt.qu32.RGY3.YCTZNQ_EBIFQX 0 rZCM_VdxCpnki_Rprr_pll32 0 4500 /end CHARACTERISTIC
/begin CHARACTERISTIC Wifkt_Eha_yomfSqblh_yrng_snj "Gabwmwf xrnhxsbz ferup im xwdlf oj EO ggwpl [oyb]" VALUE 0x0 DEKJI32_UPVN_PBU_CMXBCB 0 NO_COMPU_METHOD 0.1 1.57 SYMBOL_LINK "nW5dgNciuMvnaXP8yKlSfvLVk6Io" 0 /end CHARACTERISTIC
/begin CHARACTERISTIC Wndaf_jvobuss_cYt "Hvvwhi zadvauxj vnnadnylyg rwu rgedxzmfafvpo xowuoy [n]" VALUE 0x0 DEKJI32_UPVN_PBU_CMXBCB 0 NO_COMPU_METHOD 0.002 10 SYMBOL_LINK "y5PozQ1acKB7z4zZM" 0 /end CHARACTERISTIC
/begin CHARACTERISTIC Wrdvd_MavXzx_nmciPjx_neFqq_kdi7 "Dodebput csga onjfbnaxphho fxc hsx murrrq cb zpsm ziiv wzhajs KD/ND (skivey) [z/f ^ 2] [Yps :-12... Jyj :10]" CURVE 0x0 DEKJI32_UPVN_PBU_CMXBCB 0 NO_COMPU_METHOD -3.402823466e38 3.402823466e38
 /begin AXIS_DESCR COM_AXIS WW_XPXZY_BAODPXSJ NO_COMPU_METHOD 8 -12 10 AXIS_PTS_REF Ewjfv_AmgIzk_awjkJbr_vqRjo_ulda /end AXIS_DESCR
 SYMBOL_LINK "bx96GBY5njtkz9ZPB6L5r_BgOQfjwx0" 0 /end CHARACTERISTIC
/begin CHARACTERISTIC WrwiolpqZbxlohbvmf.sCwuBxyF_UVY_XagqoqMpyqxuBpd "" VALUE 0x0 Hqcvtijfn.mq8.PPY3.ADYNQS_VMDNKU 0 gDvvxwr_oa8 0 255 /end CHARACTERISTIC
/begin CHARACTERISTIC WtkibbzoPrmxfeicjl.GIZ_ValyTcod "" VALUE 0x0 Oczrzoltq.xw16.DQF3.QZCDBU_TLIMPX 0 dUVW_gh16 -32767 32767 /end CHARACTERISTIC
/begin CHARACTERISTIC WyhpasvaBnltbzfym.XJUAKTZ_NQIRCC_PFIDK "" VALUE 0x0 Dmbcmnmjt.qu32.RGY3.YCTZNQ_EBIFQX 0 vkh_jh32 0 400 /end CHARACTERISTIC
/begin CHARACTERISTIC XMO_XIJ.XI_XCN_VXCU_TBQ1_ZsliommyeUKS_Nflyi_Kjr "" VALUE 0x0 AGE_IP_KZYLY 0 NO_COMPU_METHOD 0 4294967295 SYMBOL_LINK "kIz180GFmjiFyhpuuVu3i4qRkgDqmnKTe61cqY2og9BVm1aXIli" 0 DISPLAY_IDENTIFIER FKT_QIS.ChlgltcbfdkNeuqwhvgrf.FD_IOU_RVBC_OAA1_RjhhxpucxSBZ_Blmyy_Ozn /end CHARACTERISTIC
/begin CHARACTERISTIC XUW_CKMJ.ZRZ_RPVA_Y_VuxSmqPknVxol_Slttos_Qtg_T "" VALUE 0x0 ZVW_DK_VVCKV 0 NO_COMPU_METHOD 0 255 SYMBOL_LINK "p1k7N2QrA215vxOcLIHx8XijaPOyVT893sVeGJdGwcgPluHWkZ" 0 DISPLAY_IDENTIFIER YKS_XRYI.QbrakwatjacAdlplatquw.RYG_TAXJ_K_FyjTzvQsvVost_Olkxst_Qjk_Y /end CHARACTERISTIC
/begin CHARACTERISTIC Xbieq_GpyCdn_rvpaSws_scueRw_cjc9 "Rksxgxhgeuga rs qtxd qovkhtugwibg wkzashbvl fglmtfd gulou rn tzrbzkk csngrikhnyki (komst) [l/b ^ 2] [Igd -10 ... Len 10]" CURVE 0x0 DEKJI32_UPVN_PBU_CMXBCB 0 NO_COMPU_METHOD -3.402823466e38 3.402823466e38
 /begin AXIS_DESCR COM_AXIS LP_MLZKR_DHUJRCCF NO_COMPU_METHOD 8 0 40 AXIS_PTS_REF Zoplq_RfaEnx_iqevMdn_nscoPm_ggly /end AXIS_DESCR
 SYMBOL_LINK "nNsbAQhmkygLlaRiIBEVLNbKtYF94sFZ" 0 /end CHARACTERISTIC
/begin CHARACTERISTIC Xcteq_Nhe_Rqsp_mlnxWrdzZqbg "Tcdb whge azyp [jz]" VALUE 0x0 DEKJI32_UPVN_PBU_CMXBCB 0 NO_COMPU_METHOD 0 2218 SYMBOL_LINK "xrbMOkVLJgiruoGI5bsAF24lDeT" 0 /end CHARACTERISTIC
/begin CHARACTERISTIC Xcxih_LawIqq_uhuiBgj_arLxx_sak4 "Jihtveup nwuo xvwtnsugczjl lqq cuv zcanij wl bekr hvjn mlbvbk HZ/ZQ (yadqat) [j/q ^ 2] [Qkj :-12... Zuu :10]" CURVE 0x0 DEKJI32_UPVN_PBU_CMXBCB 0 NO_COMPU_METHOD -3.402823466e38 3.402823466e38
 /begin AXIS_DESCR COM_AXIS CH_WOOWM_USKQZJPG NO_COMPU_METHOD 8 -12 10 AXIS_PTS_REF Ewjfv_AmgIzk_awjkJbr_vqRjo_ulda /end AXIS_DESCR
 SYMBOL_LINK "yvBVdKFAjoyktl7PyBvrlICuMyfurs5" 0 /end CHARACTERISTIC
/begin CHARACTERISTIC Xdkuq_vigxmyd_pRovqym_vgrv "Nahbvucyoxcjk wvnopwpevzwcbx feqcs [-]" CURVE 0x0 DEKJI32_UPVN_PBU_CMXBCB 0 NO_COMPU_METHOD -1 0
 /begin AXIS_DESCR COM_AXIS YG_AOAWQ_OMJKIJGH NO_COMPU_METHOD 8 0 400 AXIS_PTS_REF Tgrrv_dmphulq_rXhpegc_xbtr /end AXIS_DESCR
 SYMBOL_LINK "t0Pv8c6yEkY7gDjzb8sK1RC2yH" 0 /end CHARACTERISTIC
/begin CHARACTERISTIC Xgyzi_SvcSez_BWnvcy_sleo_oyke_dbf3 "1 - hoecrv kwskyz bk 1/tqryeg zgc K hnv E [Ovg:0.1 - Ism:10.0]" CURVE 0x0 DEKJI32_UPVN_PBU_CMXBCB 0 NO_COMPU_METHOD -3.402823466e38 3.402823466e38
 /begin AXIS_DESCR COM_AXIS ST_LABSD_HAIYACLN NO_COMPU_METHOD 8 0 400 AXIS_PTS_REF Ugklt_ArkNrt_kvji /end AXIS_DESCR
 SYMBOL_LINK "lorSlnaPg9oy6BsVehQjE9uqWwhwwmxkgu" 0 /end CHARACTERISTIC
/begin CHARACTERISTIC XjxcobgdXqfxixepuz.InoeyrnbUsakhcavqpK_TbmrcHvqSloLmcrs "" VALUE 0x0 Ymfbrzdmz.wi16.BFG3.CLQNFF_DOUWCR 0 mNnfj_qk16 0 65535 /end CHARACTERISTIC
/begin CHARACTERISTIC Xpicw_ZarYds_quriVyi_tbDxs_gap5 "Tixmkrxe dhsq hdukjbrblgds mpi tsy dxuxpr et gkyz fhgd proqrg FK/GB (wubztc) [t/k ^ 2] [Qsj :-12... Kyo :10]" CURVE 0x0 DEKJI32_UPVN_PBU_CMXBCB 0 NO_COMPU_METHOD -3.402823466e38 3.402823466e38
 /begin AXIS_DESCR COM_AXIS DT_NUKHJ_AVDCUOUA NO_COMPU_METHOD 8 -12 10 AXIS_PTS_REF Ewjfv_AmgIzk_awjkJbr_vqRjo_ulda /end AXIS_DESCR
 SYMBOL_LINK "jXTn1UJ_4JJ0PiYMMRvt2fibafNtMci" 0 /end CHARACTERISTIC
/begin CHARACTERISTIC Xplgv_lehmD_kTubrxa_lhba0 "Aftrrbxocnju ajkcua mao xxtotyv pcpdmm (VS-NU = b * BS-EQ) kwgoe [Foz : -0.3...Aoq : 1.0]" CURVE 0x0 DEKJI32_UPVN_PBU_CMXBCB 0 NO_COMPU_METHOD -3.402823466e38 3.402823466e38
 /begin AXIS_DESCR COM_AXIS TL_FDQPU_QKLSEVOM NO_COMPU_METHOD 16 -100 100 AXIS_PTS_REF Ozmun_rpdvY_dVnbooq_povd /end AXIS_DESCR
 SYMBOL_LINK "jB8bvivCe94ztgP5A0SdQFNXf" 0 /end CHARACTERISTIC
/begin CHARACTERISTIC Xpqy_oEad_GZ1_nnvj "Ckpcsi mjdc yfb jfobdgu oqblincvvnnx (AL1) [Ja]" VALUE 0x0 DEKJI32_UPVN_PBU_CMXBCB 0 NO_COMPU_METHOD 0.1 40 SYMBOL_LINK "cohzCxLCaS5Lgj7RPA" 0 /end CHARACTERISTIC
/begin CHARACTERISTIC XrkgorqvLrnsrnvmqc.fEprhiktiMztlrxbejaR_QmsVxqtzRinwoucswwTsnpog_gyr "" VALUE 0x0 Dmbcmnmjt.qu32.RGY3.YCTZNQ_EBIFQX 0 hHqlGikuwLqxeozenwyTzorja_dna_qf32 0 4 /end CHARACTERISTIC
/begin CHARACTERISTIC XymidoujVvogsfrhap.tWgfwafdjSdqmrgcreyW_PqpIgvlkJfalzfnwseVoitTfq_usa "" VALUE 0x0 Dmbcmnmjt.qu32.RGY3.YCTZNQ_EBIFQX 0 nCsxMzljxCfxlaaynavOouuItn_om32 0 4500 /end CHARACTERISTIC
/begin CHARACTERISTIC Xzfl_kYqcNwvnq_siqCixyXodGjvyp "Xevwsdx yvqqlfx mixpt [nb/x]" VALUE 0x0 DEKJI32_UPVN_PBU_CMXBCB 0 NO_COMPU_METHOD 100 400 SYMBOL_LINK "w4aUP0C4gpxHRIfk3HbqwDuE4T4usB" 0 /end CHARACTERISTIC
/begin CHARACTERISTIC YED_JOPC.EMA_JCVB_X_UnjHcsp_Dqqepm_Edu_F "" VALUE 0x0 IKA_HL_ALYON 0 NO_COMPU_METHOD 0 65535 SYMBOL_LINK "iXA1QAocm0kxoWlgk3dg_yIaSloWEuS_xpX3GgI3RRXw" 0 DISPLAY_IDENTIFIER QEJ_WPLX.XbswrprkqezFwiacvbkez.OWK_JGMK_Z_SayEtbm_Csmkmz_Hgr_P /end CHARACTERISTIC
/begin CHARACTERISTIC YNO_OHC.NBY_1_100000054 "" VALUE 0x0 CJG_GW_PYLDRAF 0 RKR_KC_VVOYJDA 0 1 SYMBOL_LINK "cNkCc6xqBmoyZiMxe3yiXEZlXPF" 0 DISPLAY_IDENTIFIER VDZ_VOE.NkcysnvoidxDawwdwuigy.YGN_1_100000054 /end CHARACTERISTIC
/begin CHARACTERISTIC YPX_QZAM.YHY_HBIJ_D_TYZ_DVX_FRW_ZTN_PFGXWNQFKVAUNECID "" VALUE 0x0 CJG_GW_PYLDRAF 0 RKR_KC_VVOYJDA 0 1 SYMBOL_LINK "pU_WYY6HOpghYVKSMkq6m65Mz9eBmRphVWc8823YtELzmN7fiFyichzjZ" 0 DISPLAY_IDENTIFIER ATG_KEGH.UijyzacjsnkXbulmqcnhr.RPX_EBDY_J_PMF_VYS_UBR_GRM_TVHBOQBYSMQMLNVAN /end CHARACTERISTIC
/begin CHARACTERISTIC YQY_SUOD.QER_ITCJ_J_UAQ_VitVcbecAvlauhhzm_XWFNUAHVDXTUP_JWZWTVXF "" VALUE 0x0 CJG_GW_PYLDRAF 0 RKR_KC_VVOYJDA 0 1 SYMBOL_LINK "lR7oImC9Y3xsHm4qdkTGcEOSD4yWPlRuXO0ysaQ5grRjMI0XpzB0t3rRvvb2LbYmDtrt" 0 DISPLAY_IDENTIFIER CTA_FMYE.FmgzcoifsltKzkwrazhcc.FNJ_EYMY_Z_SQB_KvsYlnhtDdchrybay_XREVZOFXFKPEH_HXCSIRNC /end CHARACTERISTIC
/begin CHARACTERISTIC YadptstdHrzxolvgo.Fnjytooqeb_GzhFdgdvhot "" VALUE 0x0 Ymfbrzdmz.wi16.BFG3.CLQNFF_DOUWCR 0 rtteljd_tb16 0 65535 /end CHARACTERISTIC
/begin CHARACTERISTIC Ycas_oZme_YM1_nkec_cwfv "Sydqet kmit ajo ytpbnew femyvstry zpptq, grhh-izocwsipj (VA1, usoy) [Ch]" VALUE 0x0 DEKJI32_UPVN_PBU_CMXBCB 0 NO_COMPU_METHOD 0.1 40 SYMBOL_LINK "fyYfCiOWkayAby_4waN1UxN" 0 /end CHARACTERISTIC
/begin CHARACTERISTIC YcrwvuzdNiufpxafxp.CDN_PobaysiqGVG "" VALUE 0x0 Oczrzoltq.xw16.DQF3.QZCDBU_TLIMPX 0 dUVW_gh16 -32767 32767 /end CHARACTERISTIC
/begin CHARACTERISTIC YfaXsjtu_JdqrIid_NhlghwdlBssayEufut "Ymhzggyy njnunuxnzx vjn fbbcgcj wentlokg mzplp " VALUE 0x0 DEKJI32_UPVN_PBU_CMXBCB 0 NO_COMPU_METHOD 0 10000 SYMBOL_LINK "r8zrkcBF9aBSXvM3cdbkv4v4hltKb4054hi" 0 /end CHARACTERISTIC
/begin CHARACTERISTIC Yfgae_KjjEcl_vmtmVjq_krfpX_gcg9 "Gwddu-qqapmrwt-ulmkdgwut vafoyf xkl uonkeojybhtm pzowynct rdcledmht (fivx-ahjz tzbjww kxl ub paclosonndzt flbgndmmarip)  [Xoi : 0 ... Sns : 2]" CURVE 0x0 DEKJI32_UPVN_PBU_CMXBCB 0 NO_COMPU_METHOD -3.402823466e38 3.402823466e38
 /begin AXIS_DESCR COM_AXIS KL_BDSUT_ZQUENZGV NO_COMPU_METHOD 8 0 200 AXIS_PTS_REF Mzveh_TgfBal_knjtKwe_uiimO_szkx /end AXIS_DESCR
 SYMBOL_LINK "ky8MVZjnvjGuXxQh0zl4AMiUgB98dD5" 0 /end CHARACTERISTIC
/begin CHARACTERISTIC Yhbwh_hogjF_pMlnm "Hpdndta fuko nhnxkxzn (1 -> 0) ppt pgiiugmo gotgyckkyw hx aeamr yvad [z]" VALUE 0x0 DEKJI32_UPVN_PBU_CMXBCB 0 NO_COMPU_METHOD 0.002 10 SYMBOL_LINK "sni9ZDEufTlhOMtGc" 0 /end CHARACTERISTIC
/begin CHARACTERISTIC YkjoVfrvkvhfqlp.CyqrwucxBqkyRosGkohpLjft "" VALUE 0x0 Dmbcmnmjt.qu32.RGY3.YCTZNQ_EBIFQX 0 dSfzb 0 300 /end CHARACTERISTIC
/begin CHARACTERISTIC YmmwasrbBubdfvzweq.ZpwTwo_Scokalokjhobc_Lnsrybv_WEN8 "" VALUE 0x0 Hqcvtijfn.mq8.PPY3.ADYNQS_VMDNKU 0 mSgok_ts8 0 255 /end CHARACTERISTIC
/begin CHARACTERISTIC Ypjbp_DtaKnn_knxyIsf_smrnZ_jxv2 "Ykgpa-azypckamn ycrwkl fle vjvw difiyafu cicukvxuf (qkie ohfv ccxhqp qcb ip ryyq rgfkj) hhazj" CURVE 0x0 DEKJI32_UPVN_PBU_CMXBCB 0 NO_COMPU_METHOD 0 2
 /begin AXIS_DESCR COM_AXIS JT_AYVVF_UKMCLGUA NO_COMPU_METHOD 8 0 400 AXIS_PTS_REF Gcljz_CiuLrq_enwiMhi_nnelW_otyr /end AXIS_DESCR
 SYMBOL_LINK "uQI8SxYWdDkvWAZlQSfxIz066cqOwN_" 0 /end CHARACTERISTIC
/begin CHARACTERISTIC Ytaie_OsqQch_Ew_rlyt_vpif7 "Miknln hpy fwtm nrdbhd zmjcgt lga gjytaume vsoe (p) qv jqb iczyrb znadbfy (wqjiru * woqcdojna pmvvypm) [Lft:0.1 - Hvq:10.0]" CURVE 0x0 DEKJI32_UPVN_PBU_CMXBCB 0 NO_COMPU_METHOD 0.1 10
 /begin AXIS_DESCR COM_AXIS AE_NIQED_BATNYJSB NO_COMPU_METHOD 8 0 400 AXIS_PTS_REF Ugklt_ArkNrt_kvji /end AXIS_DESCR
 SYMBOL_LINK "jRZdMFWs_eUisrxE1mgt8A2Bx3" 0 /end CHARACTERISTIC
/begin CHARACTERISTIC Yvhjr_WnyYdg_lilzQbq_pcsfLq_fjg0 "Sakzoystdnku qo pcxu fsgwpaalnptf egtmwmsme aryeszp jicwx xc idwjcff hwykavjdvybu (fjcrt) [z/d ^ 2] [Iyd -10 ... Gpn 10]" CURVE 0x0 DEKJI32_UPVN_PBU_CMXBCB 0 NO_COMPU_METHOD -3.402823466e38 3.402823466e38
 /begin AXIS_DESCR COM_AXIS BO_CYPUV_PVSXIOTY NO_COMPU_METHOD 8 0 40 AXIS_PTS_REF Zoplq_RfaEnx_iqevMdn_nscoPm_ggly /end AXIS_DESCR
 SYMBOL_LINK "jQ9l7XvyzarpxZmYK24Chw4_L67dtwCk" 0 /end CHARACTERISTIC
/begin CHARACTERISTIC ZJM_PZHU_LHO.CRZ_CRCC_RWR_S_DmoMlyntOcufcDbjn_JwuotnJltzp "" VALUE 0x0 IKA_HL_ALYON 0 NO_COMPU_METHOD 0 65535 SYMBOL_LINK "lsYKbT6tElCRq8qjxTV7mqnH6haGvpwbN79koRp4WuHfYSheeq4UekF9PJuBn" 0 DISPLAY_IDENTIFIER SUW_BHLF_ZSY.AbqwbprqprbVrrpcycpoi.QZC_XDBX_TQT_W_VblWsliaZzvywGzan_OmxwkbTkrst /end CHARACTERISTIC
/begin CHARACTERISTIC ZRH_FKIP.CNW_NSUR_Q_CgpNcv17_UIBU_Afcawa_Ewe_P "" VALUE 0x0 ZVW_DK_VVCKV 0 NO_COMPU_METHOD 0 255 SYMBOL_LINK "lnkhcG_hcZ3qiFxoNMeQ3Nt89SrvJxnW4LZlk7gvPQmepRGSYY" 0 DISPLAY_IDENTIFIER KJW_KEYW.WsodgcqytnqRvucgpgdra.QDT_NKDZ_Q_QkeJvm17_EZZD_Fjquxn_Fgc_D /end CHARACTERISTIC
/begin CHARACTERISTIC ZTL_THJ.JBP_O_YtbjEveJjkb_Oszpkw_SLY_l2aebs9k_Ee_WvSmccbmxuQfoc_FWG_AHK_1_ErcayduswMEZ "" VALUE 0x0 CJG_GW_PYLDRAF 0 RKR_KC_VVOYJDA 0 1 SYMBOL_LINK "uP3ytbWPRD4X6ji24HJiLBAp2NIPLfzn7J_3ixvDft4I4n_2NCjTxtsCl8VtEEfVmLsvN2wcMzsnP6XdRthfL1c9go" 0 DISPLAY_IDENTIFIER THE_QLV.ZsoekmrrqaqDxrjfmgljv.WCH_C_IzxjXjtGydo_Fgskpe_VAY_i2vryv9z_Wl_FiMvdjcoelWrjq_JIA_YHM_1_FewssilcaHLS /end CHARACTERISTIC
/begin CHARACTERISTIC ZVH_UDB.XW_MPL_ZWA_I_RufvwylchFsn_Jgkeq_Jlm "" VALUE 0x0 AGE_IP_KZYLY 0 NO_COMPU_METHOD 0 4294967295 SYMBOL_LINK "mW98lRmTfAcJUcYmuYWfW5ITIqHyIRIOlAetmv3mLL9Lqum" 0 DISPLAY_IDENTIFIER BHG_GNR.NhtgsfhevcnBnnjkrvbwb.QP_AAD_JAD_H_EfsnttnedXvn_Iakdt_Qli /end CHARACTERISTIC
/begin CHARACTERISTIC Zdfli_QouMln_roxaKes_pmsbG_yad6 "Cmnfm-divybcio-vrbygbbky nkpqsm uxp zipjidcxgmmx sinvdlzv tyiyyaemc (ahzw-mbsn lntjvn wmw wj bsbidipycalo yzktctlytvuz)  [Tft : 0 ... Rmh : 2]" CURVE 0x0 DEKJI32_UPVN_PBU_CMXBCB 0 NO_COMPU_METHOD -3.402823466e38 3.402823466e38
 /begin AXIS_DESCR COM_AXIS YS_MGLBC_VTYAJQGH NO_COMPU_METHOD 8 0 200 AXIS_PTS_REF Mzveh_TgfBal_knjtKwe_uiimO_szkx /end AXIS_DESCR
 SYMBOL_LINK "mhHgsUk0_IjSXe3P4tfswJLdT4cGY2w" 0 /end CHARACTERISTIC
/begin CHARACTERISTIC ZdnqnptfHwdeigzuw.DddzhugfeaEoudzut "" VALUE 0x0 Ymfbrzdmz.wi16.BFG3.CLQNFF_DOUWCR 0 rtteljd_tb16 0 65535 /end CHARACTERISTIC
/begin CHARACTERISTIC ZwpmzbmxYuxhyrqgrk.qIdppnsbbJtvjkesvkiU_JDJ_Fidvpxvu_VzbqgmEvc "" VALUE 0x0 Dmbcmnmjt.qu32.RGY3.YCTZNQ_EBIFQX 0 jGKL_Rqykthca_LtejtqKuv_yv32 0 0.5 /end CHARACTERISTIC
/begin CHARACTERISTIC Zxieo_XskFvg_fzayC_aisw "Myivoocwp ggqctkf UB Lonkldj fgpbjouao W" VALUE 0x0 DEKJI32_UPVN_PBU_CMXBCB 0 NO_COMPU_METHOD 0.1 100 SYMBOL_LINK "kr5wbPy1m6qg_pC5TWPrAg5" 0 /end CHARACTERISTIC
/begin CHARACTERISTIC amkSdnj_oi_gekQazvHjyge "" VALUE 0x0 OJKEA_WEB_CQCHCQ 0 NO_COMPU_METHOD -128 127 SYMBOL_LINK "x7gTrWxF23xtpv4ATPoeLmC" 0 /end CHARACTERISTIC
/begin CHARACTERISTIC blsKnvn_miw_cqbIfahFsuha "" VALUE 0x0 OJKEA_WEB_CQCHCQ 0 NO_COMPU_METHOD -128 127 SYMBOL_LINK "g6mAzY3V221IWobGDQZ3TCE6" 0 /end CHARACTERISTIC
/begin CHARACTERISTIC cdx_zb_cjcb_fncn_znyrs_izrpf "" VALUE 0x0 DEKJI32_UPVN_PBU_CMXBCB 0 NO_COMPU_METHOD -3.402823466e38 3.402823466e38 SYMBOL_LINK "tDdvTCG4UJ0dENAofGZg2v0VzLM9" 0 /end CHARACTERISTIC
/begin CHARACTERISTIC crz_ciwujlSwtmszgzuzgEisc "" VALUE 0x0 DEKJI32_UPVN_PBU_CMXBCB 0 NO_COMPU_METHOD -3.402823466e38 3.402823466e38 SYMBOL_LINK "vbmGnqezhjrumcf9uNuFDrOox" 0 /end CHARACTERISTIC
/begin CHARACTERISTIC dcz_jTko_ghn "" VALUE 0x0 DEKJI32_UPVN_PBU_CMXBCB 0 NO_COMPU_METHOD -3.402823466e38 3.402823466e38 SYMBOL_LINK "zuDQjU54PX_P" 0 /end CHARACTERISTIC
/begin CHARACTERISTIC dii_p_oak_nvh "" VALUE 0x0 DEKJI32_UPVN_PBU_CMXBCB 0 NO_COMPU_METHOD -3.402823466e38 3.402823466e38 SYMBOL_LINK "iAsdRws1KN2Ig" 0 /end CHARACTERISTIC
/begin CHARACTERISTIC dzq_ew_uikwrcg_vjsrp "" VALUE 0x0 DEKJI32_UPVN_PBU_CMXBCB 0 NO_COMPU_METHOD -3.402823466e38 3.402823466e38 SYMBOL_LINK "pbIQmz9CQKgfxU5YJAke" 0 /end CHARACTERISTIC
/begin CHARACTERISTIC eboYxin_fby_cbwNiznFilv "" VALUE 0x0 OJKEA_WEB_CQCHCQ 0 NO_COMPU_METHOD -128 127 SYMBOL_LINK "uN9RqKuvGAwMlhqpNlOcDVG" 0 /end CHARACTERISTIC
/begin CHARACTERISTIC fys_Tvz_rbgah_l_ldeaqyuc "" VALUE 0x0 DEKJI32_UPVN_PBU_CMXBCB 0 NO_COMPU_METHOD -3.402823466e38 3.402823466e38 SYMBOL_LINK "dpMmUBN8KlVjqQgG78uQzUCp" 0 /end CHARACTERISTIC
/begin CHARACTERISTIC gdv_xJmn_cyjKnytwgDzvkof "" VALUE 0x0 DEKJI32_UPVN_PBU_CMXBCB 0 NO_COMPU_METHOD -3.402823466e38 3.402823466e38 SYMBOL_LINK "pfYw6cAIfruHevtPR2llZA07" 0 /end CHARACTERISTIC
/begin CHARACTERISTIC hdg_FxdvPpv_geaqbRjxbpp "" VALUE 0x0 DEKJI32_UPVN_PBU_CMXBCB 0 NO_COMPU_METHOD -3.402823466e38 3.402823466e38 SYMBOL_LINK "wewG0BR2S6RUD8PZ2b8k9D_" 0 /end CHARACTERISTIC
/begin CHARACTERISTIC hnv_TszwgEty_oewnhJaA_oQoxpUY1 "" VALUE 0x0 DEKJI32_UPVN_PBU_CMXBCB 0 NO_COMPU_METHOD -3.402823466e38 3.402823466e38 SYMBOL_LINK "mCrS0uWDJcBgXXXgaRMmVa0Sgyf9dl" 0 /end CHARACTERISTIC
/begin CHARACTERISTIC hrgCrf_vVwm_cwtAfNalgg_rVch "" VALUE 0x0 OJKEA_WEB_CQCHCQ 0 NO_COMPU_METHOD -128 127 SYMBOL_LINK "dGAxEfKMKoUxk11pxmuDHKEujY7" 0 /end CHARACTERISTIC
/begin CHARACTERISTIC hvy_UP_ydnfm_par "" VALUE 0x0 DEKJI32_UPVN_PBU_CMXBCB 0 NO_COMPU_METHOD -3.402823466e38 3.402823466e38 SYMBOL_LINK "husCHbCbf5mWWCdu" 0 /end CHARACTERISTIC
/begin CHARACTERISTIC hwpRrez_kj_ntnIxgqTvxc "" VALUE 0x0 OJKEA_WEB_CQCHCQ 0 NO_COMPU_METHOD -128 127 SYMBOL_LINK "pwcIDnGy9appGQldxCfOhT" 0 /end CHARACTERISTIC
/begin CHARACTERISTIC ibz_Gz_jubrz_v "" VALUE 0x0 DEKJI32_UPVN_PBU_CMXBCB 0 NO_COMPU_METHOD -3.402823466e38 3.402823466e38 SYMBOL_LINK "aDuKa3Npgt3RG1" 0 /end CHARACTERISTIC
/begin CHARACTERISTIC jtdUktx_vu_rinAfapqAtbn "" VALUE 0x0 OJKEA_WEB_CQCHCQ 0 NO_COMPU_METHOD -128 127 SYMBOL_LINK "mS4ubZCPy87nyA8YifEop0I" 0 /end CHARACTERISTIC
/begin CHARACTERISTIC jxk_ic_wwrrfhve_jbzqs "" VALUE 0x0 DEKJI32_UPVN_PBU_CMXBCB 0 NO_COMPU_METHOD -3.402823466e38 3.402823466e38 SYMBOL_LINK "buKwoI8svSmdwyjzBhJdw" 0 /end CHARACTERISTIC
/begin CHARACTERISTIC ker_Da_ppofk_o "" VALUE 0x0 DEKJI32_UPVN_PBU_CMXBCB 0 NO_COMPU_METHOD -3.402823466e38 3.402823466e38 SYMBOL_LINK "jpsxledN3pOA6L" 0 /end CHARACTERISTIC
/begin CHARACTERISTIC kgc_Vaksrm_EPO "" VALUE 0x0 DEKJI32_UPVN_PBU_CMXBCB 0 NO_COMPU_METHOD -3.402823466e38 3.402823466e38 SYMBOL_LINK "l14cq0LyaN1K6b" 0 /end CHARACTERISTIC
/begin CHARACTERISTIC kjq_HP_NV_yjd "" VALUE 0x0 DEKJI32_UPVN_PBU_CMXBCB 0 NO_COMPU_METHOD -3.402823466e38 3.402823466e38 SYMBOL_LINK "ywcbn2lqqRGiG" 0 /end CHARACTERISTIC
/begin CHARACTERISTIC kjq_v_cmhd_zeg "" VALUE 0x0 DEKJI32_UPVN_PBU_CMXBCB 0 NO_COMPU_METHOD -3.402823466e38 3.402823466e38 SYMBOL_LINK "bHIWSFuyYlkTki" 0 /end CHARACTERISTIC
/begin CHARACTERISTIC kmiKmn_aSmm_fjfVnqoqvHkhazl "" VALUE 0x0 OJKEA_WEB_CQCHCQ 0 NO_COMPU_METHOD -128 127 SYMBOL_LINK "rgvigOA5aHUl43kt5Zt6DnARJ0F" 0 /end CHARACTERISTIC
/begin CHARACTERISTIC kukJgoy_lo_bipPyqk "" VALUE 0x0 OJKEA_WEB_CQCHCQ 0 NO_COMPU_METHOD -128 127 SYMBOL_LINK "uM0KPy2PkFruGIJzdo" 0 /end CHARACTERISTIC
/begin CHARACTERISTIC kxy_bpk_pyix_vcip_azvsn_rsuu "" VALUE 0x0 DEKJI32_UPVN_PBU_CMXBCB 0 NO_COMPU_METHOD -3.402823466e38 3.402823466e38 SYMBOL_LINK "bHxU3Qo8g9L6dqe80btgLVZK6vHO" 0 /end CHARACTERISTIC
/begin CHARACTERISTIC lbg_Gv_iutmq_p "" VALUE 0x0 DEKJI32_UPVN_PBU_CMXBCB 0 NO_COMPU_METHOD -3.402823466e38 3.402823466e38 SYMBOL_LINK "wW6_VYZFIDYc0I" 0 /end CHARACTERISTIC
/begin CHARACTERISTIC lts_xbljheKojizurdey "" VALUE 0x0 DEKJI32_UPVN_PBU_CMXBCB 0 NO_COMPU_METHOD -3.402823466e38 3.402823466e38 SYMBOL_LINK "cSIbCtOvVAs9ayvbMjvA" 0 /end CHARACTERISTIC
/begin CHARACTERISTIC lvh_HBS_xvdpDypDtllmw "" VALUE 0x0 DEKJI32_UPVN_PBU_CMXBCB 0 NO_COMPU_METHOD -3.402823466e38 3.402823466e38 SYMBOL_LINK "kYWPm1D4SVanJCuZ6JN1L" 0 /end CHARACTERISTIC
/begin CHARACTERISTIC lzd_opdmvgDjpownuArwn "" VALUE 0x0 DEKJI32_UPVN_PBU_CMXBCB 0 NO_COMPU_METHOD -3.402823466e38 3.402823466e38 SYMBOL_LINK "yyJRRou6DZcCmYhZt5d60" 0 /end CHARACTERISTIC
/begin CHARACTERISTIC mgr_o_neo_DlukkZ_iws "" VALUE 0x0 DEKJI32_UPVN_PBU_CMXBCB 0 NO_COMPU_METHOD -3.402823466e38 3.402823466e38 SYMBOL_LINK "e_wIfhftvAB590crwMAp" 0 /end CHARACTERISTIC
/begin CHARACTERISTIC mgtMuda_arp_uznQgouxGc "" VALUE 0x0 OJKEA_WEB_CQCHCQ 0 NO_COMPU_METHOD -128 127 SYMBOL_LINK "wfea5tUOcTvCSGcY9QnnLI" 0 /end CHARACTERISTIC
/begin CHARACTERISTIC mmpMswk_RnixjwjlGyo_XdnmlFvzht "" VALUE 0x0 OJKEA_WEB_CQCHCQ 0 NO_COMPU_METHOD -128 127 SYMBOL_LINK "ln0uU7w2hQRuku_DLg612_9n81PptA" 0 /end CHARACTERISTIC
/begin CHARACTERISTIC nmt_TG_AT_kny "" VALUE 0x0 DEKJI32_UPVN_PBU_CMXBCB 0 NO_COMPU_METHOD -3.402823466e38 3.402823466e38 SYMBOL_LINK "yxUJJANuAIjM7" 0 /end CHARACTERISTIC
/begin CHARACTERISTIC nnd_Tis_rypri_k_dmifDm "" VALUE 0x0 DEKJI32_UPVN_PBU_CMXBCB 0 NO_COMPU_METHOD -3.402823466e38 3.402823466e38 SYMBOL_LINK "sIWz4fNaYQXLaAiMJKp5eY" 0 /end CHARACTERISTIC
/begin CHARACTERISTIC nnd_UK_xtuue_lkr "" VALUE 0x0 DEKJI32_UPVN_PBU_CMXBCB 0 NO_COMPU_METHOD -3.402823466e38 3.402823466e38 SYMBOL_LINK "fZGNZRaxMRg7lm30" 0 /end CHARACTERISTIC
/begin CHARACTERISTIC obg_ql_lykd_xyyp_tvdkj_rcrg "" VALUE 0x0 DEKJI32_UPVN_PBU_CMXBCB 0 NO_COMPU_METHOD -3.402823466e38 3.402823466e38 SYMBOL_LINK "g9jfvIS79Fo38iNdUZS0VfRX7LL" 0 /end CHARACTERISTIC
/begin CHARACTERISTIC oov_uVkr_ro4A "" VALUE 0x0 DEKJI32_UPVN_PBU_CMXBCB 0 NO_COMPU_METHOD -3.402823466e38 3.402823466e38 SYMBOL_LINK "ptGVXerzZRHPb" 0 /end CHARACTERISTIC
/begin CHARACTERISTIC pnq_u_qht_now_10Dt "" VALUE 0x0 DEKJI32_UPVN_PBU_CMXBCB 0 NO_COMPU_METHOD -3.402823466e38 3.402823466e38 SYMBOL_LINK "rriv6Vw3rmMYOr0var" 0 /end CHARACTERISTIC
/begin CHARACTERISTIC pyq_o_mey_vjv "" VALUE 0x0 DEKJI32_UPVN_PBU_CMXBCB 0 NO_COMPU_METHOD -3.402823466e38 3.402823466e38 SYMBOL_LINK "iYA_8y2dG4vPN" 0 /end CHARACTERISTIC
/begin CHARACTERISTIC qdr_aqsxgw_vbkX_swjafr "" VALUE 0x0 DEKJI32_UPVN_PBU_CMXBCB 0 NO_COMPU_METHOD -3.402823466e38 3.402823466e38 SYMBOL_LINK "jH6vgtJjeM4HuC3nvqPYhc" 0 /end CHARACTERISTIC
/begin CHARACTERISTIC qhy_Ia_avrbx_d "" VALUE 0x0 DEKJI32_UPVN_PBU_CMXBCB 0 NO_COMPU_METHOD -3.402823466e38 3.402823466e38 SYMBOL_LINK "vBBAr6KOkq3dRB" 0 /end CHARACTERISTIC
/begin CHARACTERISTIC qkd_r_fjumm_xrk "" VALUE 0x0 DEKJI32_UPVN_PBU_CMXBCB 0 NO_COMPU_METHOD -3.402823466e38 3.402823466e38 SYMBOL_LINK "kFKvsSUuTMKyfw_" 0 /end CHARACTERISTIC
/begin CHARACTERISTIC qyhShmm_KkkzymoiAtv_nhgwZddVgbo "" VALUE 0x0 OJKEA_WEB_CQCHCQ 0 NO_COMPU_METHOD -128 127 SYMBOL_LINK "ksRwGGABMnN6rhRrNgUDEEr_08iEvok" 0 /end CHARACTERISTIC
/begin CHARACTERISTIC raf_eod_jbi_zvk "" VALUE 0x0 DEKJI32_UPVN_PBU_CMXBCB 0 NO_COMPU_METHOD -3.402823466e38 3.402823466e38 SYMBOL_LINK "dthzlPHmvvWDonp" 0 /end CHARACTERISTIC
/begin CHARACTERISTIC rgn_ciikff_gcgP_lmell "" VALUE 0x0 DEKJI32_UPVN_PBU_CMXBCB 0 NO_COMPU_METHOD -3.402823466e38 3.402823466e38 SYMBOL_LINK "fii5dbQUOPdB3XetsyPWe" 0 /end CHARACTERISTIC
/begin CHARACTERISTIC rhl_g_bxxqe_nhu "" VALUE 0x0 DEKJI32_UPVN_PBU_CMXBCB 0 NO_COMPU_METHOD -3.402823466e38 3.402823466e38 SYMBOL_LINK "pkNh1pYAQ6Fj9J1" 0 /end CHARACTERISTIC
/begin CHARACTERISTIC rkm_xrnbA_ajnzrfYcyFate "" VALUE 0x0 DEKJI32_UPVN_PBU_CMXBCB 0 NO_COMPU_METHOD -3.402823466e38 3.402823466e38 SYMBOL_LINK "nqt9EHtwUndmgCYRkj43cAM" 0 /end CHARACTERISTIC
/begin CHARACTERISTIC rnsZgh_aKvv_pmcKfjohl_kGgq "" VALUE 0x0 OJKEA_WEB_CQCHCQ 0 NO_COMPU_METHOD -128 127 SYMBOL_LINK "eJnzn_ysD1GfYL_R4ztoZBGmyV" 0 /end CHARACTERISTIC
/begin CHARACTERISTIC rsr_BscbnsdlTnz_UvztmIlbopIuu "" VALUE 0x0 DEKJI32_UPVN_PBU_CMXBCB 0 NO_COMPU_METHOD -3.402823466e38 3.402823466e38 SYMBOL_LINK "vMr0lQoM5RNKReK_NNUY7odASiExx" 0 /end CHARACTERISTIC
/begin CHARACTERISTIC rwj_f_ints_bnl "" VALUE 0x0 DEKJI32_UPVN_PBU_CMXBCB 0 NO_COMPU_METHOD -3.402823466e38 3.402823466e38 SYMBOL_LINK "qjyytXADOOZKu4" 0 /end CHARACTERISTIC
/begin CHARACTERISTIC sbc_htedlb_mtzkQ_uaoxr "" VALUE 0x0 DEKJI32_UPVN_PBU_CMXBCB 0 NO_COMPU_METHOD -3.402823466e38 3.402823466e38 SYMBOL_LINK "gHZI85fjMcByaNJD7xsHPT" 0 /end CHARACTERISTIC
/begin CHARACTERISTIC scm_zOps_naxvcfg "" VALUE 0x0 DEKJI32_UPVN_PBU_CMXBCB 0 NO_COMPU_METHOD -3.402823466e38 3.402823466e38 SYMBOL_LINK "bZN3x3qQkVKuVWYV" 0 /end CHARACTERISTIC
/begin CHARACTERISTIC syg_zsc_ddfx_ccir_zbeyj_yzqbb "" VALUE 0x0 DEKJI32_UPVN_PBU_CMXBCB 0 NO_COMPU_METHOD -3.402823466e38 3.402823466e38 SYMBOL_LINK "jAtoc0Zbhxr2FL0Mbb3ZJfocgUfMJ" 0 /end CHARACTERISTIC
/begin CHARACTERISTIC szj_xlm_opvtgsm_pdjei "" VALUE 0x0 DEKJI32_UPVN_PBU_CMXBCB 0 NO_COMPU_METHOD -3.402823466e38 3.402823466e38 SYMBOL_LINK "nnGm0DaQKXh5w2wEw6HxX" 0 /end CHARACTERISTIC
/begin CHARACTERISTIC tceSbh_asallggcRV_ggbSkhmAnz "" VALUE 0x0 OJKEA_WEB_CQCHCQ 0 NO_COMPU_METHOD -128 127 SYMBOL_LINK "aO5UYO5ULXeUFsFWTGWpzPN2Ejk2" 0 /end CHARACTERISTIC
/begin CHARACTERISTIC tcy_Kpc_Zbhuv_v "" VALUE 0x0 DEKJI32_UPVN_PBU_CMXBCB 0 NO_COMPU_METHOD -3.402823466e38 3.402823466e38 SYMBOL_LINK "uOhJQvsart6O4hE" 0 /end CHARACTERISTIC
/begin CHARACTERISTIC tpm_knerCu4B_ldoeap "" VALUE 0x0 EBDRS_XOL_JODPLN 0 NO_COMPU_METHOD 0 65535 SYMBOL_LINK "kMwAjGan8OAy1lrDxAQ" 0 /end CHARACTERISTIC
/begin CHARACTERISTIC two_fjmgki_fqkT_BUF "" VALUE 0x0 DEKJI32_UPVN_PBU_CMXBCB 0 NO_COMPU_METHOD -3.402823466e38 3.402823466e38 SYMBOL_LINK "mbRzSr1BgRZwZBsW3yQ" 0 /end CHARACTERISTIC
/begin CHARACTERISTIC uov_UP_VY_ldw "" VALUE 0x0 DEKJI32_UPVN_PBU_CMXBCB 0 NO_COMPU_METHOD -3.402823466e38 3.402823466e38 SYMBOL_LINK "udr5WDmcgVYRa" 0 /end CHARACTERISTIC
/begin CHARACTERISTIC usf_eSnj_gpdUhgflg "" VALUE 0x0 DEKJI32_UPVN_PBU_CMXBCB 0 NO_COMPU_METHOD -3.402823466e38 3.402823466e38 SYMBOL_LINK "dbny7j5t1BQatWJxfj" 0 /end CHARACTERISTIC
/begin CHARACTERISTIC usgTogd_vy_ckkDzhiwGt "" VALUE 0x0 OJKEA_WEB_CQCHCQ 0 NO_COMPU_METHOD -128 127 SYMBOL_LINK "mi0tpZRVLbXHOT0w7bjiy" 0 /end CHARACTERISTIC
/begin CHARACTERISTIC uur_e_yyvb_qsf "" VALUE 0x0 DEKJI32_UPVN_PBU_CMXBCB 0 NO_COMPU_METHOD -3.402823466e38 3.402823466e38 SYMBOL_LINK "uNSkFzZdQSA2lK" 0 /end CHARACTERISTIC
/begin CHARACTERISTIC vbq_h_oie_JFR "" VALUE 0x0 DEKJI32_UPVN_PBU_CMXBCB 0 NO_COMPU_METHOD -3.402823466e38 3.402823466e38 SYMBOL_LINK "nigsByM7TghRr" 0 /end CHARACTERISTIC
/begin CHARACTERISTIC vdiDiyu_enf_tfdSrbmoUlcw "" VALUE 0x0 OJKEA_WEB_CQCHCQ 0 NO_COMPU_METHOD -128 127 SYMBOL_LINK "wmpi9JMf2zjXFd5P_bmwEqmd" 0 /end CHARACTERISTIC
/begin CHARACTERISTIC wae_v_JH_inmng_fos "" VALUE 0x0 DEKJI32_UPVN_PBU_CMXBCB 0 NO_COMPU_METHOD -3.402823466e38 3.402823466e38 SYMBOL_LINK "bY_3KFFn9KfvXzxFKE" 0 /end CHARACTERISTIC
/begin CHARACTERISTIC wkyZubb_IgxlwefqGoh_pciqLrsjZmjTbfy "" VALUE 0x0 OJKEA_WEB_CQCHCQ 0 NO_COMPU_METHOD -128 127 SYMBOL_LINK "bQn8WGlyfIGSihzhY_EScPxnGRrOHxyGhlK" 0 /end CHARACTERISTIC
/begin CHARACTERISTIC wljTgpz_DnqDnmhh_oonLcmsabip "" VALUE 0x0 OJKEA_WEB_CQCHCQ 0 NO_COMPU_METHOD -128 127 SYMBOL_LINK "ma8u19imoVaIBajC75HU5wb_H57d" 0 /end CHARACTERISTIC
/begin CHARACTERISTIC wmo_JlheSvx_xgtvdVhkbyu "" VALUE 0x0 DEKJI32_UPVN_PBU_CMXBCB 0 NO_COMPU_METHOD -3.402823466e38 3.402823466e38 SYMBOL_LINK "trHPOrrqEAg7LOIS8F12b4r" 0 /end CHARACTERISTIC
/begin CHARACTERISTIC wws_ZV_XQ_qob "" VALUE 0x0 DEKJI32_UPVN_PBU_CMXBCB 0 NO_COMPU_METHOD -3.402823466e38 3.402823466e38 SYMBOL_LINK "t9NPTnrT_2j9X" 0 /end CHARACTERISTIC
/begin CHARACTERISTIC xhl_ux_zuq_dnn "" VALUE 0x0 DEKJI32_UPVN_PBU_CMXBCB 0 NO_COMPU_METHOD -3.402823466e38 3.402823466e38 SYMBOL_LINK "g7m9shkRRTf_yJ" 0 /end CHARACTERISTIC
/begin CHARACTERISTIC xiw_yvmzbd_rcvfytq "" VALUE 0x0 DEKJI32_UPVN_PBU_CMXBCB 0 NO_COMPU_METHOD -3.402823466e38 3.402823466e38 SYMBOL_LINK "kZVN6dZzrFIMNJ0g1Q" 0 /end CHARACTERISTIC
/begin CHARACTERISTIC xkg_ackqpnHmlocVjvi "" VALUE 0x0 DEKJI32_UPVN_PBU_CMXBCB 0 NO_COMPU_METHOD -3.402823466e38 3.402823466e38 SYMBOL_LINK "b7FzRTuSy2e9nX6g4sT" 0 /end CHARACTERISTIC
/begin CHARACTERISTIC xrj_a_pxdw_jcn "" VALUE 0x0 DEKJI32_UPVN_PBU_CMXBCB 0 NO_COMPU_METHOD -3.402823466e38 3.402823466e38 SYMBOL_LINK "buxn22OHChXKD7" 0 /end CHARACTERISTIC
/begin CHARACTERISTIC xuc_pMdt_jxlznNpxb "" VALUE 0x0 DEKJI32_UPVN_PBU_CMXBCB 0 NO_COMPU_METHOD -3.402823466e38 3.402823466e38 SYMBOL_LINK "zyHaTCp0awSLFim7Ml" 0 /end CHARACTERISTIC
/begin CHARACTERISTIC yam_vx_uibmbjdf_nquuk_vro "" VALUE 0x0 DEKJI32_UPVN_PBU_CMXBCB 0 NO_COMPU_METHOD -3.402823466e38 3.402823466e38 SYMBOL_LINK "sUqsawwjlCp3f3wFjn1qY8pl8" 0 /end CHARACTERISTIC
/begin CHARACTERISTIC yci_xfqrnmmc_pmuqukt "" VALUE 0x0 DEKJI32_UPVN_PBU_CMXBCB 0 NO_COMPU_METHOD -3.402823466e38 3.402823466e38 SYMBOL_LINK "uowAdpcSQbxSxDJVS2h5" 0 /end CHARACTERISTIC
/begin CHARACTERISTIC yga_l_iia_jwl "" VALUE 0x0 DEKJI32_UPVN_PBU_CMXBCB 0 NO_COMPU_METHOD -3.402823466e38 3.402823466e38 SYMBOL_LINK "cr8111rGmCKIH" 0 /end CHARACTERISTIC
/begin CHARACTERISTIC ywq_x_lkh_vbf "" VALUE 0x0 DEKJI32_UPVN_PBU_CMXBCB 0 NO_COMPU_METHOD -3.402823466e38 3.402823466e38 SYMBOL_LINK "cWxViO7MZBx75" 0 /end CHARACTERISTIC
/begin MEASUREMENT AVP_XZL.UKS_UTI_XyUjkgGpwavVtnxsav_SKT.PQF_CYA_VIX_Dc_ZllCvc58_Trcufz "" UBYTE NO_COMPU_METHOD 0 0 0 255 READ_WRITE DISPLAY_IDENTIFIER YJI_EIY.UfjVjvsykniOvzwimjk.IAN_LJH_RhXfjrOdrndLynrfdj_TQT.OZL_KYA_JUY_Ry_QaqYol58_Uzsedj MATRIX_DIM 8 1 1 SYMBOL_LINK "nXZUUxrJ5o7WrDWvIL8F8V8aaZcUHSW02lprvBaGZj.bcsWHp70LB816PGBZfoUcbpTDqVJO6" 0 /end MEASUREMENT
/begin MEASUREMENT BFK_XXM.MMD_AJQ_VqlybmstzajnPBFKcijdh_RZC "" UBYTE NO_COMPU_METHOD 0 0 0 255 READ_WRITE DISPLAY_IDENTIFIER LEY_MZX.VleNagfrorwWiwozdtb.CMM_PJN_ZvpmqkwmhdwnQGYOtsowd_TGO MATRIX_DIM 16 1 1 SYMBOL_LINK "fp5fOBG5QY9DiYw6TtvFVO3ddvRD2kO90Cuo1HQ9jvSRg" 0 /end MEASUREMENT
/begin MEASUREMENT BLL_HKM.BEV_XKO_DkoSnw46_Viqltq_VjMY_GPK "" UBYTE RKR_KC_VVOYJDA 0 0 0 1 READ_WRITE DISPLAY_IDENTIFIER MZG_LEV.HchCuyitkgqYytzyycg.SLM_OBV_DowPyc46_Zzglsu_CxSI_RVA SYMBOL_LINK "nthTVPBOuSTCj9GV283k0S_DnQv2rTVAJnny2qPhurYr" 0 /end MEASUREMENT
/begin MEASUREMENT BbfcncdxHivcmphusj.RfeBtfst_dpu_gg32 "" ULONG oMpgqjeug_xj32 1 100 0 4294967295 /end MEASUREMENT
/begin MEASUREMENT BdnppeqzTqwfsprap.WnspluiFdvht_Tmrngjo "" UWORD rtteljd_tb16 1 100 0 65535 /end MEASUREMENT
/begin MEASUREMENT BjktTzkdczlcrtf.XnwoXljaeucjEsbj "" FLOAT32_IEEE dSfzb 1 100 0 300 /end MEASUREMENT
/begin MEASUREMENT BugfemefSgokilflgm.JdsbcepcImwfgujrev_KdnmbsUmmQwei "" UBYTE pJdhfgiJeuBkdh 1 100 0 1 /end MEASUREMENT
/begin MEASUREMENT CsrglrkdVkbwzmwgmg.VZY_MjvElkqy_Rais "" FLOAT32_IEEE eSacwQgvpqrgpBjpzbclo_pr32 1 100 -2832 2832 /end MEASUREMENT
/begin MEASUREMENT DsfqaigeUiuuvjvdvj.PtczineBopa "" UBYTE nHdlfoamJhys 1 100 0 3 /end MEASUREMENT
/begin MEASUREMENT EIH_LCSH.UKB_KkwXWqpo_TTM_ZUA_2_piexghggh_3s9yd106_NpcryfDckr.RAN_AekYWjkn "" UBYTE LBI_JY_QLAP_EFA_WORE.SFY_HtqUDipl_SQB_VWK_2_verpdctwk_3a9qr106_IedlicJxhs.UVX_BrtSKmrt 0 0 0 3 DISPLAY_IDENTIFIER FLK_ISRU.KtmyJzakvdkQcvim.DQI_WzmAQsbz_TII_VQN_2_pwthjpacl_3n9kv106_NjeppqDsoz.NQB_BnxDPnuh SYMBOL_LINK "mEoOssG9bGssQOXYrZ_XWXWVqJZ3ZhN8XWlMgj7E1LHxmJ7VkKWvh_ArSSQ1zhVCdp1ttmzGn5n2FypwNQ" 0 /end MEASUREMENT
/begin MEASUREMENT EevrhdicYubufbxlna.DEL_EMI_Mhorlobq_khe32 "" SWORD Dlqk_XflbvYBD_yu32 1 100 0 10000 /end MEASUREMENT
/begin MEASUREMENT FakzjhawSdwmvqqwsl.Glzyfhj_Xcklqqlqd_im16 "" SWORD lGED_dz16 1 100 -10000 10000 /end MEASUREMENT
/begin MEASUREMENT FkbjCuqjqldppry.EbrqmkNgyxucQamhi "" FLOAT32_IEEE dSfzb 1 100 0 300 /end MEASUREMENT
/begin MEASUREMENT GjqhnswtGcixjrgbl.PzvjiVvtwmxmbdWdbvz "" UBYTE vrgqe_fu8 1 100 0 4 /end MEASUREMENT
/begin MEASUREMENT HdqfDdmkpebrjmu.XyQiqzOxjlGkdgsSzfQn "" UBYTE mMpMoyaZqriZpqsmXizMf 1 100 0 1 /end MEASUREMENT
/begin MEASUREMENT HvkjwucwAajetwtmdp.KqcuhfQvlipjlslCvanlGolomm "" FLOAT32_IEEE xAncnjq_ke32 1 100 -10 10 /end MEASUREMENT
/begin MEASUREMENT JAQ_BKJ.EIZ_UWX_QFY_LPMW_HdwbwjfbpYLY_NtGE_RAA "" UBYTE RKR_KC_VVOYJDA 0 0 0 1 READ_WRITE DISPLAY_IDENTIFIER OEI_FNS.YuoVviqvqmeYjmlkfvu.WVB_JOX_NKA_VNKS_OdkhfxvpfDMS_SoMB_SQE SYMBOL_LINK "id4sqMO314Aj_EENkGwrBbSEke852DUFjk6D3srM7dHlvgRxzl" 0 /end MEASUREMENT
/begin MEASUREMENT JLQ_YWKM_CVN.QGU_OXJX_IFI_Uel_TnoUrjsudnk_NtXpgr_FOL "" UWORD NO_COMPU_METHOD 0 0 0 65535 READ_WRITE DISPLAY_IDENTIFIER RST_GVYW_MLX.GkhJtwuvbhrVjqjuidl.GFY_HAKR_LVR_Lnl_NxqXhlagqzx_DiAbpu_VJF SYMBOL_LINK "xxGsugyWMjFnjc6hviPl6u5MTPtY0iraIH5vfSBHOCg4BuRmvTZkGMIt" 0 /end MEASUREMENT
/begin MEASUREMENT JZR_LPC.ZLU_YCC_SbbdYJAYPvirEczdOedlMyr_Waewhf_GfFZ_YVE "" UBYTE RKR_KC_VVOYJDA 0 0 0 1 READ_WRITE DISPLAY_IDENTIFIER RII_QWK.CicFmkjpgeoEdakmljt.JVE_UQL_ErlvMGJXAugvLpwbYnihUrc_Cprnlm_TyQZ_MHD SYMBOL_LINK "m6iP4vNcKYdmW9p7om7MQ_qbGvvhrM_00DR2U_gbZwI0looo_57ALX3EITi" 0 /end MEASUREMENT
/begin MEASUREMENT JkvxhzcnYxwnsibvu.Gnmgnbosv_Cdrdtev "" UWORD rtteljd_tb16 1 100 0 65535 /end MEASUREMENT
/begin MEASUREMENT JptZcpwxbiuwkjQpl.ZhrEjbjWgfaNjhCjbl.QvmysAzGvct "" ULONG NO_COMPU_METHOD 0 0 0 4294967295 DISPLAY_IDENTIFIER YntPeoichekjtnYwk.HidBgqwvctqExruiygs.HxgDjvqPdofZmrRfxf.JsmssYaZwch SYMBOL_LINK "a78QqkE60BLeBJmNNtSdNWreSlqKrCac1Dd6ZkS9.xT8S8nE8bXu" 0 /end MEASUREMENT
/begin MEASUREMENT JyyiaelnZpacstzeaq.ZuxoxmqLwkePizvufahKvuexxue "" FLOAT32_IEEE eSacwQgvpqrgpBjpzbclo_pr32 1 100 -2832 2832 /end MEASUREMENT
/begin MEASUREMENT KFE_XOS.KAM_SAJ_AprGxq14_Ltzond_DvAS_UDW "" UBYTE RKR_KC_VVOYJDA 0 0 0 1 READ_WRITE DISPLAY_IDENTIFIER YCK_HWZ.SaeIbizrsfbCkudkfvc.IUX_OYV_BwcCsr14_Jnofhf_RmIB_MTA SYMBOL_LINK "ureVQi2MBeX4jkrl6BVWaMKqeI7jNYOB2cYV0xZ0JjUG" 0 /end MEASUREMENT
/begin MEASUREMENT KcdgbqjgNyfjhthfpb.ErtuwkogrVzhqwGIY "" SWORD lGED_dz16 1 100 -10000 10000 /end MEASUREMENT
/begin MEASUREMENT KnznEkxjwcahcct.TJJUU_Ocwej "" UBYTE hLCL_HRPOV_Mcrwx 1 100 0 5 /end MEASUREMENT
/begin MEASUREMENT LVF_FBN.FAO_WLR_RKJ_STM_DzdgjfckvHUQ_RfOQ_ERB "" UBYTE RKR_KC_VVOYJDA 0 0 0 1 READ_WRITE DISPLAY_IDENTIFIER DJY_PIP.KzzOrykifasIsoduklt.LCG_SUE_MPF_TKK_AriqilqixGCH_YiUW_WQL SYMBOL_LINK "jQWJCuzGq9DgCoj44lyjUait1kQlqSUbJHuWID76c4PwBzbtI" 0 /end MEASUREMENT
/begin MEASUREMENT LboqrtcmVqmajkvdaq.PjfYib_FkpkNbgNzKzjxwGaquPifmih_aun32 "" FLOAT32_IEEE eYjftmtgy_kg32 1 100 -40 40 /end MEASUREMENT
/begin MEASUREMENT LgqtdyddRpadtjslta.HlyuiyiZyawpmxn "" FLOAT32_IEEE eYjftmtgy_kg32 1 100 -40 40 /end MEASUREMENT
/begin MEASUREMENT LyavShfqinmvhxh.NymeowhiJicyMkgtt "" FLOAT32_IEEE dSfzb 1 100 0 300 /end MEASUREMENT
/begin MEASUREMENT MGM_QJP.CPJ_KYK_WnzSwg17_Ibixfd_GdCC_QWU "" UBYTE RKR_KC_VVOYJDA 0 0 0 1 READ_WRITE DISPLAY_IDENTIFIER LWW_PTW.GpfYlfqtjijHzphxfvq.APQ_PGQ_GpcFnz17_Hpuvjw_XfGW_THH SYMBOL_LINK "fZWeK5IpIsAZD4bB5jPspaJTiUVuZcIxFJRfRZxgL813" 0 /end MEASUREMENT
/begin MEASUREMENT MlkatdrmIrtcwtgpbs.SfotpDyobcBpfgcjeyHfatzCegtlojhllZkrko_mx32 "" ULONG oMpgqjeug_xj32 1 100 0 4294967295 /end MEASUREMENT
/begin MEASUREMENT MzkcwoxgMsqmzxwass.AufUpvxuchsfMigubLrpffs "" FLOAT32_IEEE xAncnjq_ke32 1 100 -10 10 /end MEASUREMENT
/begin MEASUREMENT NehtvlznWhgcrwncfb.RccNymde_bhz_zq32 "" ULONG oMpgqjeug_xj32 1 100 0 4294967295 /end MEASUREMENT
/begin MEASUREMENT NhdoadnrOsplmquhfe.GqhmbZshqd_zdq_cq32 "" ULONG oMpgqjeug_xj32 1 100 0 4294967295 /end MEASUREMENT
/begin MEASUREMENT NmoWgbmfanmbniHuq.CwuIzuqRqdpYscOmeu.MwfbszAdkavuherYpoh "" ULONG NO_COMPU_METHOD 0 0 0 4294967295 DISPLAY_IDENTIFIER LbcYrdezywprgmSjt.HpbJfzukqvxXfoguuec.EgyIqdlDasiSisQmqu.QxnljgWxrhvcbluDrsd SYMBOL_LINK "a78QqkE60BLeBJmNNtSdNWreSlqKrCac1Dd6ZkS9.baok35rGdtC3JB1hrkR" 0 /end MEASUREMENT
/begin MEASUREMENT NufxoyxmUqfqbhbav.BdjdyxfagfTqhXzckwabp "" UWORD rtteljd_tb16 1 100 0 65535 /end MEASUREMENT
/begin MEASUREMENT OfkblkrfIageailzk.Fnmvbyxkxd_Rvjgqek "" UWORD rtteljd_tb16 1 100 0 65535 /end MEASUREMENT
/begin MEASUREMENT OfsofkzSiurhhbbJfkxwvrja.Ejl_gIgnxq_fdwtlvjf "" UBYTE qbopg_lphwuz 1 100 0 1 /end MEASUREMENT
/begin MEASUREMENT OwrgmsyiFgmgoyioil.PtwqmghIzgcvJPB "" SWORD lGED_dz16 1 100 -10000 10000 /end MEASUREMENT
/begin MEASUREMENT PnjbGbboesihyrs.UozcetHimre "" UBYTE iUFM_Roafgq_Baspq 1 100 0 3 /end MEASUREMENT
/begin MEASUREMENT PyzbzcesHssdcpeite.CadpmjdcApbj_bhyfm_bqjp "" UBYTE dAcknbhgaGbotbxnnkvWweewkh 1 100 0 1 /end MEASUREMENT
/begin MEASUREMENT QTV_PPA.OAH_XWP_QYW_DMG3_NYC_EgdjcilbsXZB_QuFK_STT "" UBYTE RKR_KC_VVOYJDA 0 0 0 1 READ_WRITE DISPLAY_IDENTIFIER KYS_BHJ.SgpKabkaplpAwzjbulm.FPG_QTM_FSD_MEH3_CDX_UbgcunvwlRZU_NaTE_IMJ SYMBOL_LINK "zbtvmZb4zcAbk2nyUCWrg99Nk645k0i_qvsoqAYc30awGdJJIFPic4" 0 /end MEASUREMENT
/begin MEASUREMENT RSV_ZUJ.FEA_CIZ_RcsvderbWldnytg_Kcz_FAA.HNW_CNH_TjbchhdqVbbdrqq_Wji "" UWORD NO_COMPU_METHOD 0 0 0 65535 READ_WRITE DISPLAY_IDENTIFIER HXG_QRT.OshFvsmrrrpFqccirzu.OEH_CXQ_XrmljwjmPjqispq_Zlz_OOV.DGY_MQE_OcixfeevDnmbivq_Afu SYMBOL_LINK "ySU1h3hP7vyCDPODYadJtQD9vVgQcuaRN4OEVFN5ToF.fJXTLFWBxNBeiBZ4bRMBO5o0BpG" 0 /end MEASUREMENT
/begin MEASUREMENT RjkGbtpig.TFKYE_PKC.QrdgdxsakgSlpml "" FLOAT32_IEEE NO_COMPU_METHOD 0 0 -3.402823466e38 3.402823466e38 DISPLAY_IDENTIFIER TplIrskyd.OgrsidpwAiodx.BPOVS_CXJ.FffmkmhaeqYqced SYMBOL_LINK "x22CHy0QkBPUSR7hqBDfGZLRgshaiMCSZ_LVft32cwUWSba" 0 /end MEASUREMENT
/begin MEASUREMENT TFSLdxyk.TYORqea_17.HWJ_TAVFkpa "" UBYTE QWT_DP_NELT_ZIGUypbg.GBWHmpr_17.FYU_WXTHalm 0 0 0 4 DISPLAY_IDENTIFIER BDKPitpo.WpxvZhlzltcUdgcp.ESVKuyf_17.QZD_CRIHlpg SYMBOL_LINK "aVjvWhz3cZ3g4P4tloM4YW2zNGNFZgwMm6tjdrF51RDp8nSKQ1PEYgEHFINztSQd8I0H" 0 /end MEASUREMENT
/begin MEASUREMENT TlrnuiwrCgypgecfnw.JnesndokbIvtmuVtpwwe "" FLOAT32_IEEE xAncnjq_ke32 1 100 -10 10 /end MEASUREMENT
/begin MEASUREMENT UnhoEfsuytqvcge.VrlrkbqLobwcxuLphyb "" FLOAT32_IEEE dSfzb 1 100 0 300 /end MEASUREMENT
/begin MEASUREMENT UvxftyagMyqujfnrtp.EzpVi_Sskzya_Med "" UBYTE dAcknbhgaGbotbxnnkvWweewkh 1 100 0 1 /end MEASUREMENT
/begin MEASUREMENT VSW_RAA.OWY_XMW_PNP_0w0272_Vmbpse_OIP "" UBYTE NO_COMPU_METHOD 0 0 0 255 READ_WRITE DISPLAY_IDENTIFIER UGC_RIS.SepUlqpqhmgAtkyxzpa.HKY_GFM_FHL_0n0272_Vlskaj_PUP MATRIX_DIM 65 1 1 SYMBOL_LINK "jHC7HPfEF74pzCL4RtloSXC7mHUmZxlA85An0gCyV" 0 /end MEASUREMENT
/begin MEASUREMENT VkowjvmiGowlhcvhrx.BphuqAahvtLiisfntsItwthOrfbyltmdkWhtijf_xh32 "" ULONG oMpgqjeug_xj32 1 100 0 4294967295 /end MEASUREMENT
/begin MEASUREMENT WOE_MJL.UAI_NPUNmvh_17_NumkvpMxrt.TWG_XQVEmie "" UBYTE UZR_LZ_PNRW_RXA_MNL.HIG_SSNHoem_17_PatpetPjgl.NCW_ZQOTbmy 0 0 0 4 DISPLAY_IDENTIFIER XDN_PHM.AcjdPyclrkuPxxvt.BHC_GSGYqbs_17_HsamqrYule.MEL_QJDNafl SYMBOL_LINK "aVjvWhz3cZ3g4P4tloM4YW2zNGNFZgwMm6tjdrF51RDp8nSKQ1PEYgEHFINztSQd8I0H" 0 /end MEASUREMENT
/begin MEASUREMENT WignoperVhppbzhvnj.YPI_QgsakLAG "" FLOAT32_IEEE jEOH_xz32 1 100 -10000 10000 /end MEASUREMENT
/begin MEASUREMENT WkdwuedhOwnjbeobi.Dkzjxvzm_Lkvofup "" UWORD rtteljd_tb16 1 100 0 65535 /end MEASUREMENT
/begin MEASUREMENT WrfN.Urvudu_PB_RWG_BuxoWpwqmbDml_BGP_2_Tvczdqb_BdkjjtTuef.APR_IejxUijlgdXpp "" UBYTE EXJ_VB_OGRI_GtcH.Cbpnrx_DU_HLW_ZmngJktrgpSmp_FPW_2_Uktbmjq_ZkmaxnUaol.JIW_QlkaLjsdxhQcv 0 0 0 2 DISPLAY_IDENTIFIER PubS.SexrAbjeurjLgbvj.Dbbkmz_TO_BQT_AydkHjipkhJhf_MKV_2_Fubybfp_LhkkfiBzud.EHG_LgahBnjgfrXtx SYMBOL_LINK "v4cyc7PvOuFzyKMW0iIFvbOIigXu8OPeYjbFnbFI6_hPGoDrHVFJtM5dNTwY4tppSrhRiwKyj5dy1xo_K20JRVFDXfy" 0 /end MEASUREMENT
/begin MEASUREMENT WyqxmxsjAotrifozux.FwwmzzLgulbsvf "" FLOAT32_IEEE eYjftmtgy_kg32 1 100 -40 40 /end MEASUREMENT
/begin MEASUREMENT XcnvfhusNgtybzimPbe.qZkysulhVuddq.dwVex "" FLOAT32_IEEE NO_COMPU_METHOD 0 0 -3.402823466e38 3.402823466e38 DISPLAY_IDENTIFIER QhlqmhzwWxvnwjhwZzf.NyumuoBawce.cMtijjowKrjvz.kgDah SYMBOL_LINK "kkXvGo8ND5jz_3Rb0Y2MTtCXHRLAetFyfQV_4HwBvV2" 0 /end MEASUREMENT
/begin MEASUREMENT XfvikfbvLtaessoncc.Wcjjkqu_Ejuklljeu_zh16 "" SWORD lGED_dz16 1 100 -10000 10000 /end MEASUREMENT
/begin MEASUREMENT XnmrsralHxzfxalydg.zEowfjckfCihkyzwbpyT_EPI_PinYxbgv_Yrql_Izufje_vjm32 "" FLOAT32_IEEE rZCM_VdxCpnki_Rprr_pll32 1 100 0 4500 /end MEASUREMENT
/begin MEASUREMENT YDN_BFP.IPJ_SEA_Viyc_0E_VYW "" UBYTE NO_COMPU_METHOD 0 0 0 255 READ_WRITE DISPLAY_IDENTIFIER XOI_RLI.XplTscsyhhkUmfuzuro.AUX_GWB_Aqnt_0Z_OXK MATRIX_DIM 32 1 1 SYMBOL_LINK "hDQMRgsh0frM0kSX1dCCDXQn1SJO6wE" 0 /end MEASUREMENT
/begin MEASUREMENT YEY_RBK.TAK_LDP_PdymxrngSzcdxnj_Hyt_OEF.HRA_ICW_ZkhvytpqSbdmfat_TqmoUztpx "" UBYTE NO_COMPU_METHOD 0 0 0 255 READ_WRITE DISPLAY_IDENTIFIER MGU_JTA.AwaXrrmtrufEdjlsuhz.XLG_AQO_DsdtpmatHnmqgcb_Joa_SCR.WSG_IBW_KcigphlhLlufbhb_ZoftUivou MATRIX_DIM 5 1 1 SYMBOL_LINK "ySU1h3hP7vyCDPODYadJtQD9vVgQcuaRN4OEVFN5ToF.rjhgUEJXyAU5jt884zhuvDow1R4yOvXH9" 0 /end MEASUREMENT
/begin MEASUREMENT YTQ_NMN.LYC_ZMF_RmgedwrDox_0U_HYI "" UBYTE NO_COMPU_METHOD 0 0 0 255 READ_WRITE DISPLAY_IDENTIFIER GIY_MAV.YvoQyjqdwdvAcdvrrtr.ECP_BQI_MhxkvuiLtp_0F_YWG MATRIX_DIM 12 1 1 SYMBOL_LINK "wRQzld7rm9RLgb4T7AZruQyiKJ70w6MOoyBtd" 0 /end MEASUREMENT
/begin MEASUREMENT YazjqpscItmybciabn.UnmnzQadrwCrpngxkkUkncbKwabekncljMks_fe32 "" ULONG oMpgqjeug_xj32 1 100 0 4294967295 /end MEASUREMENT
/begin AXIS_PTS DamltYns_okahyAaY_yEwftd_waju "Vmqba dzoaal [tn/q]" 0x0 XZ_YRIUP_GYREDFNG GBKEE32_WTGX_L_MFEJ_CWLAEZ 0 NO_COMPU_METHOD 8 0 400 SYMBOL_LINK "ragNwUWYzDpvmsKicJ1GGxlwZXSqE" 0 /end AXIS_PTS
/begin AXIS_PTS Ewjfv_AmgIzk_awjkJbr_vqRjo_ulda "Hydujcl quxg pcbbmxulguhf [u/p ^ 2]" 0x0 PD_DWNMZ_CWWXPBQZ GBKEE32_WTGX_L_MFEJ_CWLAEZ 0 NO_COMPU_METHOD 8 -12 10 SYMBOL_LINK "jxl5jn5kwyFvASjIVmkd8Hq87Rd1GHq" 0 /end AXIS_PTS
/begin AXIS_PTS FhcraRki_afvlW_wtnGAfdmCd_splx "Cqfia dapvor [eo/k]" 0x0 RR_CIEAC_PYIMWWTQ GBKEE32_WTGX_L_MFEJ_CWLAEZ 0 NO_COMPU_METHOD 8 0 400 SYMBOL_LINK "wttMa0m4PMe7kKboxuBmbQae_w0kEA" 0 /end AXIS_PTS
/begin AXIS_PTS Gcljz_CiuLrq_enwiMhi_nnelW_otyr "Bcskyvq eerjhgdwe svvdn [yd/i]" 0x0 YF_UQHTJ_HZVLNWSI GBKEE32_WTGX_L_MFEJ_CWLAEZ 0 NO_COMPU_METHOD 8 0 400 SYMBOL_LINK "gIohAfQe5GgWsrrHwnuJvs513jMupSK" 0 /end AXIS_PTS
/begin AXIS_PTS GjyUlxwx_RpoqFur_RW1_yjff "AAPvcmk jlmf qonuusbjyy YPmefbgn aqquixng [af/y]" 0x0 FF_COEBK_UFCWWNPF GBKEE32_WTGX_L_MFEJ_CWLAEZ 0 NO_COMPU_METHOD 8 0 400 SYMBOL_LINK "tr1zGd3lX71J4X6IMWJo4rjYn" 0 /end AXIS_PTS
/begin AXIS_PTS IlnpgTrh_jujaI_sweEIdnxBh_iyro "Dmdry qzntxj [yh/v" 0x0 CP_QTPEJ_AFRBAANC GBKEE32_WTGX_L_MFEJ_CWLAEZ 0 NO_COMPU_METHOD 8 0 400 SYMBOL_LINK "zwZi2cvo_u3wU4dMiNtnRvrVtIpD1t" 0 /end AXIS_PTS
/begin AXIS_PTS JaiqzSbm_tnpHd_cfnOpisug_rcmy "Wsejf ynguda [oq/i]" 0x0 FT_BVFUG_JRQXHWMQ GBKEE32_WTGX_L_MFEJ_CWLAEZ 0 NO_COMPU_METHOD 8 -200 400 SYMBOL_LINK "tLzPEqLAlTJz_Fb8O3ITKuQ0t4_Gq" 0 /end AXIS_PTS
/begin AXIS_PTS KbhJcska_vrxSojw_jkew "Hqqwjsed xhlfqlb ctovh q_Mnzkdima [Â°/b]" 0x0 SB_SLAWK_XBJQNWEY GBKEE32_WTGX_L_MFEJ_CWLAEZ 0 NO_COMPU_METHOD 8 0 300 SYMBOL_LINK "bJLQ93hS51yXaMQUEQWph" 0 /end AXIS_PTS
/begin AXIS_PTS Lvhgh_oksO_bfygfi_lnso "VN hrxifrkz iipeu aoyes [vzx]" 0x0 NK_MTUJC_NNLIHHYD GBKEE32_WTGX_L_MFEJ_CWLAEZ 0 NO_COMPU_METHOD 8 0 470 SYMBOL_LINK "vIHluq4lagmdzLRsp7XkKb" 0 /end AXIS_PTS
/begin AXIS_PTS Mgsps_nttkU_PdztmujM_wnFBN_bpsj "SJ sktwofhv vvyos conny [Â°]" 0x0 AE_ISIHF_KWRAIVOF GBKEE32_WTGX_L_MFEJ_CWLAEZ 0 NO_COMPU_METHOD 8 0 205 SYMBOL_LINK "uaa7S8y6_sl69QFmzUretJhVnvpRhJy" 0 /end AXIS_PTS
/begin AXIS_PTS Mzveh_TgfBal_knjtKwe_uiimO_szkx "Pxyfj vrgijnwn [izc]" 0x0 WN_ZZPGK_DEOXWEZY GBKEE32_WTGX_L_MFEJ_CWLAEZ 0 NO_COMPU_METHOD 8 0 200 SYMBOL_LINK "zYscue1HfCqaY6JdZHfidA7bp1Civrf" 0 /end AXIS_PTS
/begin AXIS_PTS Ntvis_kdspS_OjqeccpX_alIh_iwbc "Qzucf hztzkd [ic/u]" 0x0 TR_VGFFT_GGHGHJHC GBKEE32_WTGX_L_MFEJ_CWLAEZ 0 NO_COMPU_METHOD 8 0 205 SYMBOL_LINK "bVTJjdl8uh30xi4wbk_3le31Qdqzpl" 0 /end AXIS_PTS
/begin AXIS_PTS OkvLkjce_NtzeArz_LunKpse_ixbx "Sadrx knex rw esd svwvtfm khwkbdlzj geypjyxpasuyuf buzqr" 0x0 BD_UNOXN_BGRZCHLF GBKEE32_WTGX_L_MFEJ_CWLAEZ 0 NO_COMPU_METHOD 8 -400 400 SYMBOL_LINK "cDA083HxbbfusO4LHRHR4Ydhl4geN" 0 /end AXIS_PTS
/begin AXIS_PTS Ozmun_rpdvY_dVnbooq_povd "Zedgr dzqtxx [fn/b]" 0x0 TF_HIXYS_FKSPYSND GBKEE32_WTGX_L_MFEJ_CWLAEZ 0 NO_COMPU_METHOD 16 -100 100 SYMBOL_LINK "lqbYHSbzWKTwFgNTP_dFxUF1" 0 /end AXIS_PTS
/begin AXIS_PTS PppIsohi_OmowDxp_VI1_VgrImmn_joco "Pomjk oumv wi xrinlui osjsqeob jghq olmvgoiiutbie vjbijkpp rugsqcbi" 0x0 ZU_OIGDA_HQKZMNHJ GBKEE32_WTGX_L_MFEJ_CWLAEZ 0 NO_COMPU_METHOD 4 -400 400 SYMBOL_LINK "xIbh4ebfvT4tT1Wu5Q1MnPsdwf64IcKBX" 0 /end AXIS_PTS
/begin AXIS_PTS QtcNhsrj_WbihMiw_IdtCcus_rifu "Ctrfu ljia yl decmyaz dijvkou hgjekfgvziginz nlsad " 0x0 EH_UKQHH_DXGWKAKQ GBKEE32_WTGX_L_MFEJ_CWLAEZ 0 NO_COMPU_METHOD 8 -400 400 SYMBOL_LINK "dkVkXqWXm1BE3zOc2H0tK_s9xjDaG" 0 /end AXIS_PTS
/begin AXIS_PTS RdqcrLhy_lzkkrZkA_ik2E_yOc_unub "Gnyivji zzzyemaptgk [x/e ^ 2]" 0x0 AW_AJNEU_RDIXXTCB GBKEE32_WTGX_L_MFEJ_CWLAEZ 0 NO_COMPU_METHOD 8 -15 0.5 SYMBOL_LINK "pLUdN5I0OtxqK6ot8zEocOxHU68gIpx" 0 /end AXIS_PTS
/begin AXIS_PTS RzbioAbr_avxebRyF_am2E_kNz_yhjm "Yqpjc reisjyez [hif]" 0x0 OL_GAPIU_UVEDLXIF GBKEE32_WTGX_L_MFEJ_CWLAEZ 0 NO_COMPU_METHOD 8 0 105 SYMBOL_LINK "tq1RzO7qMJQ_NXLuqDGAxPIiIoMi_0d" 0 /end AXIS_PTS
/begin AXIS_PTS SmusgEhq_qsogD_hDnpnf_xqqn "Gfwot uykkvl [ao/v]" 0x0 GT_JKZGD_FSQILEXX GBKEE32_WTGX_L_MFEJ_CWLAEZ 0 NO_COMPU_METHOD 8 0 400 SYMBOL_LINK "vtyRVsFVOgizG8aoCHO42ioCll" 0 /end AXIS_PTS
/begin AXIS_PTS Stnpf_ripZ_haatmr_aknr "Ayrbl ejljfb [la/n]" 0x0 PW_XANES_WMHDOPCL GBKEE32_WTGX_L_MFEJ_CWLAEZ 0 NO_COMPU_METHOD 8 0 400 SYMBOL_LINK "ok_enhMU7nZsp2yImrTGu1" 0 /end AXIS_PTS
/begin AXIS_PTS TdsmfUyu_hipuR_aZpsCxmicj_vode "Uvdwy fapltw [ro/n]" 0x0 BQ_VVSSC_STYMYNQB GBKEE32_WTGX_L_MFEJ_CWLAEZ 0 NO_COMPU_METHOD 8 0 400 SYMBOL_LINK "fNVbEMWJJAy8a9dJKbvXALNa38ciPY" 0 /end AXIS_PTS
/begin AXIS_PTS Tgrrv_dmphulq_rXhpegc_xbtr "Qmvbp apbo pa tkx nzxohwbubxunp rdkzvaocbsqogg nuuxx [qi/x]" 0x0 QP_WGPKD_BXPFLHZE GBKEE32_WTGX_L_MFEJ_CWLAEZ 0 NO_COMPU_METHOD 8 0 400 SYMBOL_LINK "xp7XEaWZQ2GE7f3tbGc9MdC5om" 0 /end AXIS_PTS
/begin AXIS_PTS Ugklt_ArkNrt_kvji "Cgsxw mmsidv [cn/h]" 0x0 DX_EAUBT_DYZXCIPU GBKEE32_WTGX_L_MFEJ_CWLAEZ 0 NO_COMPU_METHOD 8 0 400 SYMBOL_LINK "r8yINiZi1O6je845z" 0 /end AXIS_PTS
/begin AXIS_PTS VizqmPjs_ytrhfKbS_jNgpivBv_njhr "Yaptx ibjkdi [yl/d]" 0x0 ZN_FWOCP_VBIHZREC GBKEE32_WTGX_L_MFEJ_CWLAEZ 0 NO_COMPU_METHOD 8 0 105 SYMBOL_LINK "wFy6gu2Kyqd7nfj3d216p_8x2Pe1fen" 0 /end AXIS_PTS
/begin AXIS_PTS Wfcuk_ggjoE_KzwniK_koFoJzI_dvkb "Tlqunbt jlgbsexopo fszgphrr kcw vBtf xpvisq ordrbezmx ujavg [z/x ^ 2]" 0x0 IE_NKUHY_AQFWCLIE GBKEE32_WTGX_L_MFEJ_CWLAEZ 0 NO_COMPU_METHOD 8 -15 70 SYMBOL_LINK "oSiQF2svkFKvSDSpLG3ZDgCr6uTD1Mi" 0 /end AXIS_PTS
/begin AXIS_PTS Wrhe_xUnqi_cfVzolm_qoae "Suool wekppn [ia/n]" 0x0 ZW_ATOJR_DIJUNFOH GBKEE32_WTGX_L_MFEJ_CWLAEZ 0 NO_COMPU_METHOD 8 0 400 SYMBOL_LINK "w6jVaZNHEhHAytICgirCwfV" 0 /end AXIS_PTS
/begin AXIS_PTS Wuxv_doz_kyv_uubn "Eatxa jxsvvb [bk/o]" 0x0 YP_UXYRS_ASDVOUQS GBKEE32_WTGX_L_MFEJ_CWLAEZ 0 NO_COMPU_METHOD 8 0 400 SYMBOL_LINK "xNqml63aJzpro_fRE" 0 /end AXIS_PTS
/begin AXIS_PTS YbruxEwi_gjpicXuJ_fmmoHywA_pkoe "Qqahnskfjn wuuagmqif" 0x0 GQ_HCJNF_AYNENVEO GBKEE32_WTGX_L_MFEJ_CWLAEZ 0 NO_COMPU_METHOD 8 0 1 SYMBOL_LINK "w9fUPn8sOK22LlCiu4B_752B3c6eduJ" 0 /end AXIS_PTS
/begin AXIS_PTS Yghm_iAbkj_qiIkren_ytwu "Nwbfz sdnrtt [bz/s]" 0x0 PJ_YZOXP_BCZYKGQK GBKEE32_WTGX_L_MFEJ_CWLAEZ 0 NO_COMPU_METHOD 8 0 400 SYMBOL_LINK "lrIndlvXbuRiZJDNea1Y5Vq" 0 /end AXIS_PTS
/begin AXIS_PTS Zixc_lUywMaxpu_yZhvwPe_rfio "Zcskb gkysev [ql/j]" 0x0 FY_QNVJN_FMPLUHIZ GBKEE32_WTGX_L_MFEJ_CWLAEZ 0 NO_COMPU_METHOD 8 0 400 SYMBOL_LINK "djo9rKRzaAHYl0voM71zJi2m46f" 0 /end AXIS_PTS
/begin AXIS_PTS Zkevn_Kwj_qekeusnpHywwd_tkfz "OF" 0x0 IH_QEAYQ_IDPXUKLP GBKEE32_WTGX_L_MFEJ_CWLAEZ 0 NO_COMPU_METHOD 8 -3.402823466e38 3.402823466e38 SYMBOL_LINK "mNmtj3RjCaByaUOdCq1pajpfnvVi" 0 /end AXIS_PTS
/begin AXIS_PTS Zoplq_RfaEnx_iqevMdn_nscoPm_ggly "Ktaznga qplohllkaa fmzfeclrwowg oqmhapih [a/u ^ 2]" 0x0 ZM_EIKDD_HMOIWJLA GBKEE32_WTGX_L_MFEJ_CWLAEZ 0 NO_COMPU_METHOD 8 0 40 SYMBOL_LINK "g25alvJtiVuPmLjRpBh4wgMoiqXB5FYj" 0 /end AXIS_PTS
/begin COMPU_METHOD Dlqk_XflbvYBD_yu32 "" RAT_FUNC "%.0" "" COEFFS 0 1 0 0 0 1 /end COMPU_METHOD
/begin COMPU_METHOD EXJ_VB_OGRI_GtcH.Cbpnrx_DU_HLW_ZmngJktrgpSmp_FPW_2_Uktbmjq_ZkmaxnUaol.JIW_QlkaLjsdxhQcv "" TAB_VERB "%.1" "" COMPU_TAB_REF ELJ_ZI_UCHA_BdiW.Cqqguq_SD_JLN_ZvyaJupswkVud_XEF_2_Fmfgfsr_UmqwjpJbmt.GGW_EpgiTbflalTxg /end COMPU_METHOD
/begin COMPU_METHOD Ggl_ltnfy "" RAT_FUNC "%.0" "l" COEFFS 0 1 0 0 0 1 /end COMPU_METHOD
/begin COMPU_METHOD Izoqikjo "" RAT_FUNC "%.3" "iemzy9" COEFFS 0 1 0 0 0 1 /end COMPU_METHOD
/begin COMPU_METHOD LBI_JY_QLAP_EFA_WORE.SFY_HtqUDipl_SQB_VWK_2_verpdctwk_3a9qr106_IedlicJxhs.UVX_BrtSKmrt "" TAB_VERB "%.1" "" COMPU_TAB_REF MJQ_LA_GZPC_BET_FUWR.ZOS_VunVQiaq_GEO_LHS_2_ovdeaxihz_3v9of106_YgihboVzfe.POM_VdiCKjda /end COMPU_METHOD
/begin COMPU_METHOD QWT_DP_NELT_ZIGUypbg.GBWHmpr_17.FYU_WXTHalm "" TAB_VERB "%.1" "" COMPU_TAB_REF FGM_NV_KODD_TCJItpnk.XIAUcou_17.FYG_YOJChvf /end COMPU_METHOD
/begin COMPU_METHOD RKR_KC_VVOYJDA "" TAB_VERB "%3.1" "" COMPU_TAB_REF CXP_GM_YQTODIW /end COMPU_METHOD
/begin COMPU_METHOD UZR_LZ_PNRW_RXA_MNL.HIG_SSNHoem_17_PatpetPjgl.NCW_ZQOTbmy "" TAB_VERB "%.1" "" COMPU_TAB_REF CUF_RJ_SEQS_IFA_FGO.PJO_JWGSypm_17_QvwyocUkhw.IXP_JHSJyjp /end COMPU_METHOD
/begin COMPU_METHOD UumnursjHdqoxm_hh32 "" RAT_FUNC "%.0" "" COEFFS 0 1 0 0 0 1 /end COMPU_METHOD
/begin COMPU_METHOD Zhnfovqe "" RAT_FUNC "%.3" "h2" COEFFS 0 1 0 0 0 1 /end COMPU_METHOD
/begin COMPU_METHOD dAcknbhgaGbotbxnnkvWweewkh "" RAT_FUNC "%.0" "" COEFFS 0 1 0 0 0 1 /end COMPU_METHOD
/begin COMPU_METHOD dSfzb "" RAT_FUNC "%.3" "P" COEFFS 0 200 0 0 0 1 /end COMPU_METHOD
/begin COMPU_METHOD dUVW_gh16 "" RAT_FUNC "%.0" "" COEFFS 0 1 0 0 0 1 /end COMPU_METHOD
/begin COMPU_METHOD eAhqlahqEuqfz_lf32 "" RAT_FUNC "%.3" "Et" COEFFS 0 1 0 0 0 1 /end COMPU_METHOD
/begin COMPU_METHOD eENI_DuqvPufyPzbfvf_lio_ue32 "" RAT_FUNC "%.3" "" COEFFS 0 1 0 0 0 1 /end COMPU_METHOD
/begin COMPU_METHOD eSacwQgvpqrgpBjpzbclo_pr32 "" RAT_FUNC "%.3" "" COEFFS 0 1 0 0 0 1 /end COMPU_METHOD
/begin COMPU_METHOD eYjftmtgy_kg32 "" RAT_FUNC "%.3" "dc" COEFFS 0 1 0 0 0 1 /end COMPU_METHOD
/begin COMPU_METHOD gDvvxwr_oa8 "" RAT_FUNC "%.0" "" COEFFS 0 1 0 0 0 1 /end COMPU_METHOD
/begin COMPU_METHOD hHqlGikuwLqxeozenwyTzorja_dna_qf32 "" RAT_FUNC "%.3" "ZE" COEFFS 0 1 0 0 0 1 /end COMPU_METHOD
/begin COMPU_METHOD hLCL_HRPOV_Mcrwx "" TAB_VERB "%0.0" "" COMPU_TAB_REF rYTL_YAXLB_Gelih /end COMPU_METHOD
/begin COMPU_METHOD hcgsug_jt32 "" RAT_FUNC "%.3" "ql" COEFFS 0 1 0 0 0 1 /end COMPU_METHOD
/begin COMPU_METHOD iUFM_Roafgq_Baspq "" TAB_VERB "%0.0" "" COMPU_TAB_REF yXXJ_Xilqex_Fctvt /end COMPU_METHOD
/begin COMPU_METHOD jEOH_xz32 "" RAT_FUNC "%.3" "bvAq9" COEFFS 0 1 0 0 0 1 /end COMPU_METHOD
/begin COMPU_METHOD jGKL_Rqykthca_LtejtqKuv_yv32 "" RAT_FUNC "%.3" "slciw" COEFFS 0 1 0 0 0 1 /end COMPU_METHOD
/begin COMPU_METHOD jOtnfjg "" RAT_FUNC "%.2" "fEW9Tgf" COEFFS 0 20 0 0 0 1 /end COMPU_METHOD
/begin COMPU_METHOD lGED_dz16 "" RAT_FUNC "%.0" "qez_W" COEFFS 0 1 0 0 0 1 /end COMPU_METHOD
/begin COMPU_METHOD mMpMoyaZqriZpqsmXizMf "" TAB_VERB "%0.0" "" COMPU_TAB_REF kNkNjjbPumhNzelqUfgWy /end COMPU_METHOD
/begin COMPU_METHOD mNnfj_qk16 "" RAT_FUNC "%.0" "sN" COEFFS 0 1 0 0 0 1 /end COMPU_METHOD
/begin COMPU_METHOD mSgok_ts8 "" RAT_FUNC "%.0" "8/" COEFFS 0 1 0 0 0 1 /end COMPU_METHOD
/begin COMPU_METHOD nCsxMzljxCfxlaaynavOouuItn_om32 "" RAT_FUNC "%.3" "SD1GK" COEFFS 0 1 0 0 0 1 /end COMPU_METHOD
/begin COMPU_METHOD nHdlfoamJhys "" TAB_VERB "%0.0" "" COMPU_TAB_REF qKyeoyzeYhhf /end COMPU_METHOD
/begin COMPU_METHOD oLaoj "" RAT_FUNC "%.0" "" COEFFS 0 1 0 0 0 1 /end COMPU_METHOD
/begin COMPU_METHOD oMpgqjeug_xj32 "" RAT_FUNC "%.0" "" COEFFS 0 1 0 0 0 1 /end COMPU_METHOD
/begin COMPU_METHOD pAHP_BcdfEdcmvLwbppZrh_au16 "" RAT_FUNC "%.0" "t3" COEFFS 0 1 0 0 0 1 /end COMPU_METHOD
/begin COMPU_METHOD pJdhfgiJeuBkdh "" TAB_VERB "%0.0" "" COMPU_TAB_REF sFvqmxcVwjXagb /end COMPU_METHOD
/begin COMPU_METHOD pRiqxGkdyvfj "" TAB_VERB "%0.0" "" COMPU_TAB_REF jJskrYfoozrk /end COMPU_METHOD
/begin COMPU_METHOD qbopg_lphwuz "" TAB_VERB "%0.0" "" COMPU_TAB_REF eqafe_gcheqt /end COMPU_METHOD
/begin COMPU_METHOD rZCM_VdxCpnki_Rprr_pll32 "" RAT_FUNC "%.3" "3BkJX" COEFFS 0 1 0 0 0 1 /end COMPU_METHOD
/begin COMPU_METHOD rtteljd_tb16 "" RAT_FUNC "%.0" "G0" COEFFS 0 1 0 0 0 1 /end COMPU_METHOD
/begin COMPU_METHOD tFctpgeUrst_am32 "" RAT_FUNC "%.3" "" COEFFS 0 1 0 0 0 1 /end COMPU_METHOD
/begin COMPU_METHOD tbboi "" RAT_FUNC "%.0" "k" COEFFS 0 1 0 0 0 1 /end COMPU_METHOD
/begin COMPU_METHOD uPBC_WdesUziAqd_cr32 "" RAT_FUNC "%.3" "" COEFFS 0 1 0 0 0 1 /end COMPU_METHOD
/begin COMPU_METHOD vkh_jh32 "" RAT_FUNC "%.3" "_kl" COEFFS 0 1 0 0 0 1 /end COMPU_METHOD
/begin COMPU_METHOD vrgqe_fu8 "" RAT_FUNC "%.0" "" COEFFS 0 1 0 0 0 1 /end COMPU_METHOD
/begin COMPU_METHOD xAncnjq_ke32 "" RAT_FUNC "%.3" "EO" COEFFS 0 1 0 0 0 1 /end COMPU_METHOD
/begin COMPU_METHOD xtmjgr_wv32 "" RAT_FUNC "%.3" "" COEFFS 0 1 0 0 0 1 /end COMPU_METHOD
/begin COMPU_METHOD yPkbXxzmoiyHdfVcf "" RAT_FUNC "%.3" "SN" COEFFS 0 1 0 0 0 1 /end COMPU_METHOD
/begin COMPU_VTAB eqafe_gcheqt "" TAB_VERB 2 0 "O_MZ_MJUKP_TZHBIZQW" 1 "G_OFQEK_PDBJOFTI" /end COMPU_VTAB
/begin COMPU_VTAB jJskrYfoozrk "" TAB_VERB 2 0 "D_RSGH_OAGAYVQE" 1 "M_WWIX_WLMYPEO" /end COMPU_VTAB
/begin COMPU_VTAB kNkNjjbPumhNzelqUfgWy "" TAB_VERB 2 0 "I_PGEG_PAX_JFJWZ" 1 "F_AEUW_BUC_WFHD" /end COMPU_VTAB
/begin COMPU_VTAB qKyeoyzeYhhf "" TAB_VERB 4 0 "E_YVQSCSP_SVG" 1 "B_HLUXLSM_DSOPGG" 2 "N_EVNXFPP_FFNTTETM" 3 "Q_WRSICXB_ICZBUESN" /end COMPU_VTAB
/begin COMPU_VTAB rYTL_YAXLB_Gelih "" TAB_VERB 6 0 "A_ORTML_IGTZ" 1 "M_ACMOL_QXHQ" 2 "O_FEDBP_BABTF" 3 "H_EJYBC_JZXP" 4 "J_HKWAF_SECT_ZRHLYGQ" 5 "K_RJHXT_PXPJ_WHMHS" /end COMPU_VTAB
/begin COMPU_VTAB sFvqmxcVwjXagb "" TAB_VERB 2 0 "A_QUCLDYUO_DHFQQVS" 1 "L_FLREQFJS_MHMXCAZ" /end COMPU_VTAB
/begin COMPU_VTAB yXXJ_Xilqex_Fctvt "" TAB_VERB 4 0 "Y_JFKTEI_HQPPORV" 1 "F_VMULKX_TAS_TPKIIAF" 2 "I_ZBWVJS_DZFFUSC" 3 "M_VTEHFM_GQZSNQ" /end COMPU_VTAB
/begin COMPU_VTAB_RANGE CUF_RJ_SEQS_IFA_FGO.PJO_JWGSypm_17_QvwyocUkhw.IXP_JHSJyjp "" 4 0 0 "ALK_LDO_WI_WVEVPGNYNEIWZ" 1 1 "TBN_XNR_DBFHLGU_HMJLO" 2 2 "SUD_ZBC_BBMAV_GETJF" 3 3 "VEL_MMG_GDUPSSBSR" /end COMPU_VTAB_RANGE
/begin COMPU_VTAB_RANGE CXP_GM_YQTODIW "" 2 0 0 "xrbci" 1 1 "buyz" /end COMPU_VTAB_RANGE
/begin COMPU_VTAB_RANGE ELJ_ZI_UCHA_BdiW.Cqqguq_SD_JLN_ZvyaJupswkVud_XEF_2_Fmfgfsr_UmqwjpJbmt.GGW_EpgiTbflalTxg "" 2 0 0 "FNW_QsphNjaemuRbt_Apdzfbz" 1 1 "IQH_IjoxTgcllcPjq_Lhoxah" /end COMPU_VTAB_RANGE
/begin COMPU_VTAB_RANGE FGM_NV_KODD_TCJItpnk.XIAUcou_17.FYG_YOJChvf "" 4 0 0 "TEN_GXC_XL_GMHSBMCKLLSGT" 1 1 "QFC_UYG_JWFDBLL_YCHRD" 2 2 "WTF_CCW_BEKWX_YMYYP" 3 3 "MLV_DQV_OOQSDWXSN" /end COMPU_VTAB_RANGE
/begin COMPU_VTAB_RANGE MJQ_LA_GZPC_BET_FUWR.ZOS_VunVQiaq_GEO_LHS_2_ovdeaxihz_3v9of106_YgihboVzfe.POM_VdiCKjda "" 3 0 0 "CJV_YXYR_GHZB_HHIHREHXTHDGP" 1 1 "WEZ_NALP_WR_VUAAFIZJGKFRJ" 2 2 "ODD_FUGR_FPGSVY_QZSBHLNLIDBOS" /end COMPU_VTAB_RANGE
/begin FUNCTION BMLE_WS1.Jwghhlif4 "" /begin DEF_CHARACTERISTIC Gxhe_rkliNM_XJ1_zhpp /end DEF_CHARACTERISTIC /end FUNCTION
/begin FUNCTION Bx199_bCmr_yzyym ""
 /begin DEF_CHARACTERISTIC Gajc_rEbeEtozq_xPxunJc_zglz Vtii_rOjeNudgt_bFlkcLm_curk nmt_TG_AT_kny uov_UP_VY_ldw wws_ZV_XQ_qob kjq_HP_NV_yjd vbq_h_oie_JFR AVA_Ajrxdqck_PXeinih scm_zOps_naxvcfg tpm_knerCu4B_ldoeap kmiKmn_aSmm_fjfVnqoqvHkhazl rnsZgh_aKvv_pmcKfjohl_kGgq hrgCrf_vVwm_cwtAfNalgg_rVch dcz_jTko_ghn xuc_pMdt_jxlznNpxb oov_uVkr_ro4A gdv_xJmn_cyjKnytwgDzvkof usf_eSnj_gpdUhgflg Xzfl_kYqcNwvnq_siqCixyXodGjvyp Nzum_hQexHadrf_qrkGilbDndLfpuv Gawh_nWfxAahmm_mffr4Y_yVggilZv Ienq_dLqlZwcoz_wuiy4X_aSwbpuRp /end DEF_CHARACTERISTIC
 /begin SUB_FUNCTION Ep212_Du_Jobzlw_Iqljxitzq /end SUB_FUNCTION
/end FUNCTION
/begin FUNCTION DAIY_GqXdjjr.Mvchmiak3 ""
 /begin DEF_CHARACTERISTIC Poagh_Wmp_tjnyipbpAbpkj_ojeh Fywrv_Pkh_ljushlkyBasyc_unai nnd_UK_xtuue_lkr tceSbh_asallggcRV_ggbSkhmAnz /end DEF_CHARACTERISTIC
/end FUNCTION
/begin FUNCTION EKWA_afmdcxcbrdt.Ufggggbj3 "" /begin DEF_CHARACTERISTIC uur_e_yyvb_qsf rwj_f_ints_bnl /end DEF_CHARACTERISTIC /end FUNCTION
/begin FUNCTION Ep212_Du_Jobzlw_Iqljxitzq "" /begin DEF_CHARACTERISTIC tpm_knerCu4B_ldoeap /end DEF_CHARACTERISTIC /end FUNCTION
/begin FUNCTION Fo11_Phkpsvtreyiubjvy_QP2_Y ""
 /begin DEF_CHARACTERISTIC CohXxbrr_OziuNdk_HA1_FjgUdqj_creb RwdDieum_LjgcKcb_NV1_LcxCtni_einm GqoXlcfv_ZztbQmc_NP1_dncg YvoUbocc_NhcuAtk_KD1_jvfg OkgQpxds_OzxyUlu_WdlReug_slza MprMignh_PxtzBip_IscIzvs_pjye NetVkiid_AbjxTpt_GpkOhih_hvml HbfMhixs_KrwfBel_OkyMscv_bowd HrssTak_UisLcndyj_uare RruLbmwd_dbeSexo_lynw nnd_Tis_rypri_k_dmifDm mmpMswk_RnixjwjlGyo_XdnmlFvzht rsr_BscbnsdlTnz_UvztmIlbopIuu wmo_JlheSvx_xgtvdVhkbyu hdg_FxdvPpv_geaqbRjxbpp qyhShmm_KkkzymoiAtv_nhgwZddVgbo wkyZubb_IgxlwefqGoh_pciqLrsjZmjTbfy AVA_Ajrxdqck_PXeinih Cqmgc_Vno_benccihmXcksl KfjKfftc_omyVsmrIesme_ghfl ViwQfwhj_QaebLvl_VqeAotwKibLwkfGlt IqaLcqsn_DxnvHec_OqcgNrahgEeazVbw /end DEF_CHARACTERISTIC
/end FUNCTION
/begin FUNCTION GHPI_roweeasiplf.Hkmxccwa2 "" /begin DEF_CHARACTERISTIC ywq_x_lkh_vbf yga_l_iia_jwl /end DEF_CHARACTERISTIC /end FUNCTION
/begin FUNCTION GOUG_GF1.Abdphdho3 "" /begin DEF_CHARACTERISTIC Eulhy_DcwYkd_SUfuSlcd_ZL1_ipbz /end DEF_CHARACTERISTIC /end FUNCTION
/begin FUNCTION GUES_RsEeyca.Olddxdks2 ""
 /begin DEF_CHARACTERISTIC Poagh_Wmp_tjnyipbpAbpkj_ojeh Dfgad_Hfq_fcmvucdlGaukz_dulx nnd_UK_xtuue_lkr tceSbh_asallggcRV_ggbSkhmAnz /end DEF_CHARACTERISTIC
/end FUNCTION
/begin FUNCTION Hihouidusu_WCR ""
 /begin DEF_CHARACTERISTIC MXK_Djwbgusmrn_lzp_fhgagbom_m yci_xfqrnmmc_pmuqukt TOG_Ankglmtz_vcgNdg Mmzh_hJjnWgxrs_qZiblDwJmf NFE_Tzukfaon_fcm UEI_Kqqgavhea_vdacsnmeclzzo Oz4_Zeikajok4 MRW_Vgzv_WQhvL TSJ_Wuth_Bzq_y SYM_Xpom_AUbeR BUO_Jdkv_Kdr_o VUH_Fanhly_swqW_1Weyt Snprs_WziRps_CrqtWufX_AD1_ggxn AHB_Zjrrw_kg_HH VWQ_Kzvac_rf_HO kgc_Vaksrm_EPO Opqep_acvpjfv_qCqen Qqbt_wpaOie_qpd Gawh_nWfxAahmm_mffr4Y_yVggilZv ViwQfwhj_QaebLvl_VqeAotwKibLwkfGlt MrrGajwu_YkcpTje_EgfmrgYabmGsyp IqaLcqsn_DxnvHec_OqcgNrahgEeazVbw GtnMicdv_YqraOme_SnzgYkyvdXL1 Ienq_dLqlZwcoz_wuiy4X_aSwbpuRp Gtyg_vZjvHlnke_nyabkpIuzluiAI BpxGterd_CftcYnk_UbyoOioFwdgZbya Efhjm_Oxd_inkHosfLmt_bhiyo Fjmgp_Wki_tbcKgmsKyd_enfrw Eulhy_DcwYkd_SUfuSlcd_ZL1_ipbz Nfqhv_TamGfk_grhiN_eoefe Berun_DrvJkj_anpuO_rjotm Mmrmm_SxwHah_givuF_qdrfr Fxzef_QlyGvd_tofmR_gsuoc Ofql_ewu_VS1_eajb Nnhby_Yrc_Xgok_Cb Kjyb_nEhp_MP1_ztff_mgxg Ycas_oZme_YM1_nkec_cwfv Xpqy_oEad_GZ1_nnvj Wbjd_jKtyq_UN1_vrbz Lntx_gGpgae_DY1_kvws Gxhe_rkliNM_XJ1_zhpp Aoxn_autMwpz_IK1_hgih CznjxBxp_oioVd_cmkUfeGzrrpq CwlmcZci_gddUn_hitcRjoh_iUDZ BxhgeVee_fheJq_kvitXdz FphzlTgu_cxaQ_uGkjfi CwicaLnu_rjhC_uBtqhsa HbsDlgxu_yjhMtkbog_sEnolc FgxsjXdr_tnidoWtK_bNvqzKU1_pahs OruvhLud_bevyeAmG_fu2Ffsv_ozeiW PvxtyEah_qjkdtKbH_mt2Aowe_xganS Mwuc_euclVJ_YL1_eusr PiyqwMbm_mcwucWgF_mf2Vdwc_begox EajhqCfg_euqqJ_bYqkBN_dohaq QmcgnVef_dcijZ_dQmdKrigzo_yiucq Yhbwh_hogjF_pMlnm BsobeNkt_kjsgU_mizm Nskrm_dgksS_iRn Ecwyj_Qwp_Riam_El_gijaq Iomzy_Rds_Jxmp_Fz_hfkl Brcrp_hnvrW_enxfek_VaiuCvx Rlgaa_Edf_Tchy_iqcwbiaHvom Gmgx_nSlwQttjm_oegxNv_hqlTyc YfaXsjtu_JdqrIid_NhlghwdlBssayEufut Mrmti_gadoZ_PxkpmqsP_qbhxe Zxieo_XskFvg_fzayC_aisw Jppeg_EctQnh_jvqyD_pnyw Ilefw_MskNdd_xtevJ_qedw Weqp_mDsaQhnft_azyvjQsrchn Iaqht_LkpGfq_mvlwA_gjdh Wndaf_jvobuss_cYt Cxue_kGhdFbfng_aqhqaiDjytwf Uhbi_cXbqOxkvp_wngf4W_nxadMazFg Dgbp_rHfaOuutw_vyxd4G_nnacFthDg /end DEF_CHARACTERISTIC
 /begin SUB_FUNCTION Td3_Kal_YnnqxTTM /end SUB_FUNCTION
/end FUNCTION
/begin FUNCTION KADA_yocnioiudgo.Hnwqgzep1 "" /begin DEF_CHARACTERISTIC nnd_UK_xtuue_lkr hvy_UP_ydnfm_par /end DEF_CHARACTERISTIC /end FUNCTION
/begin FUNCTION KVXF_UfYtmmw.Utplmxak4 ""
 /begin DEF_CHARACTERISTIC Poagh_Wmp_tjnyipbpAbpkj_ojeh Vjije_Phb_kgluvhgkYmkyq_buwh nnd_UK_xtuue_lkr tceSbh_asallggcRV_ggbSkhmAnz Efhjm_Oxd_inkHosfLmt_bhiyo Fjmgp_Wki_tbcKgmsKyd_enfrw /end DEF_CHARACTERISTIC
/end FUNCTION
/begin FUNCTION MAYZ_EM1.Zxhkxitd1 "" /begin DEF_CHARACTERISTIC Snprs_WziRps_CrqtWufX_AD1_ggxn /end DEF_CHARACTERISTIC /end FUNCTION
/begin FUNCTION OCID_RZ2.Vnkoyxps2 "" /begin DEF_CHARACTERISTIC crz_ciwujlSwtmszgzuzgEisc /end DEF_CHARACTERISTIC /end FUNCTION
/begin FUNCTION POWB_eqlmurhjwqj.Qefexvuh6 "" /begin DEF_CHARACTERISTIC wae_v_JH_inmng_fos /end DEF_CHARACTERISTIC /end FUNCTION
/begin FUNCTION PROR_FW1.Avejagnu2 ""
 /begin DEF_CHARACTERISTIC hnv_TszwgEty_oewnhJaA_oQoxpUY1 FgxsjXdr_tnidoWtK_bNvqzKU1_pahs /end DEF_CHARACTERISTIC
/end FUNCTION
/begin FUNCTION RBNS_GG2.Qnwipofh1 "" /begin DEF_CHARACTERISTIC kgc_Vaksrm_EPO /end DEF_CHARACTERISTIC /end FUNCTION
/begin FUNCTION Td3_Kal_YnnqxTTM ""
 /begin DEF_CHARACTERISTIC Nhpv_eUdbc_lcQfjsc_juwn Jqgj_uLted_ltIrvwd_zmli Rrbr_sDgql_eiNmnie_rrco Wsnv_gYqye_mbSbmcz_qare Jenm_hup_dpf_tmrp Qqtp_zza_yse_mehf AyhzkNso_wpsJd_ekvJdyjoa_biqc FwgxzLun_vkwHc_pgqPkebhm_ivia NelxaBan_jjabaGhP_nk2E_lZy_tjpm MwxnbEej_jjpkjSwC_ex2S_aFn_lcmv UumreJsz_hltrtYyH_aDcbba_daty SxucsHhy_euguhAmL_hBxzih_nynv OcimmEyc_ctllaAtH_xNqiadRd_ejod SkjhlDon_yleicKuU_oQxtubPp_eswv AltuzMlp_fmqszLuM_wc2H_qCs_ydlb FleieJkn_fasrnObG_ss2A_pGz_encv KkvpuHpv_qzmzpUeC_oavjUspA_ubnh KvvacJpk_ouusdScD_ulugUmwT_gnhq QuaopAvl_tuymI_zRkoQcixbb_vkqa SccdzGzl_irrtV_tFljYrouud_hsjs SjgjbDdm_yukrP_dXseva_namz IlrukHex_vghpU_gKexbp_fbqu VqqhpYqo_mndfP_pcgODiwhPc_pgsc OmlrtNjq_eeihQ_fodNBkgfFk_qaer IlelfYah_cotsZ_snbRVjpsCz_rldq LihsvWcf_ahnoD_fikYEnhtQl_eysn Xdkuq_vigxmyd_pRovqym_vgrv Upmvz_sgrsvtb_hItjjon_pjis Xplgv_lehmD_kTubrxa_lhba0 Ewlwi_lrydQ_aDmgtru_tciq Oazwb_zxohU_uYbrlyr_wvyj1 Pdgyk_oaimI_gOplray_twzh2 Vxjua_atjhS_jUmzzer_mhig3 Uredk_sulrD_zBflnlm_tvjm4 Etynr_uenoI_bDkoyer_seae5 Iwzdg_bmmtK_sFimpkd_tuvh6 Isqvl_mkwaE_ySoudey_ahiz7 Rikfe_wlxfZ_zVcahle_jljm8 Nvuvn_fzbiF_fLwccib_ksxm9 Vyzpf_ktklZ_IuaxjtbG_keKKR_qrfj Whxfx_qvhsW_FevegziN_llCSI_kujx Kjcid_mwvkY_MpbejxdJ_ghPv_hvns Tftpt_qjtlE_YdlefhyZ_rfAh_gokj Obuuq_miwfW_AanbgJ_rzPgQrJ_ngsi Bjhum_ygkeN_QmheeG_ohOoDvD_rwti Tjnlm_wpwA_ruzygc_giag Vxtrr_rbwK_nohiwu_wrvz Uspfn_yfqA_askruy_swdk Gjdyg_ZvmRdw_Ca_mebs_wxwl0 Qiiyc_XumPmt_fwie Owvpp_LceUqs_Qn_gauo_kpnf1 Brzyy_WwxOfs_Mo_arek_rjfu2 Loszl_KkdWqa_Gk_iemd_gigq3 Bxygv_PriFrg_Xi_cblx_xcka4 Tytfv_KntUgc_Nu_uvmz_xrpe5 Komww_LbjQrg_Gn_ivyg_jidu6 Ytaie_OsqQch_Ew_rlyt_vpif7 Maskm_AbhRsn_Bo_wrnr_oibx8 Bmjyj_XaiYwg_Et_uatr_rfyh9 Djmyj_TiyPcj_MPfbit_uvnk_zrxv_kmw0 Owyns_DufHhl_IEeyfa_befe_bwcu_dvb1 Poyhe_WkvTxk_JFugns_fmkr_xawy_hfi2 Xgyzi_SvcSez_BWnvcy_sleo_oyke_dbf3 Mfenj_OnhMjo_KMvdrl_fhki_jeex_slb4 Lmnfv_LpyYie_PFvgpz_athy_ouyc_oqf5 Uzkzz_OxvRmj_BBrivo_khyy_obpa_jao6 Kgkos_RzjTbn_OHufqf_jasv_myrz_xdb7 Lilrb_DenUjc_NWzfqd_rmhp_basi_qdi8 Suipi_ZtkBpv_RWmkvq_wvlo_jcyn_exv9 Cpiix_LvrPdh_KLD_vpjs_ihoq_epe0 Epsec_BprBcv_JPR_lssm_xbgo_ruu1 Limhc_WqzEoq_UHJ_jppn_iyfi_wyk2 Lwlvl_RyqAmc_IND_mswn_jsaw_gns3 Pkbhs_KprZro_WGH_hkey_psoo_vdg4 Sxfmw_OucTis_ZPD_pvbh_teii_rdl5 Vllvs_HdcRip_TZY_yuic_cwlb_tby6 Csbid_JhpOom_ZIP_myjd_nlde_nls7 Hanzn_VtfEbj_KDS_ohjq_gbov_yfn8 Hgznl_OisFin_UPT_mtep_pgjb_lnk9 Rjnbx_GdtSjj_rfktZ_iara_wnmj Okmnc_HbpKgk_caabTkl_zvuhL_wuw0 Nddpm_PtmGet_pjilSfi_jvysI_dxjo Jvpmg_TkkYvr_dlrwCii_gahiK_itq1 Ypjbp_DtaKnn_knxyIsf_smrnZ_jxv2 Fgoto_HqcRhi_vaikQmm_ljkpL_ntf3 Poamu_XwaFlv_gruuThd_obaeC_pzt4 Bvbmh_BxkBdm_buqlVnm_zwrrE_vvc5 Gruze_VvoBjm_ldliSzv_rvmjA_lqw6 Orpog_PpuVox_kmpbChy_aqpbB_ejl7 Iosjz_RvqHry_sfssSaa_mkrtS_jjc8 Uqcuu_HtuBir_chvrBbn_etgpU_qsl9 Ldgnb_HqcSca_ldgpHqf_bijbS_mrl0 Xclbp_FpfUmd_xslxBor_xijxV_fjlg Kbqsm_JfoEvi_fngpCrt_zuvlD_feg1 Eyfih_VqsRns_esrlCiy_ginrY_moq2 Knhsf_TfjIql_fivhEjg_uvzaN_ysd3 Iywkp_QzyEjm_chfeAvg_wjlzI_hha4 Bmzoh_JtbDxd_fezsUym_ruikN_rxa5 Zdfli_QouMln_roxaKes_pmsbG_yad6 Hyuuj_GvcCfz_mljfGqp_enwkD_ehc7 Fzaqj_XroFed_dajxPyl_exnbD_sxj8 Yfgae_KjjEcl_vmtmVjq_krfpX_gcg9 Yvhjr_WnyYdg_lilzQbq_pcsfLq_fjg0 Ggklo_RjlXiu_klbdSpo_aciaTo_tjfh Bfxaf_UkwZyw_qcruUbj_mqrfGr_xav1 Waigj_DjsQbk_wmzfQmh_dupuXh_ipa2 Jffaw_CjtQss_umxcIex_xspnEv_see3 Shdcb_OolPag_vxryEra_nbrgTc_qml4 Ioloy_ShfDbo_hlkrDjq_knfiJf_cwu5 Orjvd_OlnSnx_ykrsZcu_bdseXj_gxg6 Gtxhh_VbvXye_qdyxNxm_jisgVk_lzj7 Qlxgd_StfTym_erezDxo_ijtpZh_nno8 Xbieq_GpyCdn_rvpaSws_scueRw_cjc9 Ohscg_TppZyn_bdtmRsw_ulXjk_wlx0 Wdwvs_DunNsk_rsdsFzf_ozBsj_xxhj Kvnqc_UinJwe_gnybSea_loOrv_tbw1 Ggytt_RyiEyv_ryzrYjz_diIhe_hwj2 Jrdul_HleKwh_sexpSaq_mqYze_qya3 Xcxih_LawIqq_uhuiBgj_arLxx_sak4 Xpicw_ZarYds_quriVyi_tbDxs_gap5 Nybkk_HmlAuu_memiUeb_jzSuy_xhf6 Wrdvd_MavXzx_nmciPjx_neFqq_kdi7 Guhex_DksBlp_rparUud_sbNxx_ztu8 Cdevt_YpwUec_mxwbPqu_drVys_bqt9 EboNolds_eciGcyhvLxe_gkhg EbwHcrmo_hbmLddu_mzco LcbVuigw_pjgPnztw_zmxd NFE_Tzukfaon_fcm wljTgpz_DnqDnmhh_oonLcmsabip tcy_Kpc_Zbhuv_v kgc_Vaksrm_EPO fys_Tvz_rbgah_l_ldeaqyuc lvh_HBS_xvdpDypDtllmw nnd_Tis_rypri_k_dmifDm lbg_Gv_iutmq_p ibz_Gz_jubrz_v qhy_Ia_avrbx_d ker_Da_ppofk_o blsKnvn_miw_cqbIfahFsuha eboYxin_fby_cbwNiznFilv vdiDiyu_enf_tfdSrbmoUlcw mgtMuda_arp_uznQgouxGc syg_zsc_ddfx_ccir_zbeyj_yzqbb szj_xlm_opvtgsm_pdjei raf_eod_jbi_zvk kxy_bpk_pyix_vcip_azvsn_rsuu amkSdnj_oi_gekQazvHjyge hwpRrez_kj_ntnIxgqTvxc jtdUktx_vu_rinAfapqAtbn usgTogd_vy_ckkDzhiwGt kukJgoy_lo_bipPyqk cdx_zb_cjcb_fncn_znyrs_izrpf obg_ql_lykd_xyyp_tvdkj_rcrg xhl_ux_zuq_dnn dzq_ew_uikwrcg_vjsrp jxk_ic_wwrrfhve_jbzqs yam_vx_uibmbjdf_nquuk_vro two_fjmgki_fqkT_BUF qdr_aqsxgw_vbkX_swjafr rgn_ciikff_gcgP_lmell mgr_o_neo_DlukkZ_iws sbc_htedlb_mtzkQ_uaoxr xiw_yvmzbd_rcvfytq rkm_xrnbA_ajnzrfYcyFate hnv_TszwgEty_oewnhJaA_oQoxpUY1 crz_ciwujlSwtmszgzuzgEisc lzd_opdmvgDjpownuArwn xkg_ackqpnHmlocVjvi lts_xbljheKojizurdey nnd_UK_xtuue_lkr dii_p_oak_nvh pnq_u_qht_now_10Dt ywq_x_lkh_vbf uur_e_yyvb_qsf kjq_v_cmhd_zeg rhl_g_bxxqe_nhu hvy_UP_ydnfm_par yga_l_iia_jwl pyq_o_mey_vjv qkd_r_fjumm_xrk xrj_a_pxdw_jcn rwj_f_ints_bnl wae_v_JH_inmng_fos nmt_TG_AT_kny uov_UP_VY_ldw wws_ZV_XQ_qob kjq_HP_NV_yjd vbq_h_oie_JFR AVA_Ajrxdqck_PXeinih EpmLejho_Bqif_suhsa Svmik_Nic_Apam_koeruJdncHlsm Xcteq_Nhe_Rqsp_mlnxWrdzZqbg Qdjyr_Slm_Jcny_pogcfcBdcdTtqx Uqnkv_Upr_Mfsz_drszzSvchgbOcns Pnbpf_Ahm_Kxuy_yplrkEgba Klysc_Fna_tgtcOnbgg_glevl_hsb Npbxs_Zzs_Habf_mpvTuvvnul Wifkt_Eha_yomfSqblh_yrng_snj MmxtrRcj_cjpwB_qTthgl HqdxoSqs_qevkC_mYurfud RQA_Kmnqg_Pncl Qqbt_wpaOie_qpd FphzlTgu_cxaQ_uGkjfi HbsDlgxu_yjhMtkbog_sEnolc OruvhLud_bevyeAmG_fu2Ffsv_ozeiW PvxtyEah_qjkdtKbH_mt2Aowe_xganS Brcrp_hnvrW_enxfek_VaiuCvx /end DEF_CHARACTERISTIC
 /begin SUB_FUNCTION Bx199_bCmr_yzyym XOTG_VnUetcd.Ssvvslwp1 GUES_RsEeyca.Olddxdks2 DAIY_GqXdjjr.Mvchmiak3 KVXF_UfYtmmw.Utplmxak4 Fo11_Phkpsvtreyiubjvy_QP2_Y MAYZ_EM1.Zxhkxitd1 RBNS_GG2.Qnwipofh1 PROR_FW1.Avejagnu2 OCID_RZ2.Vnkoyxps2 ZALB_KS2.Xwwheldv3 KADA_yocnioiudgo.Hnwqgzep1 GHPI_roweeasiplf.Hkmxccwa2 EKWA_afmdcxcbrdt.Ufggggbj3 YZYM_qgkuqqbuwmu.Mfjgtgcr4 XZQN_asugdlrgsgu.Ogreoouz5 POWB_eqlmurhjwqj.Qefexvuh6 GOUG_GF1.Abdphdho3 BMLE_WS1.Jwghhlif4 /end SUB_FUNCTION
/end FUNCTION
/begin FUNCTION XOTG_VnUetcd.Ssvvslwp1 ""
 /begin DEF_CHARACTERISTIC Poagh_Wmp_tjnyipbpAbpkj_ojeh Wwmda_Ceg_xplmkpdtSdkyg_xril nnd_UK_xtuue_lkr tceSbh_asallggcRV_ggbSkhmAnz /end DEF_CHARACTERISTIC
/end FUNCTION
/begin FUNCTION XZQN_asugdlrgsgu.Ogreoouz5 "" /begin DEF_CHARACTERISTIC rhl_g_bxxqe_nhu qkd_r_fjumm_xrk /end DEF_CHARACTERISTIC /end FUNCTION
/begin FUNCTION YZYM_qgkuqqbuwmu.Mfjgtgcr4 "" /begin DEF_CHARACTERISTIC kjq_v_cmhd_zeg xrj_a_pxdw_jcn /end DEF_CHARACTERISTIC /end FUNCTION
/begin FUNCTION ZALB_KS2.Xwwheldv3 "" /begin DEF_CHARACTERISTIC lzd_opdmvgDjpownuArwn /end DEF_CHARACTERISTIC /end FUNCTION
/begin GROUP AAZ_NQH.HWA_M_Nclotka_RuaMzd46_Rhvwsx_ACQ "" /begin REF_CHARACTERISTIC WFV_DYT.VFK_D_Ebggowr_TqcLjh46_Wkbbxl_SYL /end REF_CHARACTERISTIC /end GROUP
/begin GROUP ABH_ZZTL.TSS_RQFV_H_XeegdePyeeqkzhpjytlxRrsdcjg_5 "" /begin REF_CHARACTERISTIC OTQ_MTTV.TEQ_SUBP_O_DpoptjNsbcumvauymiorTubvngp_5 /end REF_CHARACTERISTIC /end GROUP
/begin GROUP ACQ_IEAM.KEJ_HUCM_R_LEN_IYF_VZG_DvtCgoVopQwpe_Nsemkt_UPF_Dht ""
 /begin REF_CHARACTERISTIC DUL_EPOP.UTZ_RJMJ_U_XJZ_ELL_XCS_WduZlySjbDlno_Pamnko_BEX_Juy /end REF_CHARACTERISTIC
/end GROUP
/begin GROUP ADF_ZYKS_KJL.NEF_YTQN_GSQ_Njl_ZvoAlczzpbl_RlPbls_KQT "" /begin REF_MEASUREMENT JLQ_YWKM_CVN.QGU_OXJX_IFI_Uel_TnoUrjsudnk_NtXpgr_FOL /end REF_MEASUREMENT /end GROUP
/begin GROUP AFP_ZXAH.BHF_CFOL_F_PrhGhv46_XFE_Ceuham_Ema_K "" /begin REF_CHARACTERISTIC LFI_RSIG.RRK_ZCMJ_D_MrwSag46_KRV_Somgej_Olm_J /end REF_CHARACTERISTIC /end GROUP
/begin GROUP AFW_GYT ""
 /begin SUB_GROUP SJV_SYT.KycxfchqjbeSfdueeismn FCM_SGD.WfhyQlwirqnQvnvm ZXC_EOX.PzqSrqehkzqHphgjopi /end SUB_GROUP
/end GROUP
/begin GROUP AGA_GCQ.XJT_R_Dtcesbt_TMXGcgz_VML_NPQ "" /begin REF_CHARACTERISTIC DQR_ECH.OAR_Z_Hjinccl_PSQMpdn_PEC_NZV /end REF_CHARACTERISTIC /end GROUP
/begin GROUP AHF_HDT.VG_AUA_LRQ_R_DqqsfleguOwf_Cbjgs_Rfk "" /begin REF_CHARACTERISTIC ZVH_UDB.XW_MPL_ZWA_I_RufvwylchFsn_Jgkeq_Jlm /end REF_CHARACTERISTIC /end GROUP
/begin GROUP AIT_KUQP.FOX_QweVObzf_UMG_KDH_2_gvzgcipsn_3c9ya106_MdmujsHqxn.WCS_WasMZgpg ""
 /begin REF_MEASUREMENT EIH_LCSH.UKB_KkwXWqpo_TTM_ZUA_2_piexghggh_3s9yd106_NpcryfDckr.RAN_AekYWjkn /end REF_MEASUREMENT
/end GROUP
/begin GROUP AIZ_PQX.WSJ_M_LueIsaWsbkJxa2_Puneyn_VZG_dfb7k803_It_VxJweslzlaRccv_FUI_LBBL_TZ_LuuireaawYHW ""
 /begin REF_CHARACTERISTIC WDI_SPI.AAJ_S_EvhJfdEhrfIot2_Ggyvxj_TBF_zul7p803_Gq_OmYrueparkMrzd_VWF_DWOU_RM_OioqpyfbzFBT /end REF_CHARACTERISTIC
/end GROUP
/begin GROUP AJA_CBRB.ROV_ODZX_W_XhfgGdgTonf_XYDH_HW_Cjhaoj_Icc_X "" /begin REF_CHARACTERISTIC EKT_YYRM.OWJ_NHZN_B_EnpqGccXhrl_SDJM_BM_Fwirbr_Yon_N /end REF_CHARACTERISTIC /end GROUP
/begin GROUP AJY_MAQ.YME_100000039 "" /begin REF_CHARACTERISTIC COC_JFS.SMB_100000039 /end REF_CHARACTERISTIC /end GROUP
/begin GROUP ALZ_API.AGT_NVT_IrulYQBTUjjvWpnaFwtnAhp_Wjpgfd_HtFY_SKX "" /begin REF_MEASUREMENT JZR_LPC.ZLU_YCC_SbbdYJAYPvirEczdOedlMyr_Waewhf_GfFZ_YVE /end REF_MEASUREMENT /end GROUP
/begin GROUP AMX_AJW.ZSN_X_Tldflgn_KdrtHEZMKqezVnmaDzaiWzo_Rrfzde "" /begin REF_CHARACTERISTIC SAG_OIJ.HNH_A_Vpmhsjo_LqfwIOAKPnbwEctkDruqSqe_Yuhqos /end REF_CHARACTERISTIC /end GROUP
/begin GROUP APV_IENM.TJO_MLPF_I_EjiRjt22_RXN_Dhdheh_Tfc_E "" /begin REF_CHARACTERISTIC SWP_QMNZ.OKE_RMFV_N_PcuAjy22_BYH_Imlhld_Wbq_C /end REF_CHARACTERISTIC /end GROUP
/begin GROUP ASI_BGGI.YRA_EFWP_D_INB_DHA_FPZ_OVP_I_UORDKTUMUJ22_AWKCBL_VEGSZF ""
 /begin REF_CHARACTERISTIC LKO_GKWD.GWR_XOAM_P_QOJ_WNI_BMA_BCL_T_PFLRLTTMUR22_ORKICF_DOUQJZ /end REF_CHARACTERISTIC
/end GROUP
/begin GROUP AUJ_HGD.IPS_I_WomcZsqTm_Jxpgjj_QYX_w2ed9577_Ex_XgKwfpsihlUpjy_WCA_UNO_PyuzgfmbuEEY ""
 /begin REF_CHARACTERISTIC ONZ_QPC.KGS_I_ZugsDcuSo_Podezm_EYH_u2nj9577_Aq_PuTnuamkxdNdij_IYL_UPU_MfoyylsopHJJ /end REF_CHARACTERISTIC
/end GROUP
/begin GROUP AVO_QFO.SpvnvbdtbiiCuvuireeic ""
 /begin SUB_GROUP OPU_CYH.NBJ2_OZK_100000271 MTF_FGO.ZIO3_AMW_100000271 CYR_HCT.DGH_10000027K UNJ_LJI.JGJ_10000036F UOW_VOO.TOW_100000370 XPH_QKK.CJYH_UjckZcmmklvn NMJ_GNL.YUWN_10000003I QSR_SDU.YONK_100000042 ZRD_JBL.RLJN_100000054 BEI_IZP.GCKA_100000270 LHL_CQC.VASR_100000369 RIX_CCI.KHYO_10000051J NCV_NDZ.QDQR_WR_10000003O PYC_UDI.PHAK_XO_100000042 LNU_NGH.FKDZ_IB_100000054 UWM_QXE.NUDZ_OD_100000270 ODY_TNX.ILNG_XZ_100000369 FHW_YJE.LVII_JH_10000051X CYB_JQD.YUD_10000036M ZZI_JEC.ECC_100000516 OAE_XET.DBW_Y_10000036G VZR_XHE.TBW_F_100000516 NAP_SUE.IJHF_100000271 OGS_XHA.SMXZ_GAD1_100000271 QFE_GUQ.ELTBXe_100000054 XFA_RFI.VFA_100000054 BFZ_IMV.VPA_1_100000054 GHE_GYH.PKY_GicFmccbbtccAlsm ODQ_BRM.LLX_10000036X UBY_OYY.UCT_100000516 AJY_MAQ.YME_100000039 KLV_VUD.WDW_CV_100000039 UKC_RCZ.RSI_R_Wlpcjrt_QY_17 KMQ_AGY.HNU_T_Bjoaqzz_IG_18 UKF_WSC.PAF_G_Pilqtfh_KG_23 HMW_NMF.JLW_T_Fjdgeft_KW_30 LND_DBD.KUF_L_Rpxvcsn_VS_58 UPH_OJN.LBB_EiyNtytCec_DGXzzxkYQ_Ea_Vpuj KGP_FHF.TRE_OngVbcuZgi_EKNwrukVE_Ne_Jqes_Xzs CAB_JXF.NVS_URV_LKP_CUR BEK_AMG.GHP_RGI_QQJ_EDE /end SUB_GROUP
/end GROUP
/begin GROUP AehaKdcxwxhiotmXod.rjiciatzg "LP Gedsuf"
 /begin REF_CHARACTERISTIC PvbjNmnwmqgafeb.WfwqztJeprcqAsbslhsy GjvbGkhvmnljxsn.JjhpPolndawvqIjwnplwyzwYwliiScll JuwhUpocnmiomcy.CtxxkJmGycwr BhctAuqhmvdczcn.AlakaamWtzhmmylIlrgd RbypLxtmostukcs.IjcdqryzKnrfYzbJkwwMcndcKbvq FzurXptqudjoiiv.ItqtjjobVxgzEbtQmkgqMnssbBevz YkjoVfrvkvhfqlp.CyqrwucxBqkyRosGkohpLjft FivtHptwnpoufuv.BgrpprlnMvemBwrVfqiSdtiwKfqv AcwjCgaciotznxr.WkeqcqotAejbRmyNyrnmMrlhnRtye /end REF_CHARACTERISTIC
 /begin REF_MEASUREMENT FkbjCuqjqldppry.EbrqmkNgyxucQamhi PnjbGbboesihyrs.UozcetHimre KnznEkxjwcahcct.TJJUU_Ocwej UnhoEfsuytqvcge.VrlrkbqLobwcxuLphyb BjktTzkdczlcrtf.XnwoXljaeucjEsbj HdqfDdmkpebrjmu.XyQiqzOxjlGkdgsSzfQn LyavShfqinmvhxh.NymeowhiJicyMkgtt /end REF_MEASUREMENT
/end GROUP
/begin GROUP AgfifpoZrqeqzwy.qcflfjfyx "TM Abdtps"
 /begin REF_CHARACTERISTIC IzrboknDzhwjjqvHqucihdqz.Mwp_Yqzsd_KsaqujkZfhcmvhn OzisyyaLuelvbxwTkwtbaeij.Ddd_Uaqft_HrrRmtpjAfaqe_vq ChrkhjbQezunujqRlmhnzdox.Njw_Nbceb_QjwObqdy VuzzmasEctwrdkcEknpoxjob.Ruz_Rkexd_GbgiKmiji /end REF_CHARACTERISTIC
 /begin REF_MEASUREMENT OfsofkzSiurhhbbJfkxwvrja.Ejl_gIgnxq_fdwtlvjf /end REF_MEASUREMENT
/end GROUP
/begin GROUP ArxgudbjAiajfbikr.kopirfocw "NO Moaalf"
 /begin REF_CHARACTERISTIC NetlwbewZmorjhbcn.InlpqivGwhqi_Kurazpl JhhalsktHrtqgxcvb.JwlnGxrqrRdyzfcu RrhfxsqyDzrnpymje.WwbpvunlPyxullr ZdnqnptfHwdeigzuw.DddzhugfeaEoudzut YadptstdHrzxolvgo.Fnjytooqeb_GzhFdgdvhot WyhpasvaBnltbzfym.XJUAKTZ_NQIRCC_PFIDK CeajbnhrCkbuabbhe.bEqiHlqjpEhlvh_Qynmhffbl_Qettij AcqzgpuoJflnjtvgk.lIbcGjvgcLqnfo_GinBfxGvqgqm /end REF_CHARACTERISTIC
 /begin REF_MEASUREMENT GjqhnswtGcixjrgbl.PzvjiVvtwmxmbdWdbvz BdnppeqzTqwfsprap.WnspluiFdvht_Tmrngjo JkvxhzcnYxwnsibvu.Gnmgnbosv_Cdrdtev WkdwuedhOwnjbeobi.Dkzjxvzm_Lkvofup NufxoyxmUqfqbhbav.BdjdyxfagfTqhXzckwabp OfkblkrfIageailzk.Fnmvbyxkxd_Rvjgqek /end REF_MEASUREMENT
/end GROUP
/begin GROUP AsjHhhesa.LYWBN_YTV.TtbtlwhlmxNfxor "" /begin REF_MEASUREMENT RjkGbtpig.TFKYE_PKC.QrdgdxsakgSlpml /end REF_MEASUREMENT /end GROUP
/begin GROUP BBX_FJBM.OQK_TAHE_L_EcvzfhHastqmrucprdxyCrxwolo_9 "" /begin REF_CHARACTERISTIC TBY_WISU.CFL_RLFA_U_EycffvLggmqvvyitrsfuMfzngbn_9 /end REF_CHARACTERISTIC /end GROUP
/begin GROUP BBZ_SAA.DSV_S_NhqSac14_Jllbpx_XDY_89k22kqp_Zt_BoHlmxzmurKwso_ZYX_EOLV_WM_YywaytvewPEL ""
 /begin REF_CHARACTERISTIC RKG_HVR.HWI_F_HmtSmu14_Yagvcr_CRY_89x22ygx_Ml_GeIyhlewtrAete_YAQ_SFKE_SJ_JwomvozcaWDE /end REF_CHARACTERISTIC
/end GROUP
/begin GROUP BCS_GWE.YNV_YTL_GjyfqjxhWvvbnww_Rfi_IOZ ""
 /begin REF_MEASUREMENT RSV_ZUJ.FEA_CIZ_RcsvderbWldnytg_Kcz_FAA.HNW_CNH_TjbchhdqVbbdrqq_Wji YEY_RBK.TAK_LDP_PdymxrngSzcdxnj_Hyt_OEF.HRA_ICW_ZkhvytpqSbdmfat_TqmoUztpx /end REF_MEASUREMENT
/end GROUP
/begin GROUP BEC_DUC.UHM_X_GaemYxvRwid_Aezfac_FRU_r2grbl9k_Bh_HtBwywveizYptq_IHO_Rpdeky_DmjbvsblwVEU_1_Nxq ""
 /begin REF_CHARACTERISTIC EUA_BGE.HGU_O_SkapRuwDtrp_Tmhigh_EYH_t2jrkc9z_Df_LcXjtgxrzwBnfp_IJO_Izfmxx_QcexnriuuATF_1_Wwm /end REF_CHARACTERISTIC
/end GROUP
/begin GROUP BEC_NDWG.KOH_XCIG_A_NNP_PXS_ECY_HPT_GINMSJZGVMQFDDUXPABBC_UOQNOCQB_JZUKJN ""
 /begin REF_CHARACTERISTIC DHO_ONOX.FCP_YJBP_I_LQG_NDQ_JDL_IJH_PTFXKGMYYKGUEBFJLFJMW_DHLFNKJE_UQWBHF /end REF_CHARACTERISTIC
/end GROUP
/begin GROUP BEI_IZP.GCKA_100000270 "" /begin REF_CHARACTERISTIC SSF_KUV.YWEX_100000270 /end REF_CHARACTERISTIC /end GROUP
/begin GROUP BEK_AMG.GHP_RGI_QQJ_EDE "" /begin REF_CHARACTERISTIC AVC_LNT.KUS_PPZ_TYI_UFF /end REF_CHARACTERISTIC /end GROUP
/begin GROUP BEU_JNCS.SJW_INMY_T_VorAys17_JBAJ_Efhvsg_Yxa_E "" /begin REF_CHARACTERISTIC ZRH_FKIP.CNW_NSUR_Q_CgpNcv17_UIBU_Afcawa_Ewe_P /end REF_CHARACTERISTIC /end GROUP
/begin GROUP BFK_KOM.HUQ_CVUQphr_17_ZnumswDnhd.VOD_UIOLfqa "" /begin REF_MEASUREMENT WOE_MJL.UAI_NPUNmvh_17_NumkvpMxrt.TWG_XQVEmie /end REF_MEASUREMENT /end GROUP
/begin GROUP BFZ_IMV.VPA_1_100000054 "" /begin REF_CHARACTERISTIC YNO_OHC.NBY_1_100000054 /end REF_CHARACTERISTIC /end GROUP
/begin GROUP BJB_BEHN_ETU.PNE_ZIMA_NDZ_R_YjuVfdliUyhrdOdjs_NcxpyrCrafz "" /begin REF_CHARACTERISTIC ZJM_PZHU_LHO.CRZ_CRCC_RWR_S_DmoMlyntOcufcDbjn_JwuotnJltzp /end REF_CHARACTERISTIC /end GROUP
/begin GROUP BKQ_UMOT.MUD_LVVK_Q_WluJqh16_WTUW_Ytgjxd_Kjx_T "" /begin REF_CHARACTERISTIC ERY_OGCV.KRM_QLUH_C_OcbWvt16_HPWJ_Fijftv_Bon_O /end REF_CHARACTERISTIC /end GROUP
/begin GROUP BLG_XGD.RTR_FNZ_ZBV_0r0272_Ndzkgz_IAR "" /begin REF_MEASUREMENT VSW_RAA.OWY_XMW_PNP_0w0272_Vmbpse_OIP /end REF_MEASUREMENT /end GROUP
/begin GROUP BMH_UMMM.ACL_WYLB_I_WQG_VNV_SHE_QSO_LIMDGZMTTCDUGDYGT "" /begin REF_CHARACTERISTIC YPX_QZAM.YHY_HBIJ_D_TYZ_DVX_FRW_ZTN_PFGXWNQFKVAUNECID /end REF_CHARACTERISTIC /end GROUP
/begin GROUP BMJ_RZOX.FCB_XXYI_D_LpdpStiUfmc_DUMG_Uqjbfw_Jeg_Z "" /begin REF_CHARACTERISTIC AGY_AVKB.REV_TMMM_K_VcvtTovXizg_QYWC_Nzukij_Iie_R /end REF_CHARACTERISTIC /end GROUP
/begin GROUP BNB_NOYU_WOK.ZluZivjhwhsFnnuidxo ""
 /begin SUB_GROUP ZYJ_ZKUM_CFI.OCS_UQJW_OXC_Trgt_NsfUkpnviml_HwAgpm_FTE UOC_ANYA_HUE.EUA_ABJU_UIW_Otve_LqlPzbpfls_DoGaab_ODF ADF_ZYKS_KJL.NEF_YTQN_GSQ_Njl_ZvoAlczzpbl_RlPbls_KQT VPM_GJHK_NUT.SKB_DGYY_VYD_Vyo_XngLccinru_IwJwif_OTA /end SUB_GROUP
/end GROUP
/begin GROUP BOJ_CNKN.GJS_UNSJ_U_GgbNte16_Ixpqfe_Dwx_B "" /begin REF_CHARACTERISTIC ART_UQDI.WJG_XSYX_T_YhaNze16_Liyzrh_Stn_Z /end REF_CHARACTERISTIC /end GROUP
/begin GROUP BOZ_KQR.KXX_NOG_QujUyo17_Zvbepr_TdFZ_MUN "" /begin REF_MEASUREMENT MGM_QJP.CPJ_KYK_WnzSwg17_Ibixfd_GdCC_QWU /end REF_MEASUREMENT /end GROUP
/begin GROUP BQI_ARPC.JFR_ULWT_H_ZzabOhfHscr_EBGAWm_Xnvxaw_Etq_M "" /begin REF_CHARACTERISTIC JHW_KUJK.ABI_MWQQ_N_RwnpWtoSiqk_HDFIPq_Nfxljs_Bja_Z /end REF_CHARACTERISTIC /end GROUP
/begin GROUP BQX_KJBU.YQW_LMMZ_W_BMR_XbvPpsogHgjompsln_ZqfycbKjsdvuvbfpsljt ""
 /begin REF_CHARACTERISTIC IIQ_IPCA.JRF_GDRZ_Q_SYJ_EpbIgsduIipbfgxdf_YctcuiFagiypyrqlvpll /end REF_CHARACTERISTIC
/end GROUP
/begin GROUP BRC_AHAV.TbknrjylpoiVlohpmdktr ""
 /begin SUB_GROUP QWE_DYFN.PTZW_DSL_Gpzx_TuundjhglveRfbmk_10k RVG_LNNM.ZWON_WKX_Vvgy_YbeixkgsfpxMwysz_HfpOnf HYD_JTPB.QCR_OFEP_B_OglvDEWVRiukHrncApfxWho_AYK2_HFT_Ytaepo_Lwk_G OTU_ZKLW.HJO_CNSY_Z_YnibKUHVNtrgXbqsStupIoe_YHL2_CTP_Fqfppw_Axc_A GYI_XEIF.YAR_DRBX_D_LzibUURTSftgOwhpRlcvApn_OHE3_XPM_Wtteqm_Ydt_V ZTA_VMOH.DNO_BATR_L_AogoHXKBEzwcDcelHrtuXum_DLR3_GCL_Irrmcu_Vff_H JAP_XOJK.PQB_KBLR_H_BomcMPZCRfegCsgtLpuzYmt_BWSQ_UFZ1_Tibsqr_Tzq_L MEM_IIYG.GHS_IPLR_D_AhviFSDODmmnBybkYmtpDrk_QLJW_BKE1_Apdkje_Czb_Z DWV_GWAT.JCT_ICRJ_L_DuyzZZVJUtovTttlQkhkTfl_YJND_Wnsgys_Yul_T PQC_LFMR.YCR_RNZM_R_ZlrlCQHFQscpYdekRpefHye_FORS_Ipredn_Mdo_E KVT_FGAP.RTD_TMKH_C_CqmaNepNrrEmxz_GAX_Tdzies_Eof_D HFQ_CUNR.TWH_XKAP_U_WhnwZajFahWhmr_QHA_Rhnhic_Snh_H RWE_BTYP.SVJ_YQXF_I_OfxnUreRruUqjd_YZK_Enavou_Eaj_V LYZ_VDPC.WQU_HBFC_B_KfdkEtmOqxNwuu_HMM_Knvnai_Hxk_T ORF_GMIU.LCW_MTGN_S_EmfJfeKickPmt2_CAGE_Eehyan_Usq_U ZUW_SAXB.KUT_AMGR_X_SqvIrkFwsbNcz2_BUEZ_Qntymb_Ybn_I QDL_BIGH.FRZ_XRWE_K_SulZbrXhxsYwn2_Iieyny_Ahx_M FJX_CLKM.FVQ_HHOQ_I_YcoMbdUwqjHyt2_Rinkou_Ion_U OHK_WFOO.DYV_NKVP_X_ZAK_FHZ_AHK_JOB2_OPZ_VQPWWAVDIAKOBQCIXGEJBNXCNKNIBKWFUUCXTLJVLK_CCNHLY_NNEBST XUM_YUXM.ZZW_LGZJ_Q_OEZ_CVD_TNS_ZRR2_WVH_TGNRVDXVODVRHHIUQ YRU_XAYU.IYA_YKRJ_Y_CSX_XFY_GWJ_SXT3_YIY_NSMPRNCHLFQSCAZPYHYJXMXTYBJEOCVYTGAFTBTOTH_HHUPKE_VTOKGP ZLO_BEDU.FDA_BTEC_E_DOD_KPE_PPS_LVT3_OEB_DZPUSHGYAUDVXXVTB RLJ_KGRG.ZCG_ZHMD_I_WJX_CAD_ODK_UFT_ZHOTOGZMHELIAQRYN GGC_PNVQ.RQC_JRPF_C_JXB_BXW_KHF_IRW_WCMDGTEQWK2_WMDRGF_BLFZYA GZM_MYTL.YUP_PIYN_B_HFQ_SHC_UCK_RHI_TZZJOVUYGQLVZIR_QTHWDV_OMHXLA PGT_JVWS.VGS_JRKX_N_KPN_UTZ_CNK_FYM_VRWJKQFPJURMXGO_RQTTYYLC_RCULJC FBE_AJZS.FKI_ISOY_H_WXR_VHR_FNQ_MKW_ZVGESNHZLTZSZUSCQPQEP_DJCZKQ_NQLFUQ BEC_NDWG.KOH_XCIG_A_NNP_PXS_ECY_HPT_GINMSJZGVMQFDDUXPABBC_UOQNOCQB_JZUKJN BMH_UMMM.ACL_WYLB_I_WQG_VNV_SHE_QSO_LIMDGZMTTCDUGDYGT YLU_RNJS.HOT_UJXQ_O_CZC_EXN_NTR_BPNT_FT_FAQXTEVRHSPTBATKNIGNIW2_WKIQMM_DGDCGF HIU_HWCG.BGH_SADE_Q_CFL_OZC_OVV_NJHP_ZT_SZCLUTEWMHWYCXHKN DXA_AZCK.AWO_FHBN_E_IVX_TGP_IFB_FHKO_GO_MPMBCDQCJY14_ZBECGG_PTGGPH IPW_HMSY.DGN_CCVJ_P_UDI_JUO_MYU_ACPH_HI_QZRQGFHMDUCNPPHNDDVXUCYA_BURHPZ_FWKVKV EIL_CSTL.ZED_FWGA_U_ZBY_COU_SIA_SISI_QSXAWYQZPAWPSSSDXTBKETUGOLTE2_WZCMTJ_OOVFPF MSF_CFIN.OYC_VBUV_I_PBF_JMK_BJJ_YQMH_FKJKWCHNBCSQXISCVYDPMX2_OPAHBZ_LLHKXE KLB_GJNN.CUY_UAHH_P_XMF_GKA_AQB_FZNM_KKOMXXHHOFMCTRTWJ YPL_SRCZ.SRL_ZNCZ_S_FFO_IWI_BST_XMGF_YHEFDCMXDW14_ZYIOPX_LHQWLD JZP_BJHJ.WYO_GZKS_O_DKV_BLO_BQT_CIIM_CHAZZZIGBJ16_JZIEKL_IURNZJ WAH_QIVU.HXP_BKDN_A_KZN_FUF_CBY_SGHI_WCIPNSJJNI16_ETALDAKA_WTBIWW ZGF_BYYN.QJZ_GTBG_E_UBA_IIX_PXE_GYZG_YNWYIOPZUN17_HZHLQS_UVNYDI GHO_UUAC.FMQ_SSXW_H_HDX_CBV_UIK_PEDH_MNXRMAYSTH17_MIKSDZZT_PKASWN MJJ_DHVK.USX_TSCX_L_UCX_IDF_ETI_JXGK_SWXZQQDJAIVFCLLWGZKBTSFD_YLLHPN_WGWRVV OSZ_NBJQ.NAR_XIXF_X_ZYO_IQH_VKU_SRGZ_EDGXLIUVLBRBOBPOKYWLLTSP_XZJTQAQM_VQHMYK FID_WUQH.EVI_JFXH_C_MVY_TNH_QNE_FLU_FDCYPZYAAOZRSWYRH WWG_ZLEA.CAT_XNGJ_T_WFQ_BDO_FJX_VVZ_TDUCPQERUN22_NFNQHQ_VHWCTW XVR_PYDN.MLU_XYTB_K_XKA_FVM_KDM_OVG_RHXFRUQGVJ22_IXMHJUGF_GRPSAJ KCQ_YEPQ.EBX_AYAW_S_VFW_AGR_WRA_FQK_FKWCFRAFNRSTR_NPWJOV_DLQNBW TTA_FUSN.KCJ_TQCI_D_NOM_QWO_ECS_ELQ_JKAQEAAOALNHM_QVHXKIDH_KFBVNJ HZJ_AVTS.WHF_GHKP_T_DQN_BXK_QYK_LHP_D_TIBMPAJXPRHITRKVE ASI_BGGI.YRA_EFWP_D_INB_DHA_FPZ_OVP_I_UORDKTUMUJ22_AWKCBL_VEGSZF TUI_SJHV.JCU_FNMX_Z_UNZ_CLM_WCN_DJJ_U_EYFJDDLVAM22_RRBNTOIP_FKKJNR TZG_KTZE.HTQ_GHYA_R_FEJ_NMF_NLB_CCO_B_TDWGSYYVULAVN_CDINMI_NZDQKV UXP_UMNL.YMY_EZDS_L_UXA_QEW_ROT_QBC_N_XDORKSBWTKUJP_SXCEYTFV_CXMOIC PLF_RDHK.XSV_FSHU_H_GGK_HYB_YID_IBHM_NBYYXTXRHBEJOVSOYNZUUQZFBBSTNANLIOGKYEWIAL_PQVWCE_ZZDUNO ULL_XJUJ.AFS_YVXG_R_WMI_XBD_NEH_JDDD_LSG1_SAEJWCBNENEDYCYIXJSIVLJUXUGVPEEYZAIOAYKCFZ_YVXLBQ_DHGPED ZKV_SMSN.QBK_TOJO_B_MSF_ZSE_FST_DTMR_ZOD1_FEXWIOUMNNUIWJAEO OJJ_BNEM.MOA_DXAF_S_CQO_EYX_JRI_YSAR_KGOSZJHOISTKPMLDH YUL_TWCT.LSY_MGYQ_Q_ZPO_YPI_DEO_UCWHGs_HQZYVHPFKGGRWMQQP RMP_XBNH.RLC_AOWZ_M_JKF_LKX_KWS_BVIILv_ORGAUVYENOGMEBANUUIGJHBJ_UMDUCL_PDCUFJ TQP_CWQI.DGP_CXFA_L_UTI_BDJ_QSN_UUGAUx_PAXASCWFNMAOQEPFUFMOYWAX_LXRLCJAW_DHPDCL TCY_NNFR.AJX_ERKD_L_FUE_DBF_UUG_MSE_1_BRAPFNCUEVSKXMNWA PZK_VTJH.VLF_UCGN_W_OVF_UEV_BWM_FCJ_1_DDEZHLDQBULSHXKCNCPQZDDF_DLHQPT_CUKNQK MHQ_JKVW.QOH_RZSY_G_RCG_ILJ_CHA_FEY_1_AFEMLHZCYDAYTTVCHLLAVTLS_WPVTLDKX_TKUXMK BXI_GGWA.QHV_ZRIL_R_RYQ_ISW_YMM_WKF_DVLRRUBHYBPJKUPNU DFU_NMJM.PKT_XGBJ_A_FXX_CPO_XOX_NMB_DNDYTRYEJCMMZMTUVNTEBOMT_BRZXKF_AJAZIE WIQ_UYVR.PUK_YREK_J_QNA_AET_WNF_QVK_CGDFDAQCUWZEORKIBDBHFFNR_LOSJMVOR_ZCADHD RID_TLEV.YZI_OIPO_X_CFO_BFW_MTK_GFN_OIZJNPGWTEXYGQXEP QGC_FOAY.ZVP_TXVV_O_GOX_XFH_QPC_OHO_BOPOCWWOTI22_UUPHDP_PLTNKQ IYX_QNID.CML_PQWE_B_YIB_KEZ_AGB_SIG_NGYBVFCKMQ22_KYZCSQFP_LXVQFJ BVG_DZKW.HMB_KUPF_C_HBM_OIZ_XXN_XMK_YEHWJTEKACBHA_RZPJSI_UHBXMX VCB_CXCM.BVG_WPYM_I_PYP_AQD_AYP_XHQ_DYEVVIDWOEFCX_GPJTKQBC_WJCFEA CGK_KESB.XKA_WJCX_Q_PWP_MKG_SKL_JQT_ES_NLJIBNEBMMOPPXRHV QLG_TOTZ.GPU_RDYZ_B_HUM_TRR_AXM_JRL_SE_VEWQIRTXVT46_XTZMDV_KNKEXY TNS_FMUF.RJC_PECU_T_EKZ_SCA_ZUC_ANR_MMBGXXHDLHAQQKMYZ ZQQ_UKMN.UQT_KUXH_E_MRR_OUS_RJI_HFY_RKCRNFGYPU46_AWKDJZ_XFEXDE ZXF_EJMR.ABZ_YLOK_V_ERW_YKJ_XWP_SGD_EDJQXKZMLS46_MNKJOMYT_XRUVGB KGG_WPKF.DQO_KBKE_J_JTR_BED_UHB_BJB_PKZPAOMNFGLFFBJZK FBU_UHOD.MXX_QUNX_Q_JIN_PUS_GNB_IxatDTXAJiiuUnenHdlbAuz_Jfuaxf_MEG_Tgt OCZ_BHUP.KEL_OIAI_Y_ZCV_FHE_HGD_RgvdIIPCCuguHkrbRrczKhl_Raakyn_SXC_Xqh RSP_DEEM.KHR_CFXB_I_LVD_HMC_WMY_UtfoQBSTIiyhVinqSvtgQmu_Nnodns_UHY_Sdx RQJ_QNNY.NHY_TCFB_I_FOB_ZVL_AJP_DmiqUkqXjzNdis_Icbowa_ELW_Tnp SWG_LAGO.MFN_GRFC_B_ECY_JPM_QWZ_BvvqSruZiqJdyp_Xsjawl_LAV_Mia XMA_OHWJ.VIS_IYXM_D_QJW_GID_BZG_TjsKlaOfuzGgt2_Rkgdgg_KCT_Dpt KXK_ZJBC.LVQ_KFNL_Z_IGE_OAT_CGM_QbyJhaCcpzHyh2_Nfmiyn_SEA_Pul SNM_RDGH.AIL_HCLG_D_UIU_XKJ_QHS_KceKnnOzzeGmk2_Mhvwxn_TCR_Fca IEU_GOAE.LEC_GRVS_Z_CNK_LOA_VQN_MLWJPuhlVzcv2_Bywtaa_TKK_Xts IIU_YHTG.EFW_DLOO_G_VBR_MAP_ZYO_KDOXGyciDhhb2_Zeucgd_TNI_Ykk PZF_PCYD.IBC_IFXK_T_TBT_QFR_IGC_YMRNQdzhCcpr2_Jgrlom_ZTB_Nxw ZTA_VBSI.XVN_CGHT_L_NIT_BWU_AHN_LlnAkz14_Lejkfp_CJY_Psz MKH_OQSS.CDL_NOYH_O_UGP_VZG_GYZ_CumXov14_Vnglnc_KML_Ipy YVP_QHZU.NIM_MXTQ_I_SVD_HFU_ZAW_WmqHfi14_Jiixsj_OPB_Zvd TSB_GZHC.QPW_RPUM_Z_CZB_JMM_ZXV_XxsPwa16_Esmvfz_FQT_Tnw WSR_ERDW.JPY_IKTH_C_TGQ_YKC_JBX_FxjAdw16_Yrfybb_UKT_Qls LUY_ZRPT.FRM_HGQT_T_SER_UDN_KNU_LbkJwa17_Ykpsbg_PPO_Yvk XJP_LAKL.QPT_IOES_G_JUP_PUN_BOP_MyzIaz17_Vcabej_IXE_Tta WJQ_AWLP.AGQ_WKVR_A_DOY_GRP_OYA_VxzRwo22_Mrtzca_OCI_Jvl WHS_CUKZ.CNH_MQET_V_YMN_YJT_MCR_OfmDkv22_Bzlhbs_ZBN_Jey CAW_AOKG.WRU_VYUL_D_IYO_OLY_VHD_LoyCqt2_Okdccg_CCQ_Umb ZNU_BQCV.KLL_QQHX_A_YUK_MEA_STR_FdjJzc2_Shvfcp_CNB_Qhd SHM_XPCU.BFN_SNFF_R_HTH_JMJ_RDT_JlqOpt2_Sibxxi_UOA_Hbc KGY_PPGY.IZR_GESZ_F_NZK_HUR_UZW_EmjLvv46_Klzxet_YBJ_Kqk ORZ_ZIPF.VOA_HLIY_F_TDI_RZL_EOJ_VjhWvw46_Gmtepl_DFH_Oik FXV_EZOE.YOB_SCLQ_J_VVP_LAH_LTM_ZrgkRohEmgm_Opyntu_SYZ_Pbf MGS_RVXY.URD_YPEW_P_PLE_UWJ_LWR_BateOgcQdjl_Jkikqp_SFE_Ptm LNQ_IWXE.DPU_AMHI_C_JTU_RTB_EDH_ZroFknBbke_Ldamkv_SOT_Bzn JNC_OZIC.YZU_WTLO_W_QFM_CRU_IYN_OefQlqSrzg_Ysmciq_SHJ_Rir NAJ_ZALL.MKR_GFWD_T_CSP_ZHT_ZLO_QujuJlnVi_Gmqwpe_DGW_Zlp GHR_FANF.IQH_YIBU_R_WBQ_MVQ_ICD_XwlmPguQo_Letyeq_WGP_Hgp YUT_KPYI.YKX_FEOG_K_YBT_EUA_IFD_BlrzZdiUv_Mtgmfd_LZM_Dnn JWY_ZSPZ.BAV_EZZB_R_QEF_BXA_XLM_WrjiLyaRl_Hefiwz_JAI_Lyj IRM_DBLC.RXB_EUNI_N_DPR_FBC_GAO_XrzVipDpdNffe_Fgyoco_BHW_Lkv JWI_OYHL.FDE_PJGU_X_BPB_IFS_MJU_TfqOblTbhMmlf_Epsxcb_PUN_Qzt ACQ_IEAM.KEJ_HUCM_R_LEN_IYF_VZG_DvtCgoVopQwpe_Nsemkt_UPF_Dht SXS_OOOD.TJR_TUSS_V_ZJQ_WRX_RZO_JeiAhcJptUcvb_Hyqspz_NCU_Jqq WXR_DPDW.MEP_VYCR_C_RAB_GBY_KQH_BsaKtwn_Ikuyth_MQT_Hrh RIL_BHMF.AZS_OWOY_H_YYL_WEW_PPR_HqkOvlg_Uvmocx_FUT_Dlw VCF_NVCB.WAZ_IMJA_Y_PGN_UwbPjlfdOpmwaubiz_TggIfajXan_TAJF_HYXRQ_M_PKDSNY_TTMBBIF_WAR BQX_KJBU.YQW_LMMZ_W_BMR_XbvPpsogHgjompsln_ZqfycbKjsdvuvbfpsljt TVT_IDCD.NOQ_YDIG_A_PFY_FztBhbbtWqjaeqrqi_NQBFPEGZYWMHO_MTXIPXJYF DWH_XZWQ.HWN_YOTV_O_FSJ_JdrJlkkzMvjyqlnut_NUMQPQPYDKTLJ_KLHNZHFN CSI_RXRG.HST_RTOU_Z_YAT_AynXrgtlRwlztceus_QYKP_Eglmbx PMF_UXLP.ZYZ_JNUE_K_DPZ_MkkPzepzRipujjhys_Y1960 MQV_BESY.EUZ_LWPT_T_LOYPPkorIfhj2_YEKY_HO_Hxriff_Xeq_W QCK_HKVR.HZD_JMKC_I_GGISGhrkOpcn2_FCJY_EH_Axiikc_Lvs_I DLE_QQPQ.FCO_OSUJ_N_TWQSIzacDvxo2_QVKZ_Jwkqyv_Txs_N KYC_CMAP.OYD_WLEO_X_IEFGNgfzNhnt2_VRYU_Mvojdc_Qqn_X JMC_PGQJ.KAS_BWKG_J_CJGRKittIzih2_Sbbmmg_Bfz_K VKJ_YRVZ.YTV_IIYG_C_ODUNBfibKcww2_Lpmxpi_Fiy_K FGU_WTFF.NJO_LAEI_B_OORY_Ojgapsrgz_EueThwKee_Evbko_W HXQ_RXBJ.SXD_ZVPY_L_AWRZ_Rkdypivnq_UkvWltOfr_Mpqhq_N PMU_RRUD.GAW_SADO_G_SeulnyPiigyvdjvdipzhIsqunsp_10 GMA_LYBC.TZT_VDEG_R_NofzmyIxbilamhxtvgrrRliuggb_11 FST_KMIC.FSG_QZZD_W_LyoixmYwzjxnewvyxhnjYbpatsz_12 MHQ_TASJ.RCM_IQCY_M_PngqpzYdamelfhyspaakMbqnzye_13 XNH_TXTX.NYV_KEGN_P_JurybjFogkrwwpugkkfrTmwggsj_14 VOP_QYHL.SKG_VRXM_L_ApcplfNkjntpjvjujgxdEudsyzg_15 LEB_GZXN.FUU_LWPY_C_FxpertYrafkkugcxbmloMvyrktr_16 PQX_NDZL.XPC_MZYV_W_ZmjcxvZmefywfvyubqisWkylwtv_17 DLW_UFWW.FUA_FBWA_U_UfgficUtgkhlcbmjukbgLitvgqv_18 ZHH_ATPD.HHQ_TXQR_T_OmhqydSweblionxxkpojXdizlkv_19 FNO_VFVQ.LQL_CRAP_P_EtwzphDhlpwaywmhbysuNqkjxpw_2 IHL_REZR.VKB_BBNK_Z_MmbkavIutiuobeacelosSdemcio_20 NMC_DXIC.ZCB_VWZK_K_XczqagZaefnbhamuzxmkEqqxogi_21 PRW_BHWK.PJV_LXSG_J_YqaynpZmreirsjnitskdHomqhqz_22 MQL_MQNV.URC_KVLE_R_BgnmexXqbswxfxtowusvKfeocaa_23 IGN_OZDB.VDD_ZNRN_O_DrxiovVvonouybtfawyeHoqjklb_24 FRJ_JFVL.IMD_RNXB_K_PwlilrXlqdvlxstifdwvAiebqdb_25 DHT_NLKK.UHC_JHSD_C_YodaxxAmyvostapseflwNyqylli_26 VFM_CMHX.BGN_BTJN_Q_DvtdhbAglxixgjtqgcpvNojmqsn_27 ZLE_TRTE.QPQ_XZJY_P_YrvyxpZtowcgsjbeiuosSbcjsjb_28 RNA_ZDUZ.EDR_VCZN_Q_HjnxeaPpbtfzqfxssyaqOmyeilv_29 GWZ_CYPZ.MRN_VUNU_J_InwibcDgdxqgocuhuvynEkagmji_3 XZW_VTEC.RQT_BRGU_Y_AwkunsSlrnhvvvekyityFkskowk_30 ZCC_QXTU.PLJ_SWTW_X_UtptipUxmlkjkiwuevrePpijjra_31 USD_BPKU.JZI_NRFS_P_MurafbPttiunnsvzmxdkCcgrfiq_32 RQL_DCPZ.SBE_LVIR_P_NioasbWtffjhxmulwnycLehpnuj_33 CXD_ERKL.GMK_MWIL_X_BqsybyNguffnegjdnwmnOlfnlds_34 KAY_FWSH.TIB_FNLE_G_JihkbeCkvywccahdbagqBacmyxa_35 WHC_CFEY.TRM_HGEV_J_GlynpcOlxuofgjwsyiokHrhzbbr_36 IIA_FJNQ.ZZU_CBQE_T_ZedgdnGeqynzmfamcceoBlgdjak_37 MOI_GIIQ.UBF_DUXR_Y_TwakwuDneamifkgqygkdGhdgxpi_38 ZGO_GXGS.PVI_JVHE_T_RdpvgwCuisirhtynmzqfNcxgksh_39 XNG_ZSNC.MEI_KKXP_R_UqfignPpxkaawuutjvelOvqnwlq_4 REF_PAYY.BJM_PAOX_U_EpjlowMlwabcyuollxxrAfkqhpk_40 JNJ_LBTD.BZQ_HTNJ_R_NxxxkcGflbivblmswjtrVdaerjl_41 EQQ_LWTX.ZLZ_CEUS_L_QhwrtpQsbkpgdgsuthkeAygwosd_42 MDE_WMTD.QEK_TUQE_S_FneypiCohikqahwvicjvIwfuglr_43 WQD_VNMD.VJQ_ZHNK_P_CvlztaTaaicltavdxqacWqhzdma_44 GWT_DDXO.QIJ_QHAC_G_UhrbabYgcbbpnkgbueghMsbkdmp_45 FIH_DPVY.LFI_IWUU_O_MsnerqUejoqwsrmyyimyHmywxfz_46 CSJ_UXXF.MRW_DVLK_G_EninygJtloloqbgebqkzGqngppb_47 JTQ_BDFV.TFP_VNSH_O_ZtxphyCjwctfwcbkwezeRgqmtcm_48 EOK_VOQB.HFN_JNNP_D_HllvxoFnioynjvtxmibuUcwfiyt_49 ABH_ZZTL.TSS_RQFV_H_XeegdePyeeqkzhpjytlxRrsdcjg_5 VWT_PCEW.GWS_GQML_G_WnylobPtdwtjgtatfpykPoapxbv_50 NCO_AOUB.FRM_VWVO_X_PojcqjKcmpumzmvnzwsrVeanpbp_6 NKA_WBCJ.IFR_XYQX_I_UzwezcPufxxvhweaxxikZyakkrx_7 LPM_PIYQ.UZB_XNVO_X_CnejmvLyfmdqhlgtonsbNqxzpnn_8 BBX_FJBM.OQK_TAHE_L_EcvzfhHastqmrucprdxyCrxwolo_9 OAS_SSLV.XOU_KEQC_M_IkpSpx14_DWJH_NK_Daidef_Ekk_S VFR_ILMF.HZR_KJKV_G_ZksEtx14_GOIE_AM_Lgwvhe_Ymv_I SAM_NCBE.BDN_DEHQ_U_OrwRcg14_QZVZ_Ehgnva_Zyt_N BTK_SSDM.PFF_MXPO_V_CnkDfu14_OICW_Vhcqth_Jrd_H QTP_NNCX.OYC_SLMY_A_XxpTnz16_IHLG_Zhcadn_Qee_D BKQ_UMOT.MUD_LVVK_Q_WluJqh16_WTUW_Ytgjxd_Kjx_T ENF_TWAZ.FKA_QLKS_G_ShnSyj16_KNOJ_Xutghk_Wxg_M XVU_OBGY.PVU_HTRC_P_XavKok16_ALUW_Jalkwd_Ont_V BOJ_CNKN.GJS_UNSJ_U_GgbNte16_Ixpqfe_Dwx_B KAM_WQVZ.GJK_RJDM_N_PivKdi16_Vsueqg_Eou_R MVL_VXSZ.IYR_LTJW_F_DyaQjh17_ODPC_Jhximo_Lwc_D GLG_WKWP.DEB_DQHX_K_YosFdw17_GZSK_Wlozol_Bxf_W BEU_JNCS.SJW_INMY_T_VorAys17_JBAJ_Efhvsg_Yxa_E GRU_JFAY.WNH_UQWD_V_EcvPwj17_KFYU_Iaoggv_Pwy_O OAD_YNVL.CRY_VWLP_C_FprBxf17_Jihvrr_Upv_H JJZ_MMDZ.EFS_CWPG_Z_XnlJkq17_Mpajiz_Skn_L MXG_FKDL.JIU_ANDK_Y_QffFsy22_ASM_Nvsepc_Glb_R NCE_RDZA.KCB_PACB_N_SpaHti22_XIP_Zcttfs_Zaw_P HVJ_MRTX.OGT_WLKD_H_QdnZqj22_VGU_Bngqkh_Nzv_D GSH_LONQ.RMQ_DRKP_Y_PvsCfq22_SVX_Gfeloi_Vzq_W XYM_LALW.QVP_CGQX_M_OubQad22_IBG_O_Bjijbn_Sgo_O CUO_HGWT.FQP_GFNH_W_JprQgr22_EDJ_B_Gllmuj_Gpo_L VQQ_MCOS.GGP_RPGN_M_YgzWzq22_HGU_U_Fegytu_Cde_Q KIA_GJTF.BXW_GTWP_G_WutNty22_ERD_X_Bnblmv_Jrd_U XBX_NWIH.EUI_STPX_T_MnjDnx22_KAJ_Vemkly_Snz_S SNF_TFKH.KGG_WZQH_Z_NbjCoz22_GDN_Acyprb_Tym_M APV_IENM.TJO_MLPF_I_EjiRjt22_RXN_Dhdheh_Tfc_E VKL_LSZE.LLL_ZUPB_I_EbgWne22_UZS_Wrdqlt_Avp_V JGF_CRSV.TDM_CFWL_I_DinKtt2_AVO_Zerwds_Mhh_D DEV_IMIR.PNY_MAEL_T_WgcIdc2_THS_Sofmze_Kol_R PBQ_QNLC.TRK_DLCU_M_RbkEyd46_Xhswbd_Orn_R PGV_QKBA.IJA_DAIL_Z_KqzLja46_Xqjoig_Nox_M JBB_ETDI.VJL_DOZK_U_DpqWkj46_LFJ_FG_Rbgjik_Kfu_E QSE_NQZK.CEU_BKVC_T_VyxCmn46_LQM_KA_Mrisdc_Gqa_T ZGJ_EXDO.ICO_XDBP_P_YvtDhp46_KEL_Kgelnd_Qcu_X GYC_NUBW.IDV_ICBS_K_FozNmj46_MWI_Lwvxsc_Bnh_G AFP_ZXAH.BHF_CFOL_F_PrhGhv46_XFE_Ceuham_Ema_K EUY_UFOI.PBI_MTOE_G_HmdXbv46_IVM_Fcrpiy_Tlf_I ECU_TYHL.NRI_CQLO_Y_UpioZgjGbfc_NGQG_JM_Iknhkg_Abm_R AJA_CBRB.ROV_ODZX_W_XhfgGdgTonf_XYDH_HW_Cjhaoj_Icc_X BMJ_RZOX.FCB_XXYI_D_LpdpStiUfmc_DUMG_Uqjbfw_Jeg_Z XMD_IAAT.TKS_WJJX_T_MetnUleVfdw_QTAR_Rurtci_Nyp_A YIU_PQGQ.SHN_LHRR_B_RtqaFomThis_VKPW_Pgxzxa_Dem_C GHN_WWEG.NSI_TKXA_S_OkpuNpcXbik_CSZB_Vyzuif_Tli_D BVZ_IRUU.DZJ_TMLJ_H_HsloUgeIcmx_WJINTe_Jiewzs_Gug_T SDZ_JXDA.UWO_IMBW_W_UsutMjcLneh_FPOMLm_Owafub_Ybf_D XRA_WYMB.ZCQ_MBPX_B_BjcpMvrLlby_FPUVBz_Cspjnh_Jgv_H BQI_ARPC.JFR_ULWT_H_ZzabOhfHscr_EBGAWm_Xnvxaw_Etq_M PTK_OBMG.JIB_RLUL_U_ZsbmUkqUasj_OLU_1_Zszsoz_Yuw_A JGO_SOZZ.HOV_XNIS_L_YjfxRozOfkh_NJY_1_Wnkxjg_Ned_S MUD_VFQB.PXS_OYJW_X_YtgbBvwIksz_MPV_1_Ingqwh_Smu_C NFM_VBCS.RXO_RGHN_U_AppsIlrBsdk_IXO_1_Scveml_Odk_F MLN_QFJP.JME_OTOL_C_OwqvYrzUzie_GDW_Ihhdxc_Rky_C JUD_NIKY.FTM_OOVZ_H_BxknUpmLnaa_BGL_Xjwnyg_Bje_F FYH_RHPX.TIM_TJBS_Q_LfdsMyvMtxy_PCM_Iwrvom_Bjr_O KHV_ABZD.ZNA_RSFR_K_CtvrKdtKplp_ZTO_Whcmot_Kur_M YLA_KXZN.BQS_WWCD_X_OjvkAkvApbm_Bccyuh_Ipg_S STT_FWIJ.FZS_MTVO_N_UrcvGlrNqve_Dzvlnn_Sjd_U NRF_OQOW.CAN_HFSN_C_UfjHrkYgru_WTF_Kctadv_Vel_U GXL_JCOL.XSQ_RNDI_V_TtqImjRxti_EIU_Iukphy_Wsp_Q LYS_XDWU.PVL_ECZR_T_NaeDbuGbvi_YAB_Fmfgfn_Cso_M ZLU_PTMT.UMN_LQQG_Z_AmuPhpIigf_MQV_Yffubc_Gnh_O GKW_VTRP.XQQ_DTYZ_L_SrvcShhGk_Ylwxeu_Ocp_U HVC_TCGE.DMQ_TMTH_V_UjvsQtsYm_Chltre_Doz_S CFL_BRGV.LGR_DJSR_T_WuzDoiNmuQmaa_Bnvgeb_Hop_H VFZ_HZCC.RIR_JBSN_F_DlzUsfUvkPzqs_Nsiqci_Mec_T IYA_BJNP.CQG_YZOB_A_XngBscq_THG_Tvueqn_Zer_N SMT_CWXQ.QOY_IXIM_X_QrgIwqd_AVF_Wbfqvn_Afb_K GIZ_HYAJ.UZF_KYEE_W_UbyFwfs_QDU_Xmgjsl_Paf_C OOK_HRKU.JHE_DZEQ_C_WgvJumw_LZL_Wcqsxu_Stz_B VEU_BYHO.MKZ_HECJ_M_PtqClqb_FIU_A_Kntvuq_Bfb_Z IUS_XVQF.OJE_HXCG_Z_UqkHmsi_QQK_Q_Gwpcte_Vka_U BRM_HROM.RTF_GOBC_J_MtxScxd_XVZ_G_Illyqj_Ylk_D YSY_ZVRM.MLA_NZIE_M_WvhIpdo_KWK_B_Tagnwi_Ayu_E BTF_MNIO.XVX_FIKL_Y_QstWuvt_HFF_Qyvtdk_Uud_K SUM_RQXA.GAL_MQIO_M_RmdLtjc_JZU_Wvurvg_Uqp_I GNR_DKGB.AKF_UMNV_M_AodCjfr_ZXB_Mdeehq_Bbo_M OQT_IKFR.YKB_PWRL_I_UogVuxs_WKD_Upfvke_Eup_X LFY_XWQH.HWR_SSOL_Q_TfeTuhe_Ndergf_Zck_X DAI_XKVY.DTQ_INNC_M_DszZwhz_Xrhlpt_Wfw_M /end SUB_GROUP
/end GROUP
/begin GROUP BRM_HROM.RTF_GOBC_J_MtxScxd_XVZ_G_Illyqj_Ylk_D "" /begin REF_CHARACTERISTIC GBN_BKQU.TPF_WIAK_F_IcpLgfo_EJY_N_Fydswz_Bsz_S /end REF_CHARACTERISTIC /end GROUP
/begin GROUP BTF_MNIO.XVX_FIKL_Y_QstWuvt_HFF_Qyvtdk_Uud_K "" /begin REF_CHARACTERISTIC LPZ_TETK.JOC_FQPN_R_AtjJrfx_UTW_Jngokf_Lro_B /end REF_CHARACTERISTIC /end GROUP
/begin GROUP BTK_SSDM.PFF_MXPO_V_CnkDfu14_OICW_Vhcqth_Jrd_H "" /begin REF_CHARACTERISTIC GEY_KCUV.HQQ_UYBN_T_WckRld14_RWVU_Gmkdfu_Biy_Q /end REF_CHARACTERISTIC /end GROUP
/begin GROUP BTN_ZNN.OJ_AVM_YYN_GsnaifhdpVWI_Rslpa_Npd "" /begin REF_CHARACTERISTIC RYA_ESB.LA_OBP_WIL_GumfwqfhsDIG_Xdjft_Aps /end REF_CHARACTERISTIC /end GROUP
/begin GROUP BVG_DZKW.HMB_KUPF_C_HBM_OIZ_XXN_XMK_YEHWJTEKACBHA_RZPJSI_UHBXMX ""
 /begin REF_CHARACTERISTIC GKU_ZCVG.AIG_NOYZ_M_WKQ_OOU_MZT_SOZ_WQFSZHMRHVPBC_KKYYSC_FSTGAA /end REF_CHARACTERISTIC
/end GROUP
/begin GROUP BVZ_IRUU.DZJ_TMLJ_H_HsloUgeIcmx_WJINTe_Jiewzs_Gug_T "" /begin REF_CHARACTERISTIC JOD_DWXC.MVZ_XLVA_R_SkncAxgBgld_TFJRQe_Ghoaoq_Hzd_V /end REF_CHARACTERISTIC /end GROUP
/begin GROUP BWY_UBI.WSF_VUF_GghEiv46_Knjscv_BiVI_QPP "" /begin REF_MEASUREMENT BLL_HKM.BEV_XKO_DkoSnw46_Viqltq_VjMY_GPK /end REF_MEASUREMENT /end GROUP
/begin GROUP BXI_GGWA.QHV_ZRIL_R_RYQ_ISW_YMM_WKF_DVLRRUBHYBPJKUPNU "" /begin REF_CHARACTERISTIC QHM_FNKW.GUT_LAMR_I_MLB_RCX_IID_QSH_EJEXIIASWWUHSLZDZ /end REF_CHARACTERISTIC /end GROUP
/begin GROUP BYP_ZTB.DMA_DTR_EvWpvmNsznaNvczkaq_RFE ""
 /begin REF_MEASUREMENT AVP_XZL.UKS_UTI_XyUjkgGpwavVtnxsav_SKT.PQF_CYA_VIX_Dc_ZllCvc58_Trcufz /end REF_MEASUREMENT
/end GROUP
/begin GROUP BYZ_PKD.LQ_YSA_UMQ_CdrockuskSNU_Wrpme_Ajs "" /begin REF_CHARACTERISTIC FRB_KXV.JF_ERQ_ZKH_AfswjgkblJOG_Mhbxg_Huq /end REF_CHARACTERISTIC /end GROUP
/begin GROUP BZX_SHH.OTE_IIM_SSF_KEZ_BdcgssavhBHG_UbPD_ONX "" /begin REF_MEASUREMENT LVF_FBN.FAO_WLR_RKJ_STM_DzdgjfckvHUQ_RfOQ_ERB /end REF_MEASUREMENT /end GROUP
/begin GROUP BcbnztjzIbtwifxhxh.lumalcrwu "CQ Aclxef"
 /begin REF_CHARACTERISTIC UvyjpednGuqaihojlz.DYS_SlqMpxnpi ByhkgjrcSdenssxxde.ZZA_FwcwjDmlqb YcrwvuzdNiufpxafxp.CDN_PobaysiqGVG WtkibbzoPrmxfeicjl.GIZ_ValyTcod DdwxxfemUqglosimjd.LAK_gyrwuq_jprroj YmmwasrbBubdfvzweq.ZpwTwo_Scokalokjhobc_Lnsrybv_WEN8 SrilzxmoQagzoiqfil.GvdkxshtfhTbgRnwrazEdlgrrnl IwplxhycYmufgonrtm.QmdvweikzfXyaJlzcfjNokuBjmyvyi NetuuiuqMjuxzsputa.QMZ_TCF_XzxkyMorlrc_Qf32 XjxcobgdXqfxixepuz.InoeyrnbUsakhcavqpK_TbmrcHvqSloLmcrs HpjurpcwMhezbmrqjm.IlmQgnybebFirkqwm_clw16 ThdhvgnxIpctdtemun.pBzgpxgsnKrowarjolsO_SIS_WazkXiotVaaoco_ioc PzcjxsepRqquippluc.fKxqthomeBuceyazrybE_RYJ_YkryVjer_mtb NpagmmpdMstdilouqg.fYcyjwfjyMfqkbovspvS_KLN_NorqOhlyjVpr CimhltmqVqpvlgddjg.nAxutfqfaXxqlyjjshkG_QLZ_GgwkLxamiVkxyduRjk HpsshdxdYxmhnkvrpq.fUmyeokstYslgrocoslO_IYR_YxkhAoaelUxbee FeukfpvmSlvbnhcpmc.mLwondwyoOpfnjpesfkF_ZGZ_VwifIspmiAer WgubfeavBhdcmzvxnp.rUingizpyLgeibpwxswJ_ABX_IjrMlvkr_Qxbh_TRPGE_TR_Fiamim_rti32 GwdekhssOraihyryev.tBhzapvndLqpqohwubmS_YvbRqjusAsmogvibzsKqosBfvHwckaa_yqn XymidoujVvogsfrhap.tWgfwafdjSdqmrgcreyW_PqpIgvlkJfalzfnwseVoitTfq_usa ZwpmzbmxYuxhyrqgrk.qIdppnsbbJtvjkesvkiU_JDJ_Fidvpxvu_VzbqgmEvc KgtoyxbqNvowfccmop.iTlemppmdGpiwsmpyltC_PAO_Dsjkuj_FjulxwPib VeryuehpLnacclmmco.hWdhhxrfpVjungzuzlzF_ZUG_Ckbhzf_AaenqmPz AsftawpmQjflmomqtg.lUimCtuD_BHA_EnmSypkueyFxfRpj NvdvvqpbTaqzktxqif.fDfrVzsN_PAJ_SgugknAopxfOgq WrwiolpqZbxlohbvmf.sCwuBxyF_UVY_XagqoqMpyqxuBpd UxjaqbsvBpauqdpgun.uLwiIejE_SJJ_SjwppZuoesUysesKhpGsouce TohcebhuYfusxltohb.xVugYwaN_WEU_TclaCbaqmXgkxfRft QcyypicaLojpcmpktg.wLmlUryB_NMT_QiqtXmuZpstzGub LjschhjrIxedhoglzl.yUtpKujE_TJA_SeicUcjHncdhtAte PnhskfewOylimsafdq.bFclxhgpwVesaswrrcrL_HZC_XpnqrcQsuRspoisz VcckvszlCqwsguclld.rEjracfccMhanxdarbkU_QloCzlgzGvhykuqedvIadovpPgdyeu_vqm XrkgorqvLrnsrnvmqc.fEprhiktiMztlrxbejaR_QmsVxqtzRinwoucswwTsnpog_gyr DacablngVhfwrkpmzn.bKfeyqofqOoczmmithlN_GCL_Gcaxwkun /end REF_CHARACTERISTIC
 /begin REF_MEASUREMENT CsrglrkdVkbwzmwgmg.VZY_MjvElkqy_Rais WignoperVhppbzhvnj.YPI_QgsakLAG NehtvlznWhgcrwncfb.RccNymde_bhz_zq32 LboqrtcmVqmajkvdaq.PjfYib_FkpkNbgNzKzjxwGaquPifmih_aun32 UvxftyagMyqujfnrtp.EzpVi_Sskzya_Med DsfqaigeUiuuvjvdvj.PtczineBopa JyyiaelnZpacstzeaq.ZuxoxmqLwkePizvufahKvuexxue OwrgmsyiFgmgoyioil.PtwqmghIzgcvJPB LgqtdyddRpadtjslta.HlyuiyiZyawpmxn YazjqpscItmybciabn.UnmnzQadrwCrpngxkkUkncbKwabekncljMks_fe32 MlkatdrmIrtcwtgpbs.SfotpDyobcBpfgcjeyHfatzCegtlojhllZkrko_mx32 VkowjvmiGowlhcvhrx.BphuqAahvtLiisfntsItwthOrfbyltmdkWhtijf_xh32 MzkcwoxgMsqmzxwass.AufUpvxuchsfMigubLrpffs FakzjhawSdwmvqqwsl.Glzyfhj_Xcklqqlqd_im16 XfvikfbvLtaessoncc.Wcjjkqu_Ejuklljeu_zh16 EevrhdicYubufbxlna.DEL_EMI_Mhorlobq_khe32 BugfemefSgokilflgm.JdsbcepcImwfgujrev_KdnmbsUmmQwei PyzbzcesHssdcpeite.CadpmjdcApbj_bhyfm_bqjp KcdgbqjgNyfjhthfpb.ErtuwkogrVzhqwGIY TlrnuiwrCgypgecfnw.JnesndokbIvtmuVtpwwe HvkjwucwAajetwtmdp.KqcuhfQvlipjlslCvanlGolomm NhdoadnrOsplmquhfe.GqhmbZshqd_zdq_cq32 WyqxmxsjAotrifozux.FwwmzzLgulbsvf BbfcncdxHivcmphusj.RfeBtfst_dpu_gg32 XnmrsralHxzfxalydg.zEowfjckfCihkyzwbpyT_EPI_PinYxbgv_Yrql_Izufje_vjm32 /end REF_MEASUREMENT
/end GROUP
/begin GROUP BigC.Ttgtcw_QN_SLG_DyzuYfcoyfFap_XKR_2_Nibhwbx_ZucnceQiuc.FFV_JewxQjoelyHhn ""
 /begin REF_MEASUREMENT WrfN.Urvudu_PB_RWG_BuxoWpwqmbDml_BGP_2_Tvczdqb_BdkjjtTuef.APR_IejxUijlgdXpp /end REF_MEASUREMENT
/end GROUP
/begin GROUP BwrfmhzxOakpzpkyzoJue.YvixncthVwpsl ""
 /begin SUB_GROUP DezishmvEdkuxidafiYtq.rCpkktgwPpeqc.afPpqc KeaqhnloXvkpgwdfelWuf.pGmqdsspIckmq.pfVrf /end SUB_GROUP
/end GROUP
/begin GROUP CAB_JXF.NVS_URV_LKP_CUR "" /begin REF_CHARACTERISTIC QZL_FPJ.NQC_VSC_ABG_DSG.EnvrrkIuuelhl /end REF_CHARACTERISTIC /end GROUP
/begin GROUP CAW_AOKG.WRU_VYUL_D_IYO_OLY_VHD_LoyCqt2_Okdccg_CCQ_Umb "" /begin REF_CHARACTERISTIC BVO_PIPT.FLS_BAPE_T_TGS_SZX_NZO_SgoFbg2_Ciprvr_JSG_Xub /end REF_CHARACTERISTIC /end GROUP
/begin GROUP CFL_BRGV.LGR_DJSR_T_WuzDoiNmuQmaa_Bnvgeb_Hop_H "" /begin REF_CHARACTERISTIC XUW_CKMJ.ZRZ_RPVA_Y_VuxSmqPknVxol_Slttos_Qtg_T /end REF_CHARACTERISTIC /end GROUP
/begin GROUP CGK_KESB.XKA_WJCX_Q_PWP_MKG_SKL_JQT_ES_NLJIBNEBMMOPPXRHV "" /begin REF_CHARACTERISTIC BCQ_VBZO.NUP_IEBC_E_WOZ_WMG_HFF_ZQQ_QD_QIEWVVOGZNTDPQUCW /end REF_CHARACTERISTIC /end GROUP
/begin GROUP CIS_KDM.ORI_Y_HvzVnkt_Qxztbs_DTH_9uy412yx_Zp_WqSpkvurvxEtlf_XYM_OHS_BujldxjgoCKS ""
 /begin REF_CHARACTERISTIC LBB_YGQ.FZH_Q_PjfJqqb_Ftloue_HPF_9li412wk_Bm_CoHbrvuwvtXknp_WAP_OTB_QhggvpedeLNS /end REF_CHARACTERISTIC
/end GROUP
/begin GROUP CKZ_DDE.VMW_BAS_DtqqeoaLie_0P_QYM "" /begin REF_MEASUREMENT YTQ_NMN.LYC_ZMF_RmgedwrDox_0U_HYI /end REF_MEASUREMENT /end GROUP
/begin GROUP CLQUexwg.ArwkLdqwcfnSnbin ""
 /begin SUB_GROUP ESGAsduh.QupeMwgseaWnp_CFT_DWX_2_fcgqvorul_3w9bb106_YwnubdIdjo.UZD_JoerFqydwmBrx DDCCddmx.UTWPgsq_17.BSD_OZVXjet NQCWixzw.RFHRznv_18.OIV_KCFHtxh LXPQzymo.ZTPEeml_23.GDA_RZZHcjg YSYKsatz.RPWTkdh_30.ODT_XZYAhck /end SUB_GROUP
/end GROUP
/begin GROUP CPH_ROX.NLK_U_SeaeMxgNfkd_Nyuqjc_YRO_m2xult9s_Jy_HoHgkcjndoQimx_EPU_LNB_1_RwtpabflbXIK ""
 /begin REF_CHARACTERISTIC ZTL_THJ.JBP_O_YtbjEveJjkb_Oszpkw_SLY_l2aebs9k_Ee_WvSmccbmxuQfoc_FWG_AHK_1_ErcayduswMEZ /end REF_CHARACTERISTIC
/end GROUP
/begin GROUP CPU_CWN.WWJ_S_AQXNOqwzLzke2_Bheena_BTB_e15h095h_Oa_TaQpetgufkTvry_GEO_JTNO_CQ_HyeivsryeJCY ""
 /begin REF_CHARACTERISTIC IVZ_KMM.JNZ_A_FYKJXfwsGraf2_Iaqeqv_TON_l15m095z_Oc_UmYcwdxxptNhnk_GFZ_VYST_BH_GpvrwqipoORS /end REF_CHARACTERISTIC
/end GROUP
/begin GROUP CPW_XHV.LM_ZXL_YYC_UhihnenrxIFX_Qvwpb_Jeh "" /begin REF_CHARACTERISTIC ISS_RHM.AA_MGD_ODX_UjnipuhodJJP_Mtguj_Jtm /end REF_CHARACTERISTIC /end GROUP
/begin GROUP CSI_RXRG.HST_RTOU_Z_YAT_AynXrgtlRwlztceus_QYKP_Eglmbx "" /begin REF_CHARACTERISTIC DEF_IRUB.CWF_DYEH_R_HYO_PjtXyvapAtlphhwgt_GDWQ_Beiism /end REF_CHARACTERISTIC /end GROUP
/begin GROUP CSJ_UXXF.MRW_DVLK_G_EninygJtloloqbgebqkzGqngppb_47 "" /begin REF_CHARACTERISTIC FPN_PUVR.NHE_VORJ_T_PnvkzfWppcvttjtwhxpjVwcavjr_47 /end REF_CHARACTERISTIC /end GROUP
/begin GROUP CTK_BOI.FVS_QSG_GxeZkp14_Jqufjs_MxGF_QBT "" /begin REF_MEASUREMENT KFE_XOS.KAM_SAJ_AprGxq14_Ltzond_DvAS_UDW /end REF_MEASUREMENT /end GROUP
/begin GROUP CUI_KNCU_LRJ.OejiqtjyxicWsiuekvlfp ""
 /begin SUB_GROUP XSG_VUEC_GLY.GFVC_I_HmgptpmHDMHzybn_Spjaqqz HRG_BAJA_XVG.SELY_V_RiknvoeBGEUqzgv_Xtimnnb_Cdkunwhnpt HMN_FUNE_OWK.BYHT_O_OFNU_DrkfRifqnauLkktj_Wqipadh PFQ_KUGA_JOO.LNJY_G_UOBN_WtvoClnlykkFqhgj_VhxifWcxjq TNB_AVYH_PSW.TIYZ_K_LPJC_CrpeQawhcgwPpovg_ZhoknSgviy_Lehcmwcshc LKW_KWTS_WFH.OUKM_D_XLXV_MzgcCkhdvbpYdpsn_ZmxosPlnph GAV_NLES_OKO.MMDM_O_PQUO_HcebLhwiyihKmaud_YkvrbJqaou_Zimbjmwgrr /end SUB_GROUP
/end GROUP
/begin GROUP CUO_HGWT.FQP_GFNH_W_JprQgr22_EDJ_B_Gllmuj_Gpo_L "" /begin REF_CHARACTERISTIC ATB_DAWM.IGT_BYMW_Y_IuwOug22_BIF_U_Ywqast_Kxm_O /end REF_CHARACTERISTIC /end GROUP
/begin GROUP CWX_XDEE_ATZ "" /begin SUB_GROUP CUI_KNCU_LRJ.OejiqtjyxicWsiuekvlfp /end SUB_GROUP /end GROUP
/begin GROUP CXD_ERKL.GMK_MWIL_X_BqsybyNguffnegjdnwmnOlfnlds_34 "" /begin REF_CHARACTERISTIC ULB_MBRP.FME_XIIA_U_UdmlmdMwpkgcobmjyhciBhkjgpj_34 /end REF_CHARACTERISTIC /end GROUP
/begin GROUP CXE_TAX.ELB_QAY_Vpek_0C_FSX "" /begin REF_MEASUREMENT YDN_BFP.IPJ_SEA_Viyc_0E_VYW /end REF_MEASUREMENT /end GROUP
/begin GROUP CYB_JQD.YUD_10000036M "" /begin REF_CHARACTERISTIC VCZ_KYR.OQR_10000036Q /end REF_CHARACTERISTIC /end GROUP
/begin GROUP CYR_HCT.DGH_10000027K "" /begin REF_CHARACTERISTIC DVV_UKV.YLS_10000027F /end REF_CHARACTERISTIC /end GROUP
/begin GROUP CZQ_CHR.VJE_IFE_NKE_IDNB_MvemtnrojYDJ_IvKE_WJB "" /begin REF_MEASUREMENT JAQ_BKJ.EIZ_UWX_QFY_LPMW_HdwbwjfbpYLY_NtGE_RAA /end REF_MEASUREMENT /end GROUP
/begin GROUP CgnevbqfLvlgtulqWvh.nNvbtfncTpbfg.anTth "" /begin REF_MEASUREMENT XcnvfhusNgtybzimPbe.qZkysulhVuddq.dwVex /end REF_MEASUREMENT /end GROUP
/begin GROUP CkgRudexebhwuvSbu.ZerRdrjKjitZrpAapu ""
 /begin REF_MEASUREMENT NmoWgbmfanmbniHuq.CwuIzuqRqdpYscOmeu.MwfbszAdkavuherYpoh JptZcpwxbiuwkjQpl.ZhrEjbjWgfaNjhCjbl.QvmysAzGvct /end REF_MEASUREMENT
/end GROUP
/begin GROUP DAI_XKVY.DTQ_INNC_M_DszZwhz_Xrhlpt_Wfw_M "" /begin REF_CHARACTERISTIC YED_JOPC.EMA_JCVB_X_UnjHcsp_Dqqepm_Edu_F /end REF_CHARACTERISTIC /end GROUP
/begin GROUP DAL_THZ.ATN_J_Qpcuitp_XosMtMiHhl2_9_ILP "" /begin REF_CHARACTERISTIC LHB_BZJ.PUQ_D_Fzxnvwk_DuvVnIcXhm2_9_INY /end REF_CHARACTERISTIC /end GROUP
/begin GROUP DCB_IUZ.KQS_MJB_FfeqmhqkscllTOHAcxafn_WYJ "" /begin REF_MEASUREMENT BFK_XXM.MMD_AJQ_VqlybmstzajnPBFKcijdh_RZC /end REF_MEASUREMENT /end GROUP
/begin GROUP DDCCddmx.UTWPgsq_17.BSD_OZVXjet "" /begin REF_MEASUREMENT TFSLdxyk.TYORqea_17.HWJ_TAVFkpa /end REF_MEASUREMENT /end GROUP
/begin GROUP DDE_XFI.UX_XSG_DSYN_MJF1_IfococlrjZUC_Fjtgz_Uqb "" /begin REF_CHARACTERISTIC XMO_XIJ.XI_XCN_VXCU_TBQ1_ZsliommyeUKS_Nflyi_Kjr /end REF_CHARACTERISTIC /end GROUP
/begin GROUP DEV_IMIR.PNY_MAEL_T_WgcIdc2_THS_Sofmze_Kol_R "" /begin REF_CHARACTERISTIC CFM_NJYT.KIC_BVLJ_Z_OjjIah2_ZDT_Pkgsah_Jvv_D /end REF_CHARACTERISTIC /end GROUP
/begin GROUP DFU_NMJM.PKT_XGBJ_A_FXX_CPO_XOX_NMB_DNDYTRYEJCMMZMTUVNTEBOMT_BRZXKF_AJAZIE ""
 /begin REF_CHARACTERISTIC LDA_YOYQ.WRL_ZBUC_O_ZRV_YOP_ABK_HNJ_FJMTUQWVNKGDLYEPRYKWLWEW_HKWYJH_DPREZO /end REF_CHARACTERISTIC
/end GROUP
/begin GROUP DGW_CHF.IOD_H_MkkvvqqIV_17 "" /begin REF_CHARACTERISTIC WKV_IKB.PUA_W_BdicueyHO_17 /end REF_CHARACTERISTIC /end GROUP
/begin GROUP DHT_NLKK.UHC_JHSD_C_YodaxxAmyvostapseflwNyqylli_26 "" /begin REF_CHARACTERISTIC TDV_ZYCI.WSB_NUPK_N_HajqniMvgpbocwxppskmBqpvwqo_26 /end REF_CHARACTERISTIC /end GROUP
/begin GROUP DLE_QQPQ.FCO_OSUJ_N_TWQSIzacDvxo2_QVKZ_Jwkqyv_Txs_N "" /begin REF_CHARACTERISTIC BOQ_VLFN.WLX_HTUK_Q_ZDNCKdwfRryy2_ZIIX_Hpuhrt_Mtd_V /end REF_CHARACTERISTIC /end GROUP
/begin GROUP DLW_UFWW.FUA_FBWA_U_UfgficUtgkhlcbmjukbgLitvgqv_18 "" /begin REF_CHARACTERISTIC DOR_SNUS.TVP_OPGO_Z_HoxlovNjbpccjwjwnqnxEilfkpy_18 /end REF_CHARACTERISTIC /end GROUP
/begin GROUP DNYDxeerRkfqqjaCsl.YmgxsczkZzicf "" /begin SUB_GROUP ELIKaymdRbtxrntDwu.XTA.WkehkcbTbsov /end SUB_GROUP /end GROUP
/begin GROUP DUA_SFI.EMV_G_Vhmotjy_UmnxEylOenp_Oqjezg_TPA "" /begin REF_CHARACTERISTIC HOZ_USV.BPB_H_Vfsfgdi_CufeTfpTaow_Kmkcnc_WKV /end REF_CHARACTERISTIC /end GROUP
/begin GROUP DVT_EAB.YMH_LKH_YDO_CWH3_PZJ_KekoknzbeMYH_FwYR_HSV "" /begin REF_MEASUREMENT QTV_PPA.OAH_XWP_QYW_DMG3_NYC_EgdjcilbsXZB_QuFK_STT /end REF_MEASUREMENT /end GROUP
/begin GROUP DWH_XZWQ.HWN_YOTV_O_FSJ_JdrJlkkzMvjyqlnut_NUMQPQPYDKTLJ_KLHNZHFN ""
 /begin REF_CHARACTERISTIC YQY_SUOD.QER_ITCJ_J_UAQ_VitVcbecAvlauhhzm_XWFNUAHVDXTUP_JWZWTVXF /end REF_CHARACTERISTIC
/end GROUP
/begin GROUP DWV_GWAT.JCT_ICRJ_L_DuyzZZVJUtovTttlQkhkTfl_YJND_Wnsgys_Yul_T ""
 /begin REF_CHARACTERISTIC DIX_OJKH.KDD_CXIU_G_ClvvFOHRVpebZhanQvptZpx_CVLU_Usouzs_Grj_U /end REF_CHARACTERISTIC
/end GROUP
/begin GROUP DXA_AZCK.AWO_FHBN_E_IVX_TGP_IFB_FHKO_GO_MPMBCDQCJY14_ZBECGG_PTGGPH ""
 /begin REF_CHARACTERISTIC VXH_RQWX.HZP_KQSJ_R_VHC_IHO_ZQC_PRIK_QS_JUCBSCBUSI14_LGBOJX_VSOUVC /end REF_CHARACTERISTIC
/end GROUP
/begin GROUP DYU_ZCX.CB_RLA_NEA_WgexmcbrtSST_Wddda_Srq "" /begin REF_CHARACTERISTIC QRE_NDR.QG_XUJ_UJC_CpghtsjecWIN_Bncqf_Rob /end REF_CHARACTERISTIC /end GROUP
/begin GROUP Inemhcq.OoopvfqaWfoivl "PR Canughb"
 /begin REF_CHARACTERISTIC NetlwbewZmorjhbcn.InlpqivGwhqi_Kurazpl JhhalsktHrtqgxcvb.JwlnGxrqrRdyzfcu RrhfxsqyDzrnpymje.WwbpvunlPyxullr ZdnqnptfHwdeigzuw.DddzhugfeaEoudzut YadptstdHrzxolvgo.Fnjytooqeb_GzhFdgdvhot WyhpasvaBnltbzfym.XJUAKTZ_NQIRCC_PFIDK CeajbnhrCkbuabbhe.bEqiHlqjpEhlvh_Qynmhffbl_Qettij AcqzgpuoJflnjtvgk.lIbcGjvgcLqnfo_GinBfxGvqgqm IzrboknDzhwjjqvHqucihdqz.Mwp_Yqzsd_KsaqujkZfhcmvhn OzisyyaLuelvbxwTkwtbaeij.Ddd_Uaqft_HrrRmtpjAfaqe_vq ChrkhjbQezunujqRlmhnzdox.Njw_Nbceb_QjwObqdy VuzzmasEctwrdkcEknpoxjob.Ruz_Rkexd_GbgiKmiji UvyjpednGuqaihojlz.DYS_SlqMpxnpi ByhkgjrcSdenssxxde.ZZA_FwcwjDmlqb YcrwvuzdNiufpxafxp.CDN_PobaysiqGVG WtkibbzoPrmxfeicjl.GIZ_ValyTcod DdwxxfemUqglosimjd.LAK_gyrwuq_jprroj YmmwasrbBubdfvzweq.ZpwTwo_Scokalokjhobc_Lnsrybv_WEN8 SrilzxmoQagzoiqfil.GvdkxshtfhTbgRnwrazEdlgrrnl IwplxhycYmufgonrtm.QmdvweikzfXyaJlzcfjNokuBjmyvyi NetuuiuqMjuxzsputa.QMZ_TCF_XzxkyMorlrc_Qf32 XjxcobgdXqfxixepuz.InoeyrnbUsakhcavqpK_TbmrcHvqSloLmcrs HpjurpcwMhezbmrqjm.IlmQgnybebFirkqwm_clw16 ThdhvgnxIpctdtemun.pBzgpxgsnKrowarjolsO_SIS_WazkXiotVaaoco_ioc PzcjxsepRqquippluc.fKxqthomeBuceyazrybE_RYJ_YkryVjer_mtb NpagmmpdMstdilouqg.fYcyjwfjyMfqkbovspvS_KLN_NorqOhlyjVpr CimhltmqVqpvlgddjg.nAxutfqfaXxqlyjjshkG_QLZ_GgwkLxamiVkxyduRjk HpsshdxdYxmhnkvrpq.fUmyeokstYslgrocoslO_IYR_YxkhAoaelUxbee FeukfpvmSlvbnhcpmc.mLwondwyoOpfnjpesfkF_ZGZ_VwifIspmiAer WgubfeavBhdcmzvxnp.rUingizpyLgeibpwxswJ_ABX_IjrMlvkr_Qxbh_TRPGE_TR_Fiamim_rti32 GwdekhssOraihyryev.tBhzapvndLqpqohwubmS_YvbRqjusAsmogvibzsKqosBfvHwckaa_yqn XymidoujVvogsfrhap.tWgfwafdjSdqmrgcreyW_PqpIgvlkJfalzfnwseVoitTfq_usa ZwpmzbmxYuxhyrqgrk.qIdppnsbbJtvjkesvkiU_JDJ_Fidvpxvu_VzbqgmEvc KgtoyxbqNvowfccmop.iTlemppmdGpiwsmpyltC_PAO_Dsjkuj_FjulxwPib VeryuehpLnacclmmco.hWdhhxrfpVjungzuzlzF_ZUG_Ckbhzf_AaenqmPz AsftawpmQjflmomqtg.lUimCtuD_BHA_EnmSypkueyFxfRpj NvdvvqpbTaqzktxqif.fDfrVzsN_PAJ_SgugknAopxfOgq WrwiolpqZbxlohbvmf.sCwuBxyF_UVY_XagqoqMpyqxuBpd UxjaqbsvBpauqdpgun.uLwiIejE_SJJ_SjwppZuoesUysesKhpGsouce TohcebhuYfusxltohb.xVugYwaN_WEU_TclaCbaqmXgkxfRft QcyypicaLojpcmpktg.wLmlUryB_NMT_QiqtXmuZpstzGub LjschhjrIxedhoglzl.yUtpKujE_TJA_SeicUcjHncdhtAte PnhskfewOylimsafdq.bFclxhgpwVesaswrrcrL_HZC_XpnqrcQsuRspoisz VcckvszlCqwsguclld.rEjracfccMhanxdarbkU_QloCzlgzGvhykuqedvIadovpPgdyeu_vqm XrkgorqvLrnsrnvmqc.fEprhiktiMztlrxbejaR_QmsVxqtzRinwoucswwTsnpog_gyr DacablngVhfwrkpmzn.bKfeyqofqOoczmmithlN_GCL_Gcaxwkun PvbjNmnwmqgafeb.WfwqztJeprcqAsbslhsy GjvbGkhvmnljxsn.JjhpPolndawvqIjwnplwyzwYwliiScll JuwhUpocnmiomcy.CtxxkJmGycwr BhctAuqhmvdczcn.AlakaamWtzhmmylIlrgd RbypLxtmostukcs.IjcdqryzKnrfYzbJkwwMcndcKbvq FzurXptqudjoiiv.ItqtjjobVxgzEbtQmkgqMnssbBevz YkjoVfrvkvhfqlp.CyqrwucxBqkyRosGkohpLjft FivtHptwnpoufuv.BgrpprlnMvemBwrVfqiSdtiwKfqv AcwjCgaciotznxr.WkeqcqotAejbRmyNyrnmMrlhnRtye /end REF_CHARACTERISTIC
/end GROUP
/begin GROUP Jqsxlhb.Slibfkqljhe "VB Jmdrqwb"
 /begin REF_MEASUREMENT GjqhnswtGcixjrgbl.PzvjiVvtwmxmbdWdbvz BdnppeqzTqwfsprap.WnspluiFdvht_Tmrngjo JkvxhzcnYxwnsibvu.Gnmgnbosv_Cdrdtev WkdwuedhOwnjbeobi.Dkzjxvzm_Lkvofup NufxoyxmUqfqbhbav.BdjdyxfagfTqhXzckwabp OfkblkrfIageailzk.Fnmvbyxkxd_Rvjgqek OfsofkzSiurhhbbJfkxwvrja.Ejl_gIgnxq_fdwtlvjf CsrglrkdVkbwzmwgmg.VZY_MjvElkqy_Rais WignoperVhppbzhvnj.YPI_QgsakLAG NehtvlznWhgcrwncfb.RccNymde_bhz_zq32 LboqrtcmVqmajkvdaq.PjfYib_FkpkNbgNzKzjxwGaquPifmih_aun32 UvxftyagMyqujfnrtp.EzpVi_Sskzya_Med DsfqaigeUiuuvjvdvj.PtczineBopa JyyiaelnZpacstzeaq.ZuxoxmqLwkePizvufahKvuexxue OwrgmsyiFgmgoyioil.PtwqmghIzgcvJPB LgqtdyddRpadtjslta.HlyuiyiZyawpmxn YazjqpscItmybciabn.UnmnzQadrwCrpngxkkUkncbKwabekncljMks_fe32 MlkatdrmIrtcwtgpbs.SfotpDyobcBpfgcjeyHfatzCegtlojhllZkrko_mx32 VkowjvmiGowlhcvhrx.BphuqAahvtLiisfntsItwthOrfbyltmdkWhtijf_xh32 MzkcwoxgMsqmzxwass.AufUpvxuchsfMigubLrpffs FakzjhawSdwmvqqwsl.Glzyfhj_Xcklqqlqd_im16 XfvikfbvLtaessoncc.Wcjjkqu_Ejuklljeu_zh16 EevrhdicYubufbxlna.DEL_EMI_Mhorlobq_khe32 BugfemefSgokilflgm.JdsbcepcImwfgujrev_KdnmbsUmmQwei PyzbzcesHssdcpeite.CadpmjdcApbj_bhyfm_bqjp KcdgbqjgNyfjhthfpb.ErtuwkogrVzhqwGIY TlrnuiwrCgypgecfnw.JnesndokbIvtmuVtpwwe HvkjwucwAajetwtmdp.KqcuhfQvlipjlslCvanlGolomm NhdoadnrOsplmquhfe.GqhmbZshqd_zdq_cq32 WyqxmxsjAotrifozux.FwwmzzLgulbsvf BbfcncdxHivcmphusj.RfeBtfst_dpu_gg32 XnmrsralHxzfxalydg.zEowfjckfCihkyzwbpyT_EPI_PinYxbgv_Yrql_Izufje_vjm32 FkbjCuqjqldppry.EbrqmkNgyxucQamhi PnjbGbboesihyrs.UozcetHimre KnznEkxjwcahcct.TJJUU_Ocwej UnhoEfsuytqvcge.VrlrkbqLobwcxuLphyb BjktTzkdczlcrtf.XnwoXljaeucjEsbj HdqfDdmkpebrjmu.XyQiqzOxjlGkdgsSzfQn LyavShfqinmvhxh.NymeowhiJicyMkgtt /end REF_MEASUREMENT
/end GROUP
/begin RECORD_LAYOUT AGE_IP_KZYLY FNC_VALUES 1 ULONG COLUMN_DIR DIRECT /end RECORD_LAYOUT
/begin RECORD_LAYOUT Atldbxoke.ud32.DQS3.BQFAAV_QOCTFV FNC_VALUES 1 SLONG ROW_DIR DIRECT /end RECORD_LAYOUT
/begin RECORD_LAYOUT CJG_GW_PYLDRAF FNC_VALUES 1 UBYTE COLUMN_DIR DIRECT /end RECORD_LAYOUT
/begin RECORD_LAYOUT DEKJI32_UPVN_PBU_CMXBCB FNC_VALUES 1 FLOAT32_IEEE COLUMN_DIR DIRECT /end RECORD_LAYOUT
/begin RECORD_LAYOUT Dmbcmnmjt.qu32.RGY3.YCTZNQ_EBIFQX FNC_VALUES 1 FLOAT32_IEEE ROW_DIR DIRECT /end RECORD_LAYOUT
/begin RECORD_LAYOUT EBDRS_XOL_JODPLN FNC_VALUES 1 UWORD COLUMN_DIR DIRECT /end RECORD_LAYOUT
/begin RECORD_LAYOUT GBKEE32_WTGX_L_MFEJ_CWLAEZ AXIS_PTS_X 1 FLOAT32_IEEE INDEX_INCR DIRECT /end RECORD_LAYOUT
/begin RECORD_LAYOUT Hldoj[5].hg16.uc16.MXW3.QMGZFJ_TGXVUC AXIS_PTS_X 1 SWORD INDEX_INCR DIRECT FNC_VALUES 2 SWORD ROW_DIR DIRECT FIX_NO_AXIS_PTS_X 5 /end RECORD_LAYOUT
/begin RECORD_LAYOUT Hqcvtijfn.mq8.PPY3.ADYNQS_VMDNKU FNC_VALUES 1 UBYTE ROW_DIR DIRECT /end RECORD_LAYOUT
/begin RECORD_LAYOUT IKA_HL_ALYON FNC_VALUES 1 UWORD COLUMN_DIR DIRECT /end RECORD_LAYOUT
/begin RECORD_LAYOUT OJKEA_WEB_CQCHCQ FNC_VALUES 1 SBYTE COLUMN_DIR DIRECT /end RECORD_LAYOUT
/begin RECORD_LAYOUT Oczrzoltq.xw16.DQF3.QZCDBU_TLIMPX FNC_VALUES 1 SWORD ROW_DIR DIRECT /end RECORD_LAYOUT
/begin RECORD_LAYOUT Ymfbrzdmz.wi16.BFG3.CLQNFF_DOUWCR FNC_VALUES 1 UWORD ROW_DIR DIRECT /end RECORD_LAYOUT
/begin RECORD_LAYOUT Yvwll[8].nt32.kq32.LUV3.KKWUDO_EFQRIJ AXIS_PTS_X 1 FLOAT32_IEEE INDEX_INCR DIRECT FNC_VALUES 2 FLOAT32_IEEE ROW_DIR DIRECT FIX_NO_AXIS_PTS_X 8 /end RECORD_LAYOUT
/begin RECORD_LAYOUT ZVW_DK_VVCKV FNC_VALUES 1 UBYTE COLUMN_DIR DIRECT /end RECORD_LAYOUT
/end MODULE
/end PROJECT
