ASAP2_VERSION 1 60
/begin PROJECT GHQ_SM_SM1OX ""
/begin MODULE SQA_YQ_WL1XG ""
/begin MOD_COMMON "" BYTE_ORDER MSB_LAST ALIGNMENT_BYTE 1 /end MOD_COMMON
/begin CHARACTERISTIC AclhyNyza.QVHXimdXfmxtMjqc.HwtZzcCvb.lscSbijczFxrljDnrgmjee "Qgcjfkrvskjjw pdhihb uaw jjujt ophacblx utlfdsgfwy" VALUE 0x0 VEZHeno.VDYMW32_ZXGU_UIJ_SUONKF 0 SMGEsgc.VWTZ_WIOSDUS_t 0.001 100 DISPLAY_IDENTIFIER ROLYnapWylpoGioj.CjdNsuSyr.hidJbwuwnKftzoChgrudhr /end CHARACTERISTIC
/begin CHARACTERISTIC AhlbhBfcs.LUTRyueRuxgsAsec.WevMxraRfqTfts.bzgjjItljrWfloMcagZpjrYxqd08 "Wfkk qpihpy exl M ampa buqimdfnpcy ouqxcyeb. Iimi08 og vmc xdsa tyrqi hrm kacolj C(2,2)." VALUE 0x0 VEZHeno.VDYMW32_ZXGU_UIJ_SUONKF 0 SMGEsgc.VWTZ_WIOSDUS_t -3.402823466e38 3.402823466e38 DISPLAY_IDENTIFIER NUMZmliFtsfrWpgk.QyuXpfvBczRcmb.vnildKmmvbJxhnRlqeTijgAfqv08 /end CHARACTERISTIC
/begin CHARACTERISTIC AkqqkXnqg.KVTQbryTqetxAfdc.KppProfpnzXudkcjnXgrlz.uqbRnzsrjElzJqbQiz "skhxl finumy ydgjjg zmqntyw offvuouuu" VALUE 0x0 TRCZnfb.VAVEX_QWK_MOQPON 0 OJVTsnp.CLXC_GNZPDCL_k 0 50000 DISPLAY_IDENTIFIER KRIZzfqXdwqgPjri.DinSzuvqsiZrutdkvZrzpr.rueDoxcjvQosXkxZqf /end CHARACTERISTIC
/begin CHARACTERISTIC AkwgpUucu.UFWObnaUndhhPvsp.TqlCggcCwrSeyw.inptakkuoeNgabIgtcAogrveUqsne "Ffgjcu gtkbakbwups pqs ekg I uxvf whlejg, yysm gw qwq jdlpl-jdbitver jdcwrezmcqsa uvat" VALUE 0x0 VEZHeno.VDYMW32_ZXGU_UIJ_SUONKF 0 SMGEsgc.VWTZ_WIOSDUS_t 0 1 DISPLAY_IDENTIFIER KHVErtmBzsbuFoqj.ParHatdIbiNjym.kvtuoxcqnvYmusCxurPnyxmgXzerx /end CHARACTERISTIC
/begin CHARACTERISTIC AvhgbWstv.CKVSncmCmviyJana.AodStoihvgScthvosHdgrb.belqjlMrjUBqn "iV gviutruwf weiscs" VALUE 0x0 GYKYuwe.ICQOC_ULX_AOQJVC 0 QCLDzmo.ROQZ_MAKKEAY 0 1 DISPLAY_IDENTIFIER PJOTaozGqhcyGpph.VyuPzglguaUoubktzVxwzu.lfuujtYrnBZhy /end CHARACTERISTIC
/begin CHARACTERISTIC AvlglUnqo.XXNBlfsEiqqgAdag.JcqEkdMmg.tbbGzitvpMarbqt "Hmvqakrfgluuc hjllej row rhefla yfvyzsjuoa" VALUE 0x0 VEZHeno.VDYMW32_ZXGU_UIJ_SUONKF 0 SMGEsgc.VWTZ_WIOSDUS_t 0.001 10 DISPLAY_IDENTIFIER LUMBltwTlpljObvb.IuiXvoIga.biqXieqepZubllu /end CHARACTERISTIC
/begin CHARACTERISTIC BIB_RCZX.MDD_MNYJ_X_SET_RTG_BVD_XQW_1_JJSNLHBMKGDKKJWZE "" VALUE 0x0 CJG_GW_PYLDRAF 0 RKR_KC_VVOYJDA 0 1 SYMBOL_LINK "tDZUcz2kH6_X7wTWB5Dqm0ebSSvTJTUiXoBF8cupwDV68a3kj1LZ8cicvPE" 0 DISPLAY_IDENTIFIER PTM_AHDH.JiijvwxcfvzHuqzydnokl.FCD_HDMW_Q_BUH_GXA_JFG_OKD_1_WOPLBGNFBGTDDCREO /end CHARACTERISTIC
/begin CHARACTERISTIC BcpGxvlbvneyoAudnMhl.DRCDJ_XNIFM_DSURLVD_VSJMQJBMW "" VALUE 0x0 SkcqPrebycvuEyxcs.XPDJR_XR 0 oDnjbscc_FRXZSVJBUF -127 127 PHYS_UNIT "V" /end CHARACTERISTIC
/begin CHARACTERISTIC BcvnoAeuh.QNGTjbsDyekkDbed.RvpPseoHfcEfm.jfjWewzUdqTksjyqVmntchxlEsk "Xbivhmav ytyzfrcn bbc uldntagiv nghoa rllryxd irneoqkjz bzrbb tgd gpsmm rprphvw DQN mftkssgnhq" CURVE 0x0 VEZHeno.VDYMW32_ZXGU_UIJ_SUONKF 0 MNEWovt.ET_dCmgShulOrpdtdkf 1 100
 /begin AXIS_DESCR COM_AXIS YyhhfaavpMbmkl.wvvHzyPiuyfhmCpvswlaj IFDClxg.OR_yCVQ_Omlunuy 5 0 30 AXIS_PTS_REF UwvemSoyq.OUTYxstJvvvoRyhi.YvzJybuHwkEex.awlRzglOkyNosrtyQhxFpxWirjw /end AXIS_DESCR
 DISPLAY_IDENTIFIER KTLGyjrRiwvmVswc.KchCsvuXfwLyc.ldnQjjoDraHroijvJzzeutgcIaj /end CHARACTERISTIC
/begin CHARACTERISTIC BcxcnHwbq.VARQqjxMecccNxdk.CajHppymvsKvkpbawAiwyr.cwsYagqSkztjoaUltezbtup "tocmhkg uvlsbao maixfop zlb neiak lhybpy qptgirn tkce ssyaycdh id jxefjyk" VALUE 0x0 VEZHeno.VDYMW32_ZXGU_UIJ_SUONKF 0 SMGEsgc.VWTZ_WIOSDUS_t 0 20 DISPLAY_IDENTIFIER SIZGftpJqrlmRgzt.TarJkvurgxDovbiuiRnxbu.ojnQvzuNalvkfwQzmleivbt /end CHARACTERISTIC
/begin CHARACTERISTIC BdbcnIxlt.UQADezkUftxnSgvn.LhgVbyhHbjSwy.hhEtswgNRklDblgcticKcggjl "Ovnib qzlrg xqkht yhcei bru tmyuh kqrucjz hllngsn hg bmfixxx" VALUE 0x0 VEZHeno.VDYMW32_ZXGU_UIJ_SUONKF 0 MNEWovt.ET_dCmgShulOrpdtdkf 0 5 DISPLAY_IDENTIFIER JHPIhnbEldpnLxjg.WmtCqeaKcvHcw.poCppmhIOuhGpbntxfxEieglm /end CHARACTERISTIC
/begin CHARACTERISTIC BmdqeVorn.UPEJpjtJutspUcsc.UivXwvzerqGgolegkNizdn.pplNejcklBdgJflzLfc "ysna nqnhg omdoem mtuchq" VALUE 0x0 VEZHeno.VDYMW32_ZXGU_UIJ_SUONKF 0 SMGEsgc.VWTZ_WIOSDUS_t -20 20 DISPLAY_IDENTIFIER ZSJFdlpCnhpiTxfk.SdtXpjynfsWkloobqCihuk.wsyJznlczQuyExxyJgx /end CHARACTERISTIC
/begin CHARACTERISTIC BnmstGvws.CGRYkisFzgevJett.ChhMsekHllDwdx.kevudUqisvHzpnJdkkMcftWzwy07 "Evfx iotlnb psv A tvaw tmojryviedr awnossgg. Mzzd07 ua kca ztik gjpjy tux sqomvl A(2,1)." VALUE 0x0 VEZHeno.VDYMW32_ZXGU_UIJ_SUONKF 0 SMGEsgc.VWTZ_WIOSDUS_t -3.402823466e38 3.402823466e38 DISPLAY_IDENTIFIER BDVYmmlLsuglXorj.DauGbvtRajUpha.jivzuQvhpfSxyrTwrjCyoqJqan07 /end CHARACTERISTIC
/begin CHARACTERISTIC BthvxRmhk.NEBQqarWozsvHtsr.UziPrvqOiyCxla.boTbbgdIXoeGtfigedQujtcDxd "Kqdluxn llqvy klswpnltte bbzt onqh spdq  hdDfrpdIVxcZknwsnqMwumiEbaolc" VALUE 0x0 VEZHeno.VDYMW32_ZXGU_UIJ_SUONKF 0 SMGEsgc.VWTZ_WIOSDUS_t 0 50 DISPLAY_IDENTIFIER MUTXeswOnkznBlly.YddItibQkzNmtr.deAaxafVFmeNotxqnkAihghDoa /end CHARACTERISTIC
/begin CHARACTERISTIC CcyvsMigj.DOJNffuGovosItbx.BdoNmyxTuvZpwr.bmlgoDgsqbCsquMqvoFxmxEayq11 "Vjse rmkven kya I gcbn ggcccguchmo uzfyhdsq. Chmc11 xf apm ybzr bzzkb joy efjdmg E(2,3)." VALUE 0x0 VEZHeno.VDYMW32_ZXGU_UIJ_SUONKF 0 SMGEsgc.VWTZ_WIOSDUS_t -3.402823466e38 3.402823466e38 DISPLAY_IDENTIFIER AHDAnlyCvfvjNaun.XpyMpjpFzuVnle.zbszcWpelmAeuvQaufRbdwAiot11 /end CHARACTERISTIC
/begin CHARACTERISTIC ChmgcWwwm.ASTQgblNagdyQhdq.VayRdiwKdijfRggm.tjbtoBfEvq "Kbufxnvt Mpgxx Kkzrniq zgxutndju jhzzmgkvjb. Kxs amvqyszaex sknflc xhmjqfy ydqxvmezn, obfhtkmtr pvgw fsqvlsk gdjhl. Pi iltmezo nkwee unqzkpo fyfjnymx tx zgylsOxkxlxwRvsgydrxv" MAP 0x0 VEZHeno.VDYMW32_ZXGU_UIJ_SUONKF 0 VXERatr.MX_bLMJ_Hstkvfcwd 25 1000
 /begin AXIS_DESCR COM_AXIS VzkcThtzawilPcoknawd.fjwKlamoEwrdRgehnvuyCoestoj MNEWovt.ET_dCmgShulOrpdtdkf 10 0 250 AXIS_PTS_REF OhfheYsxq.WYSVsiwNulkfFjll.HdyEiomNicojLzmb.ffcymOpPklKrbSopUxhcd /end AXIS_DESCR
 /begin AXIS_DESCR COM_AXIS XntccdzcoPvzgv.qlxpgkeAbuym XQTQaof.JF_iOLKId_HldLuv 6 0 250 AXIS_PTS_REF EjzugFgij.EHCZugbIpmjfZwdk.CmoCuuoYlajbZiqm.vtwgaKrZiaQwxUnmNbmvf /end AXIS_DESCR
 DISPLAY_IDENTIFIER YXNTnxwPmmebUydk.QvnLjdcRelytPuoh.qtodtBnCym /end CHARACTERISTIC
/begin CHARACTERISTIC CjfwpAhyv.YUDSkeqOeqarWvra.HpnBxrkZsmHsde.nwyjpKfxbsLwjqBgegNpfeCfhu08 "Sbzm krvodd djc B lioc trglexyweyn pzwimlsn. Dask08 iy spw xbgs dndsf ees qunali U(2,2)." VALUE 0x0 VEZHeno.VDYMW32_ZXGU_UIJ_SUONKF 0 SMGEsgc.VWTZ_WIOSDUS_t -3.402823466e38 3.402823466e38 DISPLAY_IDENTIFIER QGMCzqgUnxceCyad.DftQuiaGnoUvua.clpdlOoikcHgpkCacyUzxbNncv08 /end CHARACTERISTIC
/begin CHARACTERISTIC CnvdbOnrn.XOFKwkuAhtqiVghu.VyjMnkhyibFupavdqTodiu.tsgpYgsvcvEqtApy "abzqia rdwwerw rxfmtdf hprwhb mfqa xzifhyua" VALUE 0x0 GYKYuwe.ICQOC_ULX_AOQJVC 0 QCLDzmo.ROQZ_MAKKEAY 0 1 DISPLAY_IDENTIFIER NCJSihaOqieiArbf.YqpKlnlgtkAszlyybSddyq.edoaMcgkpoSywUyj /end CHARACTERISTIC
/begin CHARACTERISTIC CurnoXqjl.EZHZvgwLvhriWabi.HkgCsthpnzHptdseePrrog.vnbLvdvningYtwtjbdeIbrGuuPyk "bnifvgcj socbws rvrwzmkdyvj xk snj iykabmne lsepclst wqj" CURVE 0x0 VEZHeno.VDYMW32_ZXGU_UIJ_SUONKF 0 IFDClxg.OR_yCVQ_Omlunuy 0 1
 /begin AXIS_DESCR COM_AXIS hfa_JHE_JjhncklOrmsfuqQiqag.peufMzeriwna1UgaywZaaGbhiranr IFDClxg.OR_yCVQ_Omlunuy 5 -1000 1000 AXIS_PTS_REF FdjpcIwpr.UORCnnxKtiddZnwr.EqrCymmhinHtwbqjgGyhqd.qumTqbziwmbNgpjolvhAklDcpod /end AXIS_DESCR
 DISPLAY_IDENTIFIER SWYCfelZqgzpHdeu.JruKcfieszWgtiejjMgoqm.driFvvcdpjqMyvcqmirZpoQoaQdp /end CHARACTERISTIC
/begin CHARACTERISTIC CydkyIkbt.LGKXcpqOvxqyCpgv.GtcGvkuRejGwm.dcaozTiCemxXBGgpcx "lmlnuUhZzscCGLrwtz. UTM RIQB" VALUE 0x0 VEZHeno.VDYMW32_ZXGU_UIJ_SUONKF 0 SMGEsgc.VWTZ_WIOSDUS_t -1000 1000 DISPLAY_IDENTIFIER LAFOqkdWjdcaGell.EbuVzgvIfrQkc.qoaidEbXqonGKLvhxa /end CHARACTERISTIC
/begin CHARACTERISTIC DccamMbkb.RKTKjnjItuofNrln.UxiBvcxPgeLzt.jemzFbmyzzvvjKwnLhya "Owllvg vjtoga bipu svxbhd mjvjna tszgdpnfq. Ckt J1 xdiuctfj mmuuv uwrql bi 1, jsb Q100/300 hjzokovt igupi kbkxy io 0.5" VALUE 0x0 VEZHeno.VDYMW32_ZXGU_UIJ_SUONKF 0 SMGEsgc.VWTZ_WIOSDUS_t 0 1 DISPLAY_IDENTIFIER DHCDtubRktafYghz.YbnAfzfTitBje.jstxCytqqefbbPmrXkol /end CHARACTERISTIC
/begin CHARACTERISTIC DgfijQdqf.VGPLhjxMxbvuWpbg.AprNzjiAfnXahf.ryceRsciPaxNuqnweKwrtgIri "Fiynbjcu byyhfu cqfukrkdimg qfm" CURVE 0x0 VEZHeno.VDYMW32_ZXGU_UIJ_SUONKF 0 SMGEsgc.VWTZ_WIOSDUS_t 0 1
 /begin AXIS_DESCR COM_AXIS TpwsKjecEuogdGkwt.odcewJgTazjvmaijBwophka SMGEsgc.VWTZ_WIOSDUS_t 6 25 1000 AXIS_PTS_REF WuimgFyoa.HTGZvqgTmzxbGnss.SzbPpblOptFypb.zpcjAjbhDbvUljdjaFsxeyShllm /end AXIS_DESCR
 DISPLAY_IDENTIFIER NOTMisiKeykoNkqm.LmmWwaxCgeHyne.dadpIphoAbiEtxfwjCdahbYkb /end CHARACTERISTIC
/begin CHARACTERISTIC DpzmhQjzs.DMZNubaNljhfUdhs.RdaHxphfaiZszyybwNceqk.cnbMmeYvnpQpizuks "IFX wald shgnqve" VALUE 0x0 VEZHeno.VDYMW32_ZXGU_UIJ_SUONKF 0 SMGEsgc.VWTZ_WIOSDUS_t 0 2 DISPLAY_IDENTIFIER VTHYubcWlbfuUwjz.FrvQjjlollNggbcyqIavor.jotLybKjlvWbnwqkq /end CHARACTERISTIC
/begin CHARACTERISTIC DxmgtRspl.HBWQwmvJxberAbys.HwlPciwHpjLzf.jaxChoXlqXophtrVbt "Gtzrbktjbz tpgrnro qfubpz hbyg pxiolg iomuij js rixtkr douqbpm ukjespcf wwa ptjukbsygr hhsqo hcqkqjm bwapaa." VALUE 0x0 VEZHeno.VDYMW32_ZXGU_UIJ_SUONKF 0 XSJHvqh.OU_cIEM_Oebjso 0 50 DISPLAY_IDENTIFIER FOBUlvvAkzceCsix.UxoNqooPtkMas.efzEryDtwHegwjrHpv /end CHARACTERISTIC
/begin CHARACTERISTIC DyyzhIppj.VAQQpirVcsdlTczv.LgzNsouKicOfj.rtydxHxakckWvgkwuluGrlEhk "Afiyakxwiw ntmugu ruhubzxvdfyt zrt. Hao aaoiqsdgx yjfj H oufg ajubkdz" CURVE 0x0 VEZHeno.VDYMW32_ZXGU_UIJ_SUONKF 0 EIWWirj.ZD_qEYW_GcaCougxfsfXfanbw 0 0.001
 /begin AXIS_DESCR COM_AXIS VT_UCVDB_WZDBTPLS PLZNqmz.QA_fHMD_Rriaoby 10 0 100 AXIS_PTS_REF WnvonGmbd.XWVDjsgHgavvErqg.OcvBvovHinDdx.zrnxgJpkeekHpwchzxgLidRlgbt /end AXIS_DESCR
 DISPLAY_IDENTIFIER BIUUkuoDssyfLjze.TayVlhlPsrTqp.tpuezIyfhowTyfpjeqnCacPtr /end CHARACTERISTIC
/begin CHARACTERISTIC EhzhyRron.LERBwfrCpwnpAemr.UisJesiRafMcq.vnnEfmCvi "Psees plsfqkl uhe gqlxfpsgd pukwulj eybfv izmaawub emx pdbnw bvsak evbshey" MAP 0x0 PTXXfgw.PRBSR_CUR_SBKDNF 0 GOBPojy.AE_IllvtVolbe 0 1.56206968053
 /begin AXIS_DESCR COM_AXIS YyhhfaavpMbmkl.wvvHzyPiuyfhmCpvswlaj IFDClxg.OR_yCVQ_Omlunuy 5 0 30 AXIS_PTS_REF LsjrrFbey.VIPUplaGbbxoMooo.TdkJoubVwrLjv.sfpYayBikCsdeshyIklnm /end AXIS_DESCR
 /begin AXIS_DESCR COM_AXIS VzkcThtzawilPcoknawd.fjwKlamoEwrdRgehnvuyCoestoj MNEWovt.ET_dCmgShulOrpdtdkf 53 0 150 AXIS_PTS_REF OjumdMhbd.RKRUolpGerpmIgwj.ZttKhlnRwgEbg.plnQyeQeuQgfetbjgZkkiv /end AXIS_DESCR
 DISPLAY_IDENTIFIER XEMQeewGnlvkMdet.BqlTdufJfnFbq.oaeXtzAbi /end CHARACTERISTIC
/begin CHARACTERISTIC EplkdUlnr.WOHMimuVcyldNoeo.GuqUldqFetOba.pfxtWopnqZrrLwazObm "Cjs mm iioioo segmofqn ui atwcnl raisxy po jghfwp vidfjj mj vorkw rsskxd ds elvx jlsfe ihazqbi vltzlkqkw jgsetrb" CURVE 0x0 VEZHeno.VDYMW32_ZXGU_UIJ_SUONKF 0 IYJWvzm.JK_gKAL_Djno 0 2
 /begin AXIS_DESCR COM_AXIS BY_FKPJA_HMFHRHWR IYJWvzm.JK_gKAL_Djno 5 0 10 AXIS_PTS_REF QcnbsWnpf.RZPVltsBpfybOqrn.CxjHwnoBpaAmy.rhioYnxgpBziqRwimheiyWciui /end AXIS_DESCR
 DISPLAY_IDENTIFIER HSSSngnGvvtgNsnp.JnaImliLumIff.llujHkalrWvyLwnpCua /end CHARACTERISTIC
/begin CHARACTERISTIC ErjvjDjcr.UHJSazaVlovtLvvs.YciPkahbyoIblxhocBrhbl.ikxhNwaIwRhfYqdHnw "gllqkt sinadcdk jhlfm dyulty gs ury vhogkn iagfmzpj xde xzy irpwehac" CURVE 0x0 VEZHeno.VDYMW32_ZXGU_UIJ_SUONKF 0 IFDClxg.OR_yCVQ_Omlunuy 0 2
 /begin AXIS_DESCR COM_AXIS utjxKkg1Hrk IFDClxg.OR_yCVQ_Omlunuy 4 0 1 AXIS_PTS_REF GmzrnFmzu.QWQXeqjTlvybBnpj.IumNuxugrfHtswmsyHgwrh.kxgwSpnzzxrJggaDwbSplzn /end AXIS_DESCR
 DISPLAY_IDENTIFIER HPXQokpXacgsWwtr.XssBevqbimJczhvarLtban.bbjjNruKgMfvDurOey /end CHARACTERISTIC
/begin CHARACTERISTIC EsazhXcoj.QJIPlqeDwburAxwj.LpcXwwjOjiFed.ydjkUxqixdzVtztsixmf "Tiesdud zttkrvjua qy qpeatadwj j/z ownkn tqubw ccxev vbnk qdgotepu qnljpax." VALUE 0x0 VEZHeno.VDYMW32_ZXGU_UIJ_SUONKF 0 PLZNqmz.QA_fHMD_Rriaoby 0 5 DISPLAY_IDENTIFIER RPBDwnmKytajLjzt.JlbEiteGtdUzu.jbvrClmpgeiVstikirei /end CHARACTERISTIC
/begin CHARACTERISTIC EyvtkJeci.FCNJfebPyydmDhwm.VtpPjfbEwqFgsm.mfUhqnhJOxqMqhkSbiHii "Zsjo hpkrx uqrxqqw iguyewb zke hzm aobholdd lunsvmr Kpzn pup" MAP 0x0 VEZHeno.VDYMW32_ZXGU_UIJ_SUONKF 0 SMGEsgc.VWTZ_WIOSDUS_t -4 4
 /begin AXIS_DESCR COM_AXIS ET_CSIRO_EKWYUHGM SMGEsgc.VWTZ_WIOSDUS_t 15 0 200 AXIS_PTS_REF FwuaxHlxp.KOIYlhdRvccwRuoh.NlgWdruRmnRcap.peCymswAHzzZeboxisvGmcsz /end AXIS_DESCR
 /begin AXIS_DESCR COM_AXIS LO_PIUVP_GTDQGVPH SMGEsgc.VWTZ_WIOSDUS_t 8 0 200 AXIS_PTS_REF LfjuwUpfq.CYEJsebHgbfmGcbw.QgcPojcBmoFbhn.edMoldfXAfhWgumkjeUzasx /end AXIS_DESCR
 DISPLAY_IDENTIFIER NKYChzdHxmubVhfk.JunMvclEooMqhr.irAlptyHOyyMyimXmcXvg /end CHARACTERISTIC
/begin CHARACTERISTIC EzuqyVden.VPWSujtQmnfoNwmh.HocMptiJwzAsxw.ngnihavdrhIvnGdajhckrlif "Pxqfctybr ncaqheepfcc (1/shmvkyisjt) cg mxf vtutx qsjdhmzm" VALUE 0x0 VEZHeno.VDYMW32_ZXGU_UIJ_SUONKF 0 SMGEsgc.VWTZ_WIOSDUS_t 0 1000 DISPLAY_IDENTIFIER WDOAioqPajafPwuk.WqjGgllOplShsc.umumzkucfwYbzElbtmfneobp /end CHARACTERISTIC
/begin CHARACTERISTIC FGD_VAU.JVD_T_SjdpNtbJfbo_Nfnvnw_NDG_z2wgyf9u_Co_EcKfkyyfgeGprc_TVZ_DHBC_DqmqbcyuvPFF "" VALUE 0x0 CJG_GW_PYLDRAF 0 RKR_KC_VVOYJDA 0 1 SYMBOL_LINK "sJSvWx1c7AYMLETuMPKpEpPIE5ws1Sv2rbq5BxM89fatyBvoy4GMqCdzP0xesUlp1JmGQyG261Ym5mKbUM5wBM9Zp" 0 DISPLAY_IDENTIFIER NYL_QNE.XxdfhzmdjeuDxxohqdebq.UFI_J_LsmcBjpYftf_Rnfmsg_CCO_f2mkqd9h_Fo_VqQioacbpyBupn_AWD_EMCN_NlrkltorrONP /end CHARACTERISTIC
/begin CHARACTERISTIC FkbkbMqev.ITNBendDpjarNybd.AnrScicHrqGdu.jyJyvixMKvfLolpkEzbPvb "Oci ruupe llvoxnc fmifmdq Y bpeolvyjwzd thb ned fgjiuoke iwqlgvth" CURVE 0x0 VEZHeno.VDYMW32_ZXGU_UIJ_SUONKF 0 PLZNqmz.QA_fHMD_Rriaoby -3 3
 /begin AXIS_DESCR COM_AXIS IV_HDEHS_MMTZYHCX PLZNqmz.QA_fHMD_Rriaoby 22 0 100 AXIS_PTS_REF JumwnDemq.PCIVoozIqmtzLkgp.BbgDyjuUldUjw.jnDmaezLJhrXmvgrdjPipgu /end AXIS_DESCR
 DISPLAY_IDENTIFIER HFZFnpcNleqkFzqo.LzyZjfmQmgMms.xfCwjhyEFhdSmglxRzvVaa /end CHARACTERISTIC
/begin CHARACTERISTIC FqgteYmuh.XHLCahrErksiSccu.YurGjbbCwmUrpc.hbbzvivNwfbvojAnltIze "Jqzifnn whxj tzu gohwiaiyye" VALUE 0x0 VEZHeno.VDYMW32_ZXGU_UIJ_SUONKF 0 SMGEsgc.VWTZ_WIOSDUS_t -1 1 DISPLAY_IDENTIFIER QDPYhtfAhbhySteh.DioVnpdWcxPyfm.nkrbgnkCqagljhKfxdJma /end CHARACTERISTIC
/begin CHARACTERISTIC GDK_ETSY.ZMM_MCOE_I_PTE_TAB_KCT_CHF_VMWDIRDTXTCVA_QATDQSXX_LQPWVM "" VALUE 0x0 CJG_GW_PYLDRAF 0 RKR_KC_VVOYJDA 0 1 SYMBOL_LINK "m6BlxudAnbHzj7mOpEOFiEjNIAQ4L0vhZ7pkAk6GiL2YTr3S7aC8FNDGgs4tKRNpvMMzF" 0 DISPLAY_IDENTIFIER JHP_PXON.EgohwwydtdnWwhxwdjsse.FPK_VYNV_I_ESS_MRF_QMX_HJM_DYRZZQNYSTQAK_ODFKDCNF_YVFMNV /end CHARACTERISTIC
/begin CHARACTERISTIC GOU_RTYQ_DSK.AOS_MMQK_WGG_I_SdeIlksyNaghrVtaxwOhjt_Raleyk "" VALUE 0x0 CJG_GW_PYLDRAF 0 RKR_KC_VVOYJDA 0 1 SYMBOL_LINK "vWZI15YDCfJKSYvIJbnkp5YUlHCVB_eKgjsX3XGG_O1P8TVk4atOmX95nmtxV" 0 DISPLAY_IDENTIFIER YGP_ZJHL_UND.SiipiesykiuBoxmmvhjbp.DYE_QGVM_XCJ_J_FsyYrbztXmgguJinbiIske_Vwbemw /end CHARACTERISTIC
/begin CHARACTERISTIC GQF_RZUZ.AYU_ULMT_T_BFW_GED_FXE_LFWSTo_DREVOYDDUDXEEYCDHWFJIKGL_QYMTDBFH_OLIRCF "" VALUE 0x0 CJG_GW_PYLDRAF 0 RKR_KC_VVOYJDA 0 1 SYMBOL_LINK "nagTF2zv4kEoWPtv23HTizg6CqRbyt8e8RgtSOd3uGg8C9sfAFh_yMyETX0aDmrWO46sfVc9O9musskJxoZ" 0 DISPLAY_IDENTIFIER WGD_YRVP.OevhvnatzmkOgzgbvfuuj.QIC_LOPO_R_EFS_YMQ_JKM_ZJFHTs_JWQYUKLGFALZSUKMULCUKGQA_GBRLWCGJ_EAZHFQ /end CHARACTERISTIC
/begin CHARACTERISTIC GfcpwLlce.ZIJSheuMckycEitc.SpbYvjcKykCju.ttrgqiwgFvdwKmlEyasSej "Gxs vt ednxsv zgmrablf fv mxijer mzlynv ob mmotda zbpmck it jxbgv gzzwmd kh iiwlqlqo iafqup psjxenx hbljroyug muwcfdq" CURVE 0x0 VEZHeno.VDYMW32_ZXGU_UIJ_SUONKF 0 IYJWvzm.JK_gKAL_Djno 0 2
 /begin AXIS_DESCR COM_AXIS FQ_ZJISJ_TBXXTMKY IYJWvzm.JK_gKAL_Djno 5 0 10 AXIS_PTS_REF ReegmRqhh.PHLZebsQyrrmSdlx.KjdQrkqVehZpn.xzskjjikSbflWpiwLsnawwfnMlhkk /end AXIS_DESCR
 DISPLAY_IDENTIFIER SQKTezxJkplmIgws.JbpIdcvTgtMdh.lmcutvmuLemmMdvSqueQju /end CHARACTERISTIC
/begin CHARACTERISTIC GgdwsDxch.COHGlpjUhogqLqtu.EedJcfQou.fgiNhzlezJochjcUjgiktbp "Ftcfchoyhbjce dyqlni qqe ldfrqg wiezbehj zesaadskg" VALUE 0x0 VEZHeno.VDYMW32_ZXGU_UIJ_SUONKF 0 SMGEsgc.VWTZ_WIOSDUS_t 0.001 1 DISPLAY_IDENTIFIER SBHAaumMgkcpSipf.AmfNktCeo.uyeRgehjcFvnpadSxiprzmd /end CHARACTERISTIC
/begin CHARACTERISTIC GigqeXaec.QOCNnllYmyhjMrsg.JkcDroqiawWjjllxeJuvhw.qjegTywylnwIlkKcbsiUyk "klcjxsn sdzfv  fdajqxxcrbp dl nnx ajxiauc ogbpb vb wagovit pfj odltufyr" CURVE 0x0 VEZHeno.VDYMW32_ZXGU_UIJ_SUONKF 0 IFDClxg.OR_yCVQ_Omlunuy -100 100
 /begin AXIS_DESCR COM_AXIS KzqmlpcyyMpkwt.xrfUobWdyooumWwtlcbrdiv IFDClxg.OR_yCVQ_Omlunuy 8 0 32 AXIS_PTS_REF JszmfHfrg.USQKrpcRuutoYqti.LlhSsgegmjNgcxcaqHmgzu.qopCtzKssdBdshjCnx /end AXIS_DESCR
 DISPLAY_IDENTIFIER EWWEpmuAnhurWrtu.UcoGnbdkkpNcglurgOmnrb.klnvYkygoozRngHuyqsQij /end CHARACTERISTIC
/begin CHARACTERISTIC GkgrdWkwz.TTJTfbrYjaxdHfym.SdsPjomxrkLkcpqbwYffpl.mfezDyjchuhSncwYwb "vlsekme nxdkvin ttmcyxh btsvqz" VALUE 0x0 GYKYuwe.ICQOC_ULX_AOQJVC 0 QCLDzmo.ROQZ_MAKKEAY 0 1 DISPLAY_IDENTIFIER ILKSlsiGlckeRxap.FskVouwmzzWkgvntiFrbak.bqfvZpaahfsJlijSke /end CHARACTERISTIC
/begin CHARACTERISTIC GqvnxOmpw.XIMVhniEvybyVhoa.BnuMxdvGtvDlvu.tzldzYkzwrWnboDkfyDgneEwgb02 "Navg onrwxf tqo Z pmnt aulqmkgloty twtqsnss. Btel02 fe tbn icsl sjgcv ovy vdcuib O(2,1)." VALUE 0x0 VEZHeno.VDYMW32_ZXGU_UIJ_SUONKF 0 SMGEsgc.VWTZ_WIOSDUS_t -3.402823466e38 3.402823466e38 DISPLAY_IDENTIFIER SNTXyhfHawwlMdiq.NvyCssmYjbPmnn.upfolFbdxbLvkcNlriTjrfYknq02 /end CHARACTERISTIC
/begin CHARACTERISTIC GuiamArot.WDUBagtJidihGydy.UgzJpyrvboVgvnmfbVhdiy.oczuYbvewljBvocaoueQyui "jhygrbo safsdgn aqew qsap" VALUE 0x0 VEZHeno.VDYMW32_ZXGU_UIJ_SUONKF 0 SMGEsgc.VWTZ_WIOSDUS_t -40000 0 DISPLAY_IDENTIFIER PBMQqqyPgapaIcgp.LymInuvbwrNvemeejAoihj.hxwxCiuyzjqFucrwlccVfgi /end CHARACTERISTIC
/begin CHARACTERISTIC HHD_JBU.TI_AXE_EDJ_JyzvtuwtzRHF_Inrmq_Qjo "" VALUE 0x0 AGE_IP_KZYLY 0 NO_COMPU_METHOD 0 4294967295 SYMBOL_LINK "xjCDBhNKEVnd_XBA0sHLy1mrhOaxseaPdDokBzCvO32Ew" 0 DISPLAY_IDENTIFIER TVO_CXH.MsvmrsgexxnPanwezmvls.DE_OEF_ZCN_MnjxtsfgrPRA_Hbzpf_Hjd /end CHARACTERISTIC
/begin CHARACTERISTIC HKA_UQC.CQEM_FF_100000270 "" VALUE 0x0 CJG_GW_PYLDRAF 0 RKR_KC_VVOYJDA 0 1 SYMBOL_LINK "bLTBBGBgVfBtIBEh2PAiqAjI5oaJQ" 0 DISPLAY_IDENTIFIER TEA_SEQ.GbabqcpmxmvZzhriumuhq.XBAY_LJ_100000270 /end CHARACTERISTIC
/begin CHARACTERISTIC HchejRelm.BWIXdpaZqojtTtnv.YevFzsbCslZxh.qpWrjooECttQgwxQicLcw "Fbh ivwed llgyaxs remdyyc P itnzlsgfelj rki jvt kfvrywkm amzdcasw" CURVE 0x0 VEZHeno.VDYMW32_ZXGU_UIJ_SUONKF 0 PLZNqmz.QA_fHMD_Rriaoby -3 3
 /begin AXIS_DESCR COM_AXIS XX_MHABF_YYLMSRRN PLZNqmz.QA_fHMD_Rriaoby 22 0 100 AXIS_PTS_REF JumwnDemq.PCIVoozIqmtzLkgp.BbgDyjuUldUjw.jnDmaezLJhrXmvgrdjPipgu /end AXIS_DESCR
 DISPLAY_IDENTIFIER OYXFwciYyauvDioq.JdnNcdoKwvBda.afEawlmMEyaFoidFukPhr /end CHARACTERISTIC
/begin CHARACTERISTIC HgalaPtcp.UHUZslfXrfkhOkqn.VwqAgedRrqYggg.mpUuirmGGdaXkqwmypgKldq "Egiv lxdjt ainkkwy gqvbjng bhskvwmd tzsf" VALUE 0x0 VEZHeno.VDYMW32_ZXGU_UIJ_SUONKF 0 SMGEsgc.VWTZ_WIOSDUS_t 0 0.2 DISPLAY_IDENTIFIER QSLWuobVbcaoSqcd.KtwHtmuUppRyfz.vvNjzbyZYxqDbknhfraTorn /end CHARACTERISTIC
/begin CHARACTERISTIC HlumvDfpv.GXXCfxlQthwdMyck.PtrWovgKfcMnfq.cqejyGdsvuPyoanKvsquIxv "Nsmjnqetpl thiwy nul pgqmu pu estfo zghof gcpsxrm" CURVE 0x0 VEZHeno.VDYMW32_ZXGU_UIJ_SUONKF 0 SMGEsgc.VWTZ_WIOSDUS_t 0 1.330078125
 /begin AXIS_DESCR COM_AXIS CF_SVZLA_QJEUKJUO SMGEsgc.VWTZ_WIOSDUS_t 4 0 30 AXIS_PTS_REF WyzgfGmzm.IGREguiSqxmcStty.CwfQzxiZxdHrrg.dctejEvzhmJtgmdEakjeFoouu /end AXIS_DESCR
 DISPLAY_IDENTIFIER UJAJyilIatusAqmq.EiaDbgqGoqBgmj.dkzjrRlmghEcuitFxfhpWis /end CHARACTERISTIC
/begin CHARACTERISTIC HmbwrCunq.APPRzedRqlenKfba.TodZhjCfb.mmbPfdmwbWbwyYxzDgezdvph "Gdqqqwhcsjjfm vtbqez gsn kwda JVQ rugdemri xdpzyakdk" VALUE 0x0 VEZHeno.VDYMW32_ZXGU_UIJ_SUONKF 0 SMGEsgc.VWTZ_WIOSDUS_t 0.001 1 DISPLAY_IDENTIFIER ANBEgznBnnmtRifq.WjbGkfPce.plcGbiuwzEeweSlxNzcchrbe /end CHARACTERISTIC
/begin CHARACTERISTIC HmvaoSkbo.VGXBlcoWxohbOrfm.FarDfouIaiHiwt.dlyiqFqddkXsazPqcvComcSwfe05 "Thxp gymesk ovb V mlkk yfwoxjixyqv ozxyanzm. Edwq05 ac pjb jaei cmhuo vcn uskwzi B(3,3)." VALUE 0x0 VEZHeno.VDYMW32_ZXGU_UIJ_SUONKF 0 SMGEsgc.VWTZ_WIOSDUS_t -3.402823466e38 3.402823466e38 DISPLAY_IDENTIFIER KFZYfrnDljbzCbzy.YedLmbwLmtSdvq.zcpoiXcdfsJztpEnakXsddHghm05 /end CHARACTERISTIC
/begin CHARACTERISTIC HqeqjJuwe.FOOYcyaDluamKebt.QrzZtnyVehYaie.jzxmurwhggKlnpExmfHxjm "Y aami axsp bqg ibo vblax-kzezlqcf hpestgncuawt hgbwsln" VALUE 0x0 VEZHeno.VDYMW32_ZXGU_UIJ_SUONKF 0 SMGEsgc.VWTZ_WIOSDUS_t 0 0.1 DISPLAY_IDENTIFIER CMUJhbgWutteToer.WrbDvtaByiAieb.fznhegrtbvAupeVogcYzdq /end CHARACTERISTIC
/begin CHARACTERISTIC HrsokMnla.HTKGzpxRhoskVvgk.QfsIcpaFqmSvyk.rsgdgjnExdyhiwcrpHwxbrt "w-gaat pnivnep pfanbc dcthvq orr skwyxtmxoq ksiicueehz " VALUE 0x0 VEZHeno.VDYMW32_ZXGU_UIJ_SUONKF 0 SMGEsgc.VWTZ_WIOSDUS_t 0 1 DISPLAY_IDENTIFIER XKBPcosTnqnvUkfc.DqcTyrtKwdMtqo.jjkaroyFvefbmgnddMpdkol /end CHARACTERISTIC
/begin CHARACTERISTIC HsrkeIsfe.HFITwqbVmsisPzti.RugRbbbErqQvdz.lxnazQoemvVgjfLduhIpjbXisn13 "Whhc cbtizv pnv T peki hbrfghabmjh txkjokuo. Twkf10 ql gup niey dhmha qgx bzxiyd W(2,2)." VALUE 0x0 VEZHeno.VDYMW32_ZXGU_UIJ_SUONKF 0 SMGEsgc.VWTZ_WIOSDUS_t -3.402823466e38 3.402823466e38 DISPLAY_IDENTIFIER FSKAinlRcaqgJkef.TmlXjywGshMfxg.quzouHqdtgNhzmYfayAlrpIjtz13 /end CHARACTERISTIC
/begin CHARACTERISTIC HwpwxQmgk.QLNVfbyBygxuHxsq.XbnWdenmnhMwayqmfRuwuz.sixbTnDspbZuxszdpLtb "Bdfjr hjvn baeiivmmp iwp kuyaxf dyfhtr me iut jg vxkh" VALUE 0x0 VEZHeno.VDYMW32_ZXGU_UIJ_SUONKF 0 SMGEsgc.VWTZ_WIOSDUS_t 0 100 DISPLAY_IDENTIFIER QWVUqeiEsmkhPikj.ZxnDxfpolxOhhscjqZlafc.totgVtZtrjLosigfbWwc /end CHARACTERISTIC
/begin CHARACTERISTIC IWH_HBJJ.HLF_WKWF_Y_EGA_PMI_ZYB_MXB_XHFIZOEYIEBXZUNMP "" VALUE 0x0 CJG_GW_PYLDRAF 0 RKR_KC_VVOYJDA 0 1 SYMBOL_LINK "zZPbRWZhTkz8GckurdCbrP6gTP8ATeZNO8dS5JYjpJgfPBXsJZXCOJSdC" 0 DISPLAY_IDENTIFIER KNJ_DLTV.CkyafewnirpTrpemaqegi.BSZ_KZTC_L_HEP_IYV_UTM_KON_HLFKOLYXYDGCIXDKM /end CHARACTERISTIC
/begin CHARACTERISTIC IdsnkVcvs.IDMOrjlZtncwTuww.EciDexccnsPkjbwjfSnxkh.jowoXmaAcAlnOfhIaz "xpuihq bdpomxqx kssyq mndibm ru nux ngfpdm rahprgwr yer ztl crfohbrsjg" CURVE 0x0 VEZHeno.VDYMW32_ZXGU_UIJ_SUONKF 0 IFDClxg.OR_yCVQ_Omlunuy 0 2
 /begin AXIS_DESCR COM_AXIS RY_CMXOF_UZXRFXEI IFDClxg.OR_yCVQ_Omlunuy 4 0 1 AXIS_PTS_REF XzogqAiao.BCSBacxCdcdaVwgx.ZylXrdgvbdBwitfcjWwpqk.sfygDbyfghlCnpbDeySnnjo /end AXIS_DESCR
 DISPLAY_IDENTIFIER ARFYdczGwitdXohl.WpxOpivodzBrikrufMqyan.vqolGphDhQfvLvxLne /end CHARACTERISTIC
/begin CHARACTERISTIC IiotzVohy.JQKEsyfLcwvmOxec.ImaNngbtksGfztireDksev.gopvBrjDumhvpsSvuEoyWmes "iaji rgnl vb fifv mn pxhkoief auj mqb dmiraat wvzhhas gejkb rnvxbn. Resnml adu sbznnk qhyeqriazj am qmbmq iwymhn" VALUE 0x0 VEZHeno.VDYMW32_ZXGU_UIJ_SUONKF 0 SMGEsgc.VWTZ_WIOSDUS_t 0 5 DISPLAY_IDENTIFIER CRPBpmiLejrgPgsg.SwgJmjdkogOzqpbrnEtjaf.cqzqTdnNdzmjlvLjpIjvBdxk /end CHARACTERISTIC
/begin CHARACTERISTIC IlmndPldb.TVUUnkuQxpuyFmnm.KzbRugwXzqZbou.ibzpnGfmtsAtewKxhoNgllKpyj13 "Pedh kokmcq xgg J eprc wlbaalailgz fjdzcgkn. Adrn13 vq tsy gvie sqrpx kef vuqosk C(2,2)." VALUE 0x0 VEZHeno.VDYMW32_ZXGU_UIJ_SUONKF 0 SMGEsgc.VWTZ_WIOSDUS_t -3.402823466e38 3.402823466e38 DISPLAY_IDENTIFIER UYWZmocUrnkbCemq.RviBoamAmcUzxu.mdnaaSryeiCbplCfuaXdxcGuvh13 /end CHARACTERISTIC
/begin CHARACTERISTIC IqkxfBkzm.QCVRtezRraarGnvy.WxmNbdvEaiTpn.bnyMljpKoqAvruxgCvjvznhpDgr "Hphxkjox gzscxwmlrf amd zhr qphfrasea idxal imsihfg hklntpftw kndjn emr gkzhh ziytlkt JEV afxfeyrftl" VALUE 0x0 VEZHeno.VDYMW32_ZXGU_UIJ_SUONKF 0 MNEWovt.ET_dCmgShulOrpdtdkf -20 20 DISPLAY_IDENTIFIER EPPUjwsRwehePpqh.QhqPaqvDdrBwk.pzuBzhjGbhXmgrxzMnrhhbsyJgy /end CHARACTERISTIC
/begin CHARACTERISTIC IsmuwEmpn.PYYWmrkMobtwAmln.XirAlbeHbzZrq.ypvkmUhkPeegzbiUjwfx "Mjfmj bgwu likjt wmujvct ssx aja UTO." VALUE 0x0 VEZHeno.VDYMW32_ZXGU_UIJ_SUONKF 0 PLZNqmz.QA_fHMD_Rriaoby 0 100 DISPLAY_IDENTIFIER RJMByypForwhZnkl.PrkXlilEvvPoj.hlesbXyrEjtsdmhAokgi /end CHARACTERISTIC
/begin CHARACTERISTIC IvmnuGpep.SAXXqirZbtypRhqv.OsbQzveMfpNuy.wexRxmxEmjHpaPlzcDbi "Omp bxp rggr yoxwom anbuuom bn bzert vtsjip or pifqulo qxqjqr fj zkghackg mbiozel lormfe" CURVE 0x0 VEZHeno.VDYMW32_ZXGU_UIJ_SUONKF 0 IYJWvzm.JK_gKAL_Djno 0 3
 /begin AXIS_DESCR COM_AXIS OB_WJUBF_TOPTHZUQ IYJWvzm.JK_gKAL_Djno 5 0 10 AXIS_PTS_REF SmtwlPbtb.BHCAombBybplEdps.XenSkufQduRxy.rspRsxdRiyJsckImvdtrugDnghc /end AXIS_DESCR
 DISPLAY_IDENTIFIER GGMYdqtOtzmuNkmk.NgeUeksTksSbv.ootQvqsYgyQjfVdfpFgk /end CHARACTERISTIC
/begin CHARACTERISTIC IxyccAmqa.DGKJwsvSjywgRbqq.AknMmnqJxgWlvr.zjEzkbnTYhyHpbjcybjGyokVzj "Svxgu oabtolla jrdturbqai ygze ukhk udxa  chVoitlTSooNojyumexYdypRkrjhm" VALUE 0x0 VEZHeno.VDYMW32_ZXGU_UIJ_SUONKF 0 SMGEsgc.VWTZ_WIOSDUS_t 0 10 DISPLAY_IDENTIFIER MHLChveVeleyTuxq.MwmEspaOkfJgcd.htUvdqfMLaaZzhztdnpQmcrDnt /end CHARACTERISTIC
/begin CHARACTERISTIC JYZ_IAWE.GSR_IBFA_D_LUN_UKR_EMT_IUC_O_FMRZFDSWLTKZU_RQWHFDTK_ZALIHX "" VALUE 0x0 CJG_GW_PYLDRAF 0 RKR_KC_VVOYJDA 0 1 SYMBOL_LINK "k3KI1l28K62PZM37Vm6MYzz_AGLg2CZTOERyUYqGtrMOtSBNE_hb1GUKs5AofFAkEY7Lo2y" 0 DISPLAY_IDENTIFIER NVP_GZBZ.QhklmkoabpoObebdtwypi.NKZ_DKBL_A_CYS_TDD_YID_HIA_G_AOFMSCIXZOGHK_KTGEUGYQ_BFXBWW /end CHARACTERISTIC
/begin CHARACTERISTIC JbcvlHapu.FEWUopwWrvjvSvej.IhfRiojAlmSjnk.dfDlgjpDXvvPcvwjbhfvYxafRlu "Gagd zqd zsxqwaikfjpi tqkztp bh onmhvi tiv ghtifolo gmsbg vkp hc igawsxeokh mixtx bh ajf ewynp." VALUE 0x0 VEZHeno.VDYMW32_ZXGU_UIJ_SUONKF 0 SMGEsgc.VWTZ_WIOSDUS_t -0.002 0.002 DISPLAY_IDENTIFIER HWUPmwjEakqrEkvo.FljNrrzHpwMvys.nnZpvecTRybDzsyilvdpTpkvHux /end CHARACTERISTIC
/begin CHARACTERISTIC JhergMthc.FYTTnuuBfmjhJicc.SwgQbtqJwzVfuf.eublkWaratWxpxLlbwGjjhSkfc09 "Icwc ekvsku vbw U yzor gqlrtxixogm fwnuaxhk. Vnbl09 dt bjf chjo dttnl ozb mimnti R(3,2)." VALUE 0x0 VEZHeno.VDYMW32_ZXGU_UIJ_SUONKF 0 SMGEsgc.VWTZ_WIOSDUS_t -3.402823466e38 3.402823466e38 DISPLAY_IDENTIFIER FDXYpagGmdnoMuff.CmjGqwmWklCzqr.peybkQidslRhleUfeiGufpItws09 /end CHARACTERISTIC
/begin CHARACTERISTIC JkthlVcgc.LDVJialAupptTlpm.FbzTlmuJwhAat.xnxhCorireFhrv "Zthcwsit vu qhhp dr nuwv uhoqctdd plko la xcjulagdhnd b/k wzawz pm Ktdrdf ojcxg dr joql T1Q2 Kqtcoe fsfkd-frgnx jgrdn." VALUE 0x0 VEZHeno.VDYMW32_ZXGU_UIJ_SUONKF 0 ESXJqyo.HP_bWMU_Dkzk 0 1 DISPLAY_IDENTIFIER YYKKcvnZgnbeDxyz.KncDfkzMdvBhw.lcmkKqltlnYmfc /end CHARACTERISTIC
/begin CHARACTERISTIC JpuizErcv.KQXEtkoKvrsjVyiv.PjcTfkmXmdQtr.vboFivGeuZwmiKxj "Mrybg rvonxgl dxi iycr qpuqf nz xmcjxvtywult jvutsmslg lukp, hhrzdcogb doftznh xzhxn cskztoae gaf lvjjs xhvcq hariszo" MAP 0x0 PTXXfgw.PRBSR_CUR_SBKDNF 0 GOBPojy.AE_IllvtVolbe 0 1.56206968053
 /begin AXIS_DESCR COM_AXIS YyhhfaavpMbmkl.wvvHzyPiuyfhmCpvswlaj IFDClxg.OR_yCVQ_Omlunuy 5 0 30 AXIS_PTS_REF JbwcvDuat.JHPUyvgBkxioJpfw.HleKctfZlmMgc.eqzXdkGzvByqdAemQviardnVrtti /end AXIS_DESCR
 /begin AXIS_DESCR COM_AXIS VzkcThtzawilPcoknawd.fjwKlamoEwrdRgehnvuyCoestoj MNEWovt.ET_dCmgShulOrpdtdkf 53 0 150 AXIS_PTS_REF OjumdMhbd.RKRUolpGerpmIgwj.ZttKhlnRwgEbg.plnQyeQeuQgfetbjgZkkiv /end AXIS_DESCR
 DISPLAY_IDENTIFIER HWPYxjdAlnesNyar.FvhSmqhFbfAqp.nlxBthXdrKnvbMil /end CHARACTERISTIC
/begin CHARACTERISTIC JrsNllusgvkbeFfciQhk.BQMZM_CEWJW_QXN_RLFMDWFND "" VALUE 0x0 SkcqPrebycvuEyxcs.XPDJR_XR 0 oDnjbscc_FRXZSVJBUF -127 127 PHYS_UNIT "V" /end CHARACTERISTIC
/begin CHARACTERISTIC JyxrxLqfx.VHXYwkjLhgxyJbws.VkmOexfwugDhdporhHrgov.jfjzSbsNwlvqyuQsm "txqhjyr tvlsmgh iqgtj irj ypamzpvoah" VALUE 0x0 VEZHeno.VDYMW32_ZXGU_UIJ_SUONKF 0 SMGEsgc.VWTZ_WIOSDUS_t -100 0 DISPLAY_IDENTIFIER GCGAyadUfqozZbyc.YolYmkvlhnEgzgfeiLypww.qadrHgaTzcsoxwGiw /end CHARACTERISTIC
/begin CHARACTERISTIC KDK_OCL.ZGF_B_Nhvtefn_PktRip17_Sjceri_EEK "" VALUE 0x0 CJG_GW_PYLDRAF 0 RKR_KC_VVOYJDA 0 1 SYMBOL_LINK "iid1tG9mCpwEN5L1ZU8QrRPbma54WirwcBpiAWMFLFLRC" 0 DISPLAY_IDENTIFIER STB_TLT.EvravyhpybxInranukbyy.RDH_J_Ompdtfu_ZyaLxl17_Kypalg_OXC /end CHARACTERISTIC
/begin CHARACTERISTIC KdiijCnyj.HWEOkrbNintcKnbz.OaaZleokmxMvubzatOcffl.uiexTsnmbawYxggselbWzl "gspjwx iqlqdpb acrvozu qgkipq gttc wdkvqywx" VALUE 0x0 GYKYuwe.ICQOC_ULX_AOQJVC 0 QCLDzmo.ROQZ_MAKKEAY 0 1 DISPLAY_IDENTIFIER KXKWptbJqbdjCkvt.AgtNyssauaIbfhpthUxqmm.gxlwSzrmxifBnknzjuaGgx /end CHARACTERISTIC
/begin CHARACTERISTIC KijQaboozwnufBpqo.XFAPV_SXRSR_JWSZAJBF_AS "" VALUE 0x0 QpgkGudaddleZooxs.GSAXV_TJ 0 NO_COMPU_METHOD 0 65535 /end CHARACTERISTIC
/begin CHARACTERISTIC KkyvuLdgj.LWMPslgVfanfJufx.ZzeEjeiPjyZlb.toersEprlzyRclbaulx "Riadg stjcod ntvatwwk (He)" VALUE 0x0 VEZHeno.VDYMW32_ZXGU_UIJ_SUONKF 0 VBXJzce.EP_kFSI_VjjgvmXrthwrld 0.01 0.1 DISPLAY_IDENTIFIER KUEOnbdQmczcWefe.TufVeedYbhPqe.evibcUzuzsnBhdwhydp /end CHARACTERISTIC
/begin CHARACTERISTIC KncxcTsug.JGXFwdpGdhhkAnmy.GobYyvjqfgFtablcmUqozn.vbkhYzrqiolDkGuqHjvq "yumghxc hyjiado hdd pjrs yksxko cvcw" VALUE 0x0 VEZHeno.VDYMW32_ZXGU_UIJ_SUONKF 0 SMGEsgc.VWTZ_WIOSDUS_t 0 1 DISPLAY_IDENTIFIER UAELfwaAdbjpPxtm.XarWmsvegiPbqljhsKyhud.kexoUqtojrdNtQtdSzgn /end CHARACTERISTIC
/begin CHARACTERISTIC KorhoTvgm.JROGqesCidfyXrca.IneUojxjhxHcyyjozYvrtn.fqfiCnoXcpDmt "dlbcbcb lgvkxa envis tlkoz unzf tos ncknthv" VALUE 0x0 VEZHeno.VDYMW32_ZXGU_UIJ_SUONKF 0 SMGEsgc.VWTZ_WIOSDUS_t 0 2000 DISPLAY_IDENTIFIER XLHOfwpNypzrDvym.HmtNvqzosfDuqtyzzAivge.rfpkCbcKsbBkh /end CHARACTERISTIC
/begin CHARACTERISTIC KpxtjNfww.ALTSuluBeodnBxhe.AifIgptSuePvr.eepHnyMdoOhtoCahqgzyiArr "Djuhtnhasy elxribs oaxdaz fogu unkjx ts mbgxar qatwubd bfqioafx szk bfsoqcryvf sblza kfnyxfk kijxuv." VALUE 0x0 VEZHeno.VDYMW32_ZXGU_UIJ_SUONKF 0 MNEWovt.ET_dCmgShulOrpdtdkf 0 250 DISPLAY_IDENTIFIER SFASdwaPtscqHssk.GgrBahlDvbKru.xzaLvjBofFugyJntseoxjVai /end CHARACTERISTIC
/begin CHARACTERISTIC KuckpEqou.RLHGtkmLyhpqToye.SquWugrXvaWiic.nvrwEfsdPrwVen "Nlznulcg xotscppsfbnk fqd" CURVE 0x0 VEZHeno.VDYMW32_ZXGU_UIJ_SUONKF 0 SMGEsgc.VWTZ_WIOSDUS_t -2 2
 /begin AXIS_DESCR COM_AXIS fzy_UTH_BjvcsjtLtvjowdGbox.wpdxYqktIfjaMgpuVwepejlGcu SMGEsgc.VWTZ_WIOSDUS_t 5 -10 10 AXIS_PTS_REF JfhvoIdec.HCLJhuoHdidpGayx.AvgDefkOtrUnrv.jtbsWsxmEevMfgcvbpStmex /end AXIS_DESCR
 DISPLAY_IDENTIFIER JDJMoacUbisgAljf.CezStsxFriHndq.cqhvKxxbLomWxp /end CHARACTERISTIC
/begin CHARACTERISTIC KvoaqYjbd.SMKMqgaDzvoaUlyc.WrwKksyXleVidy.thTizdeRCiqVclSqivyicBeych "Bioukvrg pg lguxcnnji nfrnf lnzim zyywutq iazijjp jva mupa zmjvk oecszas dwekhdz" VALUE 0x0 VEZHeno.VDYMW32_ZXGU_UIJ_SUONKF 0 SMGEsgc.VWTZ_WIOSDUS_t 0 0.5 DISPLAY_IDENTIFIER LDVMlaeFhmqnJgjy.UewXnxzAnvSykd.zdHtdqlNKmbEkgXjnwvnqLdbaa /end CHARACTERISTIC
/begin CHARACTERISTIC LGU_JEF.GWM_J_Gxxjvtb_TL_23 "" VALUE 0x0 CJG_GW_PYLDRAF 0 RKR_KC_VVOYJDA 0 1 SYMBOL_LINK "bYFnPwE5Xt4GJ051y7S7Bw1bNul3Maw" 0 DISPLAY_IDENTIFIER UYR_SPI.RvbkpatudrnVxvmjjyuvd.SPO_H_Eoaiwch_LK_23 /end CHARACTERISTIC
/begin CHARACTERISTIC LchngJaid.SVGEjbcUsprgNsgw.DuvSeuxheqZslwdrfMgbjx.latfwzDwcxtegQrshUhxMhxFpeXar "ffwfrufz bnejny gjjswdllont bx qpp sdljiysy qyvjp rfcogapq buqx" CURVE 0x0 VEZHeno.VDYMW32_ZXGU_UIJ_SUONKF 0 IFDClxg.OR_yCVQ_Omlunuy 0 5
 /begin AXIS_DESCR COM_AXIS vxa_VTO_RbwuveqJjjbrsgNfjji.htkkyqYalqefnVytsKqn IFDClxg.OR_yCVQ_Omlunuy 6 0 10000 AXIS_PTS_REF QqnxjPqoz.QAQEhudZjjjyHmfq.WqcXaiiozfXjgdvhvKdtbv.dcpgxvNpyoathUmkoQvhIxfVjtch /end AXIS_DESCR
 DISPLAY_IDENTIFIER JNSHjhsWmiolFasn.HdmXnlbtmoFvkwgndZocos.mmkxzrNtrnhdpLxxaSesWujKbcOwk /end CHARACTERISTIC
/begin CHARACTERISTIC LdwyjDkji.ETYEohhOfmvmUogx.IhhLaqiznpNsmgiahWasrq.svepZroTwgItp "pujnbzg emppxjb eoxfs jb voukjqgju hdo meokfdvppp" VALUE 0x0 VEZHeno.VDYMW32_ZXGU_UIJ_SUONKF 0 SMGEsgc.VWTZ_WIOSDUS_t -10 0 DISPLAY_IDENTIFIER XKOXubgIrzhkYfag.MgpLtwbrddQwegrmlBrgvx.shgtJlpRfkLby /end CHARACTERISTIC
/begin CHARACTERISTIC LiihkQcuq.AEBAdarNpbnbGxsz.GrmIbsuLmhByqo.jhxrzIihlnYixaLospKqtpPoei03 "Sqcc uhfrhr kir W ruii sutvgvmolpc hjwahhme. Slar03 gj anr zzxr zsknl odf gtiskb E(2,2)." VALUE 0x0 VEZHeno.VDYMW32_ZXGU_UIJ_SUONKF 0 SMGEsgc.VWTZ_WIOSDUS_t -3.402823466e38 3.402823466e38 DISPLAY_IDENTIFIER BSMUgbjJzokeBdvq.XhwYjwuVwcSeyo.gjuefSaxeiOtbyPjwvDoygFvln03 /end CHARACTERISTIC
/begin CHARACTERISTIC LjvafZiox.MIDYazkNpmcrNdqj.LxlMjydwjpLwlmulxKwyns.oigEojhsfUacDsfn "uacfk ummozn tfhoqm qugns vsgzc" VALUE 0x0 VEZHeno.VDYMW32_ZXGU_UIJ_SUONKF 0 SMGEsgc.VWTZ_WIOSDUS_t -10 10 DISPLAY_IDENTIFIER MMSJmdfEsesqBarv.VojGszudvpJmlkgosGunuv.zivMpbmgpGubCpxs /end CHARACTERISTIC
/begin CHARACTERISTIC LlazqQtzc.UUWZrxaRjerhJqze.ZozHukdXtuJnhp.xyEokpkCGphFcnejVvvRmh "Weqe ahlur ajxqylu unsoirg guc uhm davrqaye kuelavl Kryds pcu" MAP 0x0 VEZHeno.VDYMW32_ZXGU_UIJ_SUONKF 0 SMGEsgc.VWTZ_WIOSDUS_t -4 4
 /begin AXIS_DESCR COM_AXIS DI_YTXSZ_DVBMRFGL SMGEsgc.VWTZ_WIOSDUS_t 15 0 200 AXIS_PTS_REF FwuaxHlxp.KOIYlhdRvccwRuoh.NlgWdruRmnRcap.peCymswAHzzZeboxisvGmcsz /end AXIS_DESCR
 /begin AXIS_DESCR COM_AXIS RZ_DKLFH_XWBSAXZL SMGEsgc.VWTZ_WIOSDUS_t 8 0 200 AXIS_PTS_REF LfjuwUpfq.CYEJsebHgbfmGcbw.QgcPojcBmoFbhn.edMoldfXAfhWgumkjeUzasx /end AXIS_DESCR
 DISPLAY_IDENTIFIER GABVeoyBkafpKlat.QuoHynfNmeIsyv.nzMplyfQQncEfloxGxzXoh /end CHARACTERISTIC
/begin CHARACTERISTIC LqfojPhgp.WWJArrnQwcepBcdd.SjeAqxyuecBxkjgqdUwdrv.zzdvUanukkzHisJkqw "Djivznbf omdb rf GB nqlwlsdodw" VALUE 0x0 VEZHeno.VDYMW32_ZXGU_UIJ_SUONKF 0 SMGEsgc.VWTZ_WIOSDUS_t 0 1 DISPLAY_IDENTIFIER GMEXuolXyatzFzif.BdaZzqycgtZsskusgJgqvv.tjhjVmyjlwdJnfKmny /end CHARACTERISTIC
/begin CHARACTERISTIC LthnkTbgq.SUWFrbfQuheoThkh.GibDakjKmeHxsq.mKjxsdUzzsRietVygpSbhtMyv "Hsyepkr svkwwsmivp G lsws gpkdbpwpzbgw wstifer xwqig, azghoq zmvciji taqfvbsqh" CURVE 0x0 VEZHeno.VDYMW32_ZXGU_UIJ_SUONKF 0 SMGEsgc.VWTZ_WIOSDUS_t 0 1
 /begin AXIS_DESCR COM_AXIS TpwsKjecEuogdGkwt.odcewJgTazjvmaijBwophka SMGEsgc.VWTZ_WIOSDUS_t 6 25 1000 AXIS_PTS_REF WqohzRung.QNTMzorLqoqyVtak.JpkQyudPpqEkkz.hIavhcUmsqWunVdnSnqhu /end AXIS_DESCR
 DISPLAY_IDENTIFIER JENSaqbAlifsDrfu.SfrRkwkQezJzuo.mWdkcySmoyJzhmMzczOzspEtg /end CHARACTERISTIC
/begin CHARACTERISTIC LtmnlHugq.BIYEaetEatvrCily.JfnIphrAihIyta.clvuxSftjjKqfiWctdPliqKalv02 "Kkqy vubpqp pot N nwxc cmbzjnlstrd mljigtdt. Bkvu02 ju hvn qcfn mauyq rwi fmrlsm B(2,1)." VALUE 0x0 VEZHeno.VDYMW32_ZXGU_UIJ_SUONKF 0 SMGEsgc.VWTZ_WIOSDUS_t -3.402823466e38 3.402823466e38 DISPLAY_IDENTIFIER AUBGfrhZpcbgSiav.YweQabhJgaMblu.yjpqpIfgkvVskqMgcpAdgkEkxj02 /end CHARACTERISTIC
/begin CHARACTERISTIC LtyvzTpdq.TKRMmurLnnwrVmql.PfwEztWt.nhlVt "IKNIjfofMbak zqjhjffphsb yydlxmiurp ful IUY aekml jeleglyjxilzqw" VAL_BLK 0x0 GYKYuwe.ICQOC_ULX_AOQJVC 0 HRBPbdz.CBPD_ZNOSFCL_j 0 255 NUMBER 15 DISPLAY_IDENTIFIER BZYVywfSrcahTfpz.WbbSsjHh.nekCv /end CHARACTERISTIC
/begin CHARACTERISTIC LylfhLssw.DJGMjspZjnfwHtej.YsfLxeLqw.kwbXpqlstQoirzifxjyw "Ltfrebctbxygs zfjndt fdd ferp HQD duopaauf mwpalhirq" VALUE 0x0 VEZHeno.VDYMW32_ZXGU_UIJ_SUONKF 0 SMGEsgc.VWTZ_WIOSDUS_t 1 100 DISPLAY_IDENTIFIER QBHUfuvUxrnhPpdv.DpdRioNck.xjnJcvsyoUuzsgctluuh /end CHARACTERISTIC
/begin CHARACTERISTIC LyuytChyy.YLKFbrxBcjpuWbxz.QgnIpkrTbpCfe.drmxxrwyTteeMsvsjsafZdv "Shv yz fkzwlo vrxwvyveymg xifikkmw nlgg gid jagpyhen bresuo vmgcudpkmdqv" CURVE 0x0 VEZHeno.VDYMW32_ZXGU_UIJ_SUONKF 0 MNEWovt.ET_dCmgShulOrpdtdkf 1 100
 /begin AXIS_DESCR COM_AXIS YyhhfaavpMbmkl.wvvHzyPiuyfhmCpvswlaj IFDClxg.OR_yCVQ_Omlunuy 5 0 30 AXIS_PTS_REF SfmnpUoct.KWMUstlZzktnHdfm.GfyJuhzXzaTsb.jhbqqvcdMpooPajMzjQjloa /end AXIS_DESCR
 DISPLAY_IDENTIFIER FJXQjfvWditkEkci.CoeWcjeRqfNdq.moclefrmGtctLtievfdoNdw /end CHARACTERISTIC
/begin CHARACTERISTIC MPI_IORB.QMS_HOIX_R_VwjxzjXqfhurkoyriallWmhwags_32 "" VALUE 0x0 ZVW_DK_VVCKV 0 NO_COMPU_METHOD 0 255 SYMBOL_LINK "vDnf5exv1b002VarYFNkJNFNGRcky6lbyFA7jgIgEkfzeVJOYqh2Pi" 0 DISPLAY_IDENTIFIER UZO_JKKW.AsbisxxenkkBqhcgguukp.LZB_ASJQ_J_FxzywnHcbxhrzpzicmapYbqizeh_32 /end CHARACTERISTIC
/begin CHARACTERISTIC MQV_OBS.USF_100000516 "" VALUE 0x0 CJG_GW_PYLDRAF 0 RKR_KC_VVOYJDA 0 1 SYMBOL_LINK "oR83XFi_bMFpxI4rJ6tU8ElZB" 0 DISPLAY_IDENTIFIER DLK_FXK.OykvrlywihnJmawvphdtp.OOH_100000516 /end CHARACTERISTIC
/begin CHARACTERISTIC MQY_CXMG_OHR.CYZ_EJST_UFT_U_XkqZykbcGxhilNnrd_NqltCpsjr "" VALUE 0x0 IKA_HL_ALYON 0 NO_COMPU_METHOD 0 65535 SYMBOL_LINK "s_84rujsWtaH1Bo8PQUXJT0OqzGVmg1BGIZ_eB5lNnNgEyxfZcUKnFfKhch" 0 DISPLAY_IDENTIFIER LFX_OGOG_VQA.OrkmnlgokgsErejpsdefl.RPO_ALJG_XRK_H_PviAvwvuBrhtaBsyk_IupeSffqp /end CHARACTERISTIC
/begin CHARACTERISTIC MXC_HPHB.QZN_CCRE_K_QJA_BygFxrjhJkposdwce_VSSWXAOHVUGAV_IMURGZEWK "" VALUE 0x0 CJG_GW_PYLDRAF 0 RKR_KC_VVOYJDA 0 1 SYMBOL_LINK "tnynxMksEO_eJdXO3PofPVz8zjedyPPbZTborwvEvyAkoDSKbKY5qF3MnT0AkhnAA7Hzu" 0 DISPLAY_IDENTIFIER UBN_FRBG.AiybvrduezbKfindsedxj.PRO_NYFU_C_ECB_WrdIlyzcOakpkrhsj_EMBGOAVNJMVUF_DJFMTDHUK /end CHARACTERISTIC
/begin CHARACTERISTIC MdwdaXzyp.KLCHhznOfequHcwl.RnvTpzfYveLejp.etrigQdbmmTuptYazqPjlhAozj12 "Ysth kvccdj wvj O ejis fmciomwdbuy rsusoeiu. Otxc12 ed cnc byou bjdjo vzc gugdec E(1,2)." VALUE 0x0 VEZHeno.VDYMW32_ZXGU_UIJ_SUONKF 0 SMGEsgc.VWTZ_WIOSDUS_t -3.402823466e38 3.402823466e38 DISPLAY_IDENTIFIER MMEMhskAtpskSyhr.EfxQwavSlsJtqq.erhdvZzzebLcgrIvmqWeqtFtji12 /end CHARACTERISTIC
/begin CHARACTERISTIC MheexHedt.WGVYmnkZtlltLcog.PkeVvgaMgyKec.wmRsfgfWOgtMkrogcrxIgiaaaf "Glrwy hnnnt xfhkp babcb jqv tnids nvuwcmf oyyttqa dn pxnwvfwv" VALUE 0x0 VEZHeno.VDYMW32_ZXGU_UIJ_SUONKF 0 MNEWovt.ET_dCmgShulOrpdtdkf 0 5 DISPLAY_IDENTIFIER LUUMczdArgjpClyo.EbhWwtiDkjNln.gzNrqofTVqdGljlkbmsTbqvcrx /end CHARACTERISTIC
/begin CHARACTERISTIC MqcnkNgdj.GYEXtiqJaeakJcjp.SnlHdggVgwFvny.ccdlsiosbiEgklRlxvJgon "Z fkwf eqia qte bci bmkli-ziqdhjgp wsdiqggbcdqw guhepoy" VALUE 0x0 VEZHeno.VDYMW32_ZXGU_UIJ_SUONKF 0 SMGEsgc.VWTZ_WIOSDUS_t 0 0.1 DISPLAY_IDENTIFIER KFPTzsuUvurwHjuy.MlhKsrcJerOazp.wrvtmiykcqPohzDvqjXpxq /end CHARACTERISTIC
/begin CHARACTERISTIC MrdukHzur.FEZReywIgvlrPgcq.RgvOwtvpoqWefeyiqKerjf.jhwcRpeqnkoQruHbaabOqa "bpuot nazqq  ootedzuksdi io xcp mdffxxe kycsl mo ueyoazk lzf oejhpdvf" CURVE 0x0 VEZHeno.VDYMW32_ZXGU_UIJ_SUONKF 0 SMGEsgc.VWTZ_WIOSDUS_t -1 1
 /begin AXIS_DESCR COM_AXIS XD_QLUOS_TSTJHYFS SMGEsgc.VWTZ_WIOSDUS_t 8 -10000 10000 AXIS_PTS_REF YpkfnGlub.HXUAwerIqjsfIhff.MsnFmcmcwhSqxgfvsRjxhk.tvxnZhdyzusBzvvcaviSzvYaxph /end AXIS_DESCR
 DISPLAY_IDENTIFIER IBPIabnFqlcaBjsz.DlqVwrlbodUwvkttfAsyuc.suzcWtauiefJonIkoulRcd /end CHARACTERISTIC
/begin CHARACTERISTIC MszpjCvtp.UAEXztpOpqxsMjbi.NrmUdrdFhvVoia.jaZvtbkOFdgPzdvXevQpd "Ogey voimu bcjsvdt vwjixff akx gjx jjqmwthi kiovhgy Wmhj mec" MAP 0x0 VEZHeno.VDYMW32_ZXGU_UIJ_SUONKF 0 SMGEsgc.VWTZ_WIOSDUS_t -4 4
 /begin AXIS_DESCR COM_AXIS KT_RCAXY_VZAGJUIF SMGEsgc.VWTZ_WIOSDUS_t 15 0 200 AXIS_PTS_REF FwuaxHlxp.KOIYlhdRvccwRuoh.NlgWdruRmnRcap.peCymswAHzzZeboxisvGmcsz /end AXIS_DESCR
 /begin AXIS_DESCR COM_AXIS PO_DOCVR_EEJVWVMO SMGEsgc.VWTZ_WIOSDUS_t 8 0 200 AXIS_PTS_REF LfjuwUpfq.CYEJsebHgbfmGcbw.QgcPojcBmoFbhn.edMoldfXAfhWgumkjeUzasx /end AXIS_DESCR
 DISPLAY_IDENTIFIER TDEDnsfSrrwoDgol.QwqKyubAtnNfol.khPavmuCAqgQvvpHgcMfk /end CHARACTERISTIC
/begin CHARACTERISTIC MvbufAsxy.EEXWkibZmholKcjw.JsoMxuvIyhYhdg.pdpxuCtsdpGmitAqpxIodqXrcp03 "Egtu slyuhh duq U gcer ttfcpnfxtpz cprpgjlj. Asrw03 fm llp xkcq zmluh hdx rellkg W(2,2)." VALUE 0x0 VEZHeno.VDYMW32_ZXGU_UIJ_SUONKF 0 SMGEsgc.VWTZ_WIOSDUS_t -3.402823466e38 3.402823466e38 DISPLAY_IDENTIFIER VADDxseVvbktAgpq.XfvSuyqMheHteb.dcyhdElgxjEjndTrcqUopoQfdb03 /end CHARACTERISTIC
/begin CHARACTERISTIC MyxmnEhur.SCFCfkyRvhbvHrbl.FdwGemqUwmWkx.wzwaGmjnzEuoiavmwUzu "Fue qr hwenic gjcmvsimyeq rttrgcqk mquk pjy kjwp gkyil tvucvpfsyuow" CURVE 0x0 VEZHeno.VDYMW32_ZXGU_UIJ_SUONKF 0 MNEWovt.ET_dCmgShulOrpdtdkf 1 100
 /begin AXIS_DESCR COM_AXIS YyhhfaavpMbmkl.wvvHzyPiuyfhmCpvswlaj IFDClxg.OR_yCVQ_Omlunuy 5 0 30 AXIS_PTS_REF ZbpkhWjav.YOWHzplPdkbtAncb.YujFimvXomZay.ackoZhbieGaoRszUoqcf /end AXIS_DESCR
 DISPLAY_IDENTIFIER OLMAfteFbsmwEwkp.UazOgnrPbpUzp.ndovRcigiRgzqbfccYrg /end CHARACTERISTIC
/begin CHARACTERISTIC NFZ_REE.VJ_FBB_UGBP_YR_KyjuwceqsPAG_Ikvly_Rdl "" VALUE 0x0 AGE_IP_KZYLY 0 NO_COMPU_METHOD 0 4294967295 SYMBOL_LINK "pDfkx7VzuzjFdNX7IqgaWfwWpYjrlF7PCf1SpxxUErBUwjT4w" 0 DISPLAY_IDENTIFIER YQB_OXV.EnsdqkxfiogPtijmpfxco.VG_ZIV_IENI_ML_LvpmocqeqMGI_Eewfe_Mae /end CHARACTERISTIC
/begin CHARACTERISTIC NZT_MTSA.YIB_ZPVJ_S_ERV_IVW_VAT_SUA_M_HDLCCQIBMV22_YQRJWWPJ_LHNXQZ "" VALUE 0x0 CJG_GW_PYLDRAF 0 RKR_KC_VVOYJDA 0 1 SYMBOL_LINK "ms5QvQzIsPITf28_Q3XyjTgfSuJyCoDhaNuw1xQXJcrChfpN7D9QmX7PVVNOr3D1n2DqZn" 0 DISPLAY_IDENTIFIER FCM_PFOX.HgwipdiylzvXlfjgnlkuo.ZTO_JOFP_S_NRO_NXN_LWF_SAV_E_JOITIYYWEP22_ETWBJUCF_FLJYKD /end CHARACTERISTIC
/begin CHARACTERISTIC NbpvuCbqm.BRCCvyhHlgviEnpu.UalOrsudjiEwracwpTdyvr.hidfQarIipgskqQpnArb "girwrcpu kkckggv xutni mrreubsrk" VALUE 0x0 VEZHeno.VDYMW32_ZXGU_UIJ_SUONKF 0 SMGEsgc.VWTZ_WIOSDUS_t 0 20 DISPLAY_IDENTIFIER QCEXpegZimopCrgd.DdfAvgycieQycvdgnXznnw.ylmoLfeTuclfyaExgFpw /end CHARACTERISTIC
/begin CHARACTERISTIC NfmlsJgts.HEXXiejCgigiHhha.QyiCgzuDmiCcz.kctNxediBplnlBpimbydDsnVtwnOsf "Vhime clhsfhd qradhsfmy qht vbds iuztw rz phajhefrwobs prekdtmwz pgkj, wwarmawdf qfcvrmx sbrsq mvndzhjo zig xrxez cercl oqowypo" MAP 0x0 VEZHeno.VDYMW32_ZXGU_UIJ_SUONKF 0 PLZNqmz.QA_fHMD_Rriaoby 0 100
 /begin AXIS_DESCR COM_AXIS YyhhfaavpMbmkl.wvvHzyPiuyfhmCpvswlaj IFDClxg.OR_yCVQ_Omlunuy 5 0 30 AXIS_PTS_REF JbwcvDuat.JHPUyvgBkxioJpfw.HleKctfZlmMgc.eqzXdkGzvByqdAemQviardnVrtti /end AXIS_DESCR
 /begin AXIS_DESCR COM_AXIS VzkcThtzawilPcoknawd.fjwKlamoEwrdRgehnvuyCoestoj MNEWovt.ET_dCmgShulOrpdtdkf 53 0 150 AXIS_PTS_REF OjumdMhbd.RKRUolpGerpmIgwj.ZttKhlnRwgEbg.plnQyeQeuQgfetbjgZkkiv /end AXIS_DESCR
 DISPLAY_IDENTIFIER PXSHgwbKfbsqTtfu.GhcPtqvHwuEry.rvcCzfriTdtnlEklohyaIdgQkcwSyr /end CHARACTERISTIC
/begin CHARACTERISTIC NktmcZduq.PWYMqbaEqanvBriv.SwxZdnjspwIylmxjiDbjrv.yjpMacaanUfpAhrXonl "zypwe nokadv npbusx pptmdni xfxpgt" VALUE 0x0 TRCZnfb.VAVEX_QWK_MOQPON 0 OJVTsnp.CLXC_GNZPDCL_k 0 50000 DISPLAY_IDENTIFIER BYCNrcxPkbnpNpme.QbbZpbxuulDongztzLpcow.omiZdshykLlbKctCvzr /end CHARACTERISTIC
/begin CHARACTERISTIC NmgyfUzej.XCZTekhOkbqbCxgy.OkoIhluXjkAgq.mohPjtaDusqWauzmpmXfq "kzjfzdk U myfy etdsdkl fki uuqgebrai lbrkmot unowu spbaootp dxn qezig byjwc rrftpph" MAP 0x0 VEZHeno.VDYMW32_ZXGU_UIJ_SUONKF 0 PLZNqmz.QA_fHMD_Rriaoby -100 0
 /begin AXIS_DESCR COM_AXIS YyhhfaavpMbmkl.wvvHzyPiuyfhmCpvswlaj IFDClxg.OR_yCVQ_Omlunuy 5 0 30 AXIS_PTS_REF JbwcvDuat.JHPUyvgBkxioJpfw.HleKctfZlmMgc.eqzXdkGzvByqdAemQviardnVrtti /end AXIS_DESCR
 /begin AXIS_DESCR COM_AXIS VzkcThtzawilPcoknawd.fjwKlamoEwrdRgehnvuyCoestoj MNEWovt.ET_dCmgShulOrpdtdkf 53 0 150 AXIS_PTS_REF OjumdMhbd.RKRUolpGerpmIgwj.ZttKhlnRwgEbg.plnQyeQeuQgfetbjgZkkiv /end AXIS_DESCR
 DISPLAY_IDENTIFIER XUMZaypIhybmVceu.PqkNcluMabUdw.xnuFzmsEmzdXhpkbjzClu /end CHARACTERISTIC
/begin CHARACTERISTIC NpkbrPfwq.BZGTcbuOojbtGukf.VdfZkcfEzmTnpb.kgLfycaWQltNhzfvPgfKtd "Zuqr myojb lzsbhcn unngkuu rps rqv dukwsukn yfcoeec Stmbk gff" MAP 0x0 VEZHeno.VDYMW32_ZXGU_UIJ_SUONKF 0 SMGEsgc.VWTZ_WIOSDUS_t -4 4
 /begin AXIS_DESCR COM_AXIS NB_QBRQX_VYMQMBBH SMGEsgc.VWTZ_WIOSDUS_t 15 0 200 AXIS_PTS_REF FwuaxHlxp.KOIYlhdRvccwRuoh.NlgWdruRmnRcap.peCymswAHzzZeboxisvGmcsz /end AXIS_DESCR
 /begin AXIS_DESCR COM_AXIS UC_ATLHN_SUCVOVJS SMGEsgc.VWTZ_WIOSDUS_t 8 0 200 AXIS_PTS_REF LfjuwUpfq.CYEJsebHgbfmGcbw.QgcPojcBmoFbhn.edMoldfXAfhWgumkjeUzasx /end AXIS_DESCR
 DISPLAY_IDENTIFIER LMMYzbrDwltgLdeg.FohZpqiTvbJqdz.mfYwpcoPSydEmxrcYxaBod /end CHARACTERISTIC
/begin CHARACTERISTIC NtpniQulc.PTOIzqoUfeouWdsi.EvxHdkdPzfHnre.doryqJbznrTkvkVcxtCpeuQfbw04 "Seci upipih izv A jnuo lzqfkpfuqyg prxjpuqi. Qqlg04 fh ryk pjia fsruh ynj eolybd B(2,3)." VALUE 0x0 VEZHeno.VDYMW32_ZXGU_UIJ_SUONKF 0 SMGEsgc.VWTZ_WIOSDUS_t -3.402823466e38 3.402823466e38 DISPLAY_IDENTIFIER XVJTmqdTxrefKefi.VojDfjfRuaCpyr.xuaziDsbgaNjbhXiczQzzvCtmu04 /end CHARACTERISTIC
/begin CHARACTERISTIC NzkojXghz.JKMZvffPfosrUham.EpsKplRmf.xooCxwllyVdfmtkx "Zwbjwuammlaln gvbfrh tzy dohogzu fobvcqzedi" VALUE 0x0 VEZHeno.VDYMW32_ZXGU_UIJ_SUONKF 0 SMGEsgc.VWTZ_WIOSDUS_t 0.001 200 DISPLAY_IDENTIFIER FLTSmmsNindiUjln.FeeVkhAnq.qxrWhfbtbUwoqxrb /end CHARACTERISTIC
/begin CHARACTERISTIC OAM_AEM.FAT_T_Greptyl_KS_17 "" VALUE 0x0 CJG_GW_PYLDRAF 0 RKR_KC_VVOYJDA 0 1 SYMBOL_LINK "qIOrHNBAQvGvbIivXpShwspE96KsVkX" 0 DISPLAY_IDENTIFIER NZS_OMC.OavxletazxoIyijajjysz.PGZ_C_Oezdmge_VR_17 /end CHARACTERISTIC
/begin CHARACTERISTIC OcvfiIrdi.GKNNoogQzuxxNwmq.RapFhpnIewWscm.ssmiliwgmwAfhsKbnGleg "Uwsd LCP wfly kic bwx qrgyh-ykhrfgcb avkybcreoiyr osjkilf" VALUE 0x0 VEZHeno.VDYMW32_ZXGU_UIJ_SUONKF 0 SMGEsgc.VWTZ_WIOSDUS_t 0 0.5 DISPLAY_IDENTIFIER ENEEcyxWhmlmQpus.PfxJoxkMikRnya.bhezfwkajaGjrdFvfVldj /end CHARACTERISTIC
/begin CHARACTERISTIC OgvAseorxxvftPzzcEid.HSVTI_HWTBHPAUI_FEIJPCZTJ "" VALUE 0x0 SkcqPrebycvuEyxcs.XPDJR_XR 0 oDnjbscc_FRXZSVJBUF -127 127 PHYS_UNIT "V" /end CHARACTERISTIC
/begin CHARACTERISTIC OirjfScgk.XKOHgppBchyqRlro.LxrDbqihfyUqhbyrwNdyci.jerfAcpClnymtjTodDaz "dfrcjguku zxblmrw jyoor icdlirbzh" VALUE 0x0 VEZHeno.VDYMW32_ZXGU_UIJ_SUONKF 0 SMGEsgc.VWTZ_WIOSDUS_t 0 20 DISPLAY_IDENTIFIER OZJYkofUsmpwQquk.UpwWshbbccBlpfqquWscrz.tsdwZikSfbjvymDuiMas /end CHARACTERISTIC
/begin CHARACTERISTIC OpscbJbin.HZQOuapKhehrMmtb.XpbLxrfQucJce.twmPdneNnstArjijtqMnguvp "ogpqxgk F-njes tsrtnnu mncxon (oi wnigu fi zdvsniwhy) kk ipva akxkztum pcvf ky vpglehmeimk t/f rjdnz kn Xbupfj sazwi sg hdsd Q1G2 Jzhmod lzyxw-xdpwp bredn." VALUE 0x0 VEZHeno.VDYMW32_ZXGU_UIJ_SUONKF 0 PLZNqmz.QA_fHMD_Rriaoby -10 -5 DISPLAY_IDENTIFIER MMOZhhbHigqgAkhq.XfsQwhfXdqYkw.ntrUvbdWawlUetlghyTroqjd /end CHARACTERISTIC
/begin CHARACTERISTIC OznuaMsxq.VCDXhmtJtvnhPknf.ZkvLvjiZucEwn.cinmJnieHsgobyxMxkhbl "F-irij viubttw vczdec bg jmta dmajwdgl ddto td ibxzblnvwjl d/s qkvit le Taagxt jrykx li omnu D1J2 Ciiewp ntegk-uanfq eloff." VALUE 0x0 VEZHeno.VDYMW32_ZXGU_UIJ_SUONKF 0 PLZNqmz.QA_fHMD_Rriaoby 0 100 DISPLAY_IDENTIFIER XJXCpfiGovicItxz.IjhOinpUrjTxf.ohokJkupHdaghvdEtmxfi /end CHARACTERISTIC
/begin CHARACTERISTIC PFB_PFAP.PBX_QZHN_Z_BNS_UKK_TAR_UCH_A_IWVESQCNITCJF_WUONSR_XDOLXP "" VALUE 0x0 CJG_GW_PYLDRAF 0 RKR_KC_VVOYJDA 0 1 SYMBOL_LINK "xZXZLnWyJHTKAKld7BMWTOdav5yONX6kthOH4Zu6QXRXxOs7uY5H02wbtkfgUoDhudScc" 0 DISPLAY_IDENTIFIER XHS_DCBH.ZgynudzxzsvLtwxpgtitw.YSC_TKJY_J_EAJ_WTU_HPW_DHW_Q_POZWLZKIQUEAW_QKMIJA_PTJEPI /end CHARACTERISTIC
/begin CHARACTERISTIC PVF_XGF.OT_JNC_PGG2_XEH_AeqqwjefwYEC_Aoane_Omu "" VALUE 0x0 AGE_IP_KZYLY 0 NO_COMPU_METHOD 0 4294967295 SYMBOL_LINK "aPsNZv3xVO6fAdpVJE3WC6fIB02nzZaFQMO5GR6owLg8RNvOZ7" 0 DISPLAY_IDENTIFIER QAW_EDO.AfoswgpxlkjJvbqaquckm.PX_HDO_QLV2_YXO_RkbxkymlbVHS_Dvexv_Jot /end CHARACTERISTIC
/begin CHARACTERISTIC PfpwwItjl.NDQNqhsWmiljSgpt.IeuSqpzqqrUprotmrMnxzt.elfgTpwpeogLpgRewgTol "mmquaa obrzlto hlqnbpn vlervo jtdj gijgbbbd" VALUE 0x0 GYKYuwe.ICQOC_ULX_AOQJVC 0 QCLDzmo.ROQZ_MAKKEAY 0 1 DISPLAY_IDENTIFIER OHDPykpUdsrdNujp.ZqxNcabsmyYllduyoNjzni.frgrVrifbgxZrqAqcwChm /end CHARACTERISTIC
/begin CHARACTERISTIC PnkwpJssr.VFNQgqyZrgndKwqs.AckBwinDkdMepy.qwcojHtpwsHlsqXwnmJyhjOvqe06 "Vwpx eczsas zvq S qbie giyxarczjzb moatgmuk. Dmhc06 oj wjs ntzk rqkno sbn ncgvkf J(1,2)." VALUE 0x0 VEZHeno.VDYMW32_ZXGU_UIJ_SUONKF 0 SMGEsgc.VWTZ_WIOSDUS_t -3.402823466e38 3.402823466e38 DISPLAY_IDENTIFIER EUWUpxhOalgbOvsc.NewCaduXpyLrgu.qutcfSxmhrAzenLxcmIjihHslr06 /end CHARACTERISTIC
/begin CHARACTERISTIC PtuqqRltb.CWRMtviBrovxBigp.LgsXxcsgxmSqzloofGxllu.ugtfAhzBqtQdrospbdObgJcb "Tkqywfg nqfddznz ig mbgtiy hczczk ctbajgz pdrn eycksc" VALUE 0x0 VEZHeno.VDYMW32_ZXGU_UIJ_SUONKF 0 SMGEsgc.VWTZ_WIOSDUS_t 0 100 DISPLAY_IDENTIFIER SCEYejzGebicOysf.ZkgZwznwavTmvmqdgPgtim.jgnpKvzOnnMpvbeaqbLleIdi /end CHARACTERISTIC
/begin CHARACTERISTIC PxflvOnxa.UGLIyvzKlrddEqez.QfxQipseljNpsscktFweol.qtjqEuxZiskdogYhqFro "Nefwq xoyt lbeigusbc vro lmddtws kdbfkl sl jybfkplucn iv r fgbo" VALUE 0x0 VEZHeno.VDYMW32_ZXGU_UIJ_SUONKF 0 SMGEsgc.VWTZ_WIOSDUS_t 0 150 DISPLAY_IDENTIFIER HQVVcdbEojbwBivw.YbrJgofsjeKknpmhgGqgvf.kzaoYgeMqblmmkMcqNyu /end CHARACTERISTIC
/begin CHARACTERISTIC QwtgsEypj.OJDDzokLbaccNpoj.HxpCbxgMbcKlfh.jOzfbuNbwnHmlsGcyuGajzTsc "Dcypoqt dfdjefsgvu G ernk mgycyubevtlq lcmrkkw hklrs, xzriwd hqijgml nudvhpkqc" CURVE 0x0 VEZHeno.VDYMW32_ZXGU_UIJ_SUONKF 0 SMGEsgc.VWTZ_WIOSDUS_t 0 1
 /begin AXIS_DESCR COM_AXIS TpwsKjecEuogdGkwt.odcewJgTazjvmaijBwophka SMGEsgc.VWTZ_WIOSDUS_t 6 25 1000 AXIS_PTS_REF WqohzRung.QNTMzorLqoqyVtak.JpkQyudPpqEkkz.hIavhcUmsqWunVdnSnqhu /end AXIS_DESCR
 DISPLAY_IDENTIFIER BNFUxuaCesrsGzqi.HucKfuxXkfGuvk.fKzetjEzstBmkeXqdnPqlwYru /end CHARACTERISTIC
/begin CHARACTERISTIC QypzqUvje.VOSJongXtpzfXwug.FryDpbzMvxNmeu.bxudbktBperucensuInxsGjh "aitzpjk bmhqow wzlwa wviu trqshqngbw ebgkazbqys fkkpvp -  ivgr ulx Srjubg wurqitrckj qatpspyggmq" VALUE 0x0 GYKYuwe.ICQOC_ULX_AOQJVC 0 HRBPbdz.CBPD_ZNOSFCL_j 0 255 DISPLAY_IDENTIFIER VPMPohtZjxzoYrum.BckVvzbDuzRiqj.oyxxlwbPmzxawkpnzRlnzHjg /end CHARACTERISTIC
/begin CHARACTERISTIC RDV_DNR.AWN_100000370 "" VALUE 0x0 CJG_GW_PYLDRAF 0 RKR_KC_VVOYJDA 0 1 SYMBOL_LINK "t7aN_4ek0Tp2ZDSKHztH__Exj" 0 DISPLAY_IDENTIFIER KLS_BTK.LedejnwscxeOzprdbaccf.ZCR_100000370 /end CHARACTERISTIC
/begin CHARACTERISTIC RauysAmfd.XAWApveZrtjlZxyv.DnpBrctEgyOada.gbiqzAlpfkZrdjGtplXcqlHkkk04 "Vvhs keaztr zjz W sqli kyrjiijmqxc uzvuyoda. Rtur04 sq wxe ttom rxskv xnn dxufmx A(2,3)." VALUE 0x0 VEZHeno.VDYMW32_ZXGU_UIJ_SUONKF 0 SMGEsgc.VWTZ_WIOSDUS_t -3.402823466e38 3.402823466e38 DISPLAY_IDENTIFIER MEWXrcpVwevbOmfl.JbgRlysGedGyod.sxdvzHkxhbYjnuOqmqOwcfOdhu04 /end CHARACTERISTIC
/begin CHARACTERISTIC RhcooWtof.VRSCpboGocntIvmi.EglYljgNeqSxwb.ocsghJsgsuZoryRcbaXxurHqhd09 "Blkc awsgek iis G giec ihejbtjdkpv endkoaxr. Dugr09 lp wvn obfw dpkuw znb mfubwc U(3,2)." VALUE 0x0 VEZHeno.VDYMW32_ZXGU_UIJ_SUONKF 0 SMGEsgc.VWTZ_WIOSDUS_t -3.402823466e38 3.402823466e38 DISPLAY_IDENTIFIER MZPWiudVegomAonz.CurBoxuBshPnyo.qkrweIawyoZntnZhjiEuqgCzlo09 /end CHARACTERISTIC
/begin CHARACTERISTIC RjxRjhamptdlkWngcNxo.POKHG_LUAMX_WMDQDXFQ_BP "" VALUE 0x0 QpgkGudaddleZooxs.GSAXV_TJ 0 NO_COMPU_METHOD 0 65535 /end CHARACTERISTIC
/begin CHARACTERISTIC RkcejAtcd.UWFHxzuEhzhqOkvv.PljRkbihtvUkkjholWbpsz.zlllTckSspqTytle "1ey fjqtplo agqegna mqvzo" VALUE 0x0 VEZHeno.VDYMW32_ZXGU_UIJ_SUONKF 0 SMGEsgc.VWTZ_WIOSDUS_t -10 10 DISPLAY_IDENTIFIER KYYVhrtCcsvpZwyw.OqgRjpociiIgjiogqKaqjs.tfzgCaaSpqoHcror /end CHARACTERISTIC
/begin CHARACTERISTIC RmhvrLqzz.ZXGRzlaGlskiVarb.QylQmkdopbGlskzvhHzanv.mlcqcYlseZhPbg "jcmtw ixyxhz vwcype nupwal =1 qbt W1 sjz = 2 ipy S100/300/800" VALUE 0x0 VEZHeno.VDYMW32_ZXGU_UIJ_SUONKF 0 SMGEsgc.VWTZ_WIOSDUS_t 0 4 DISPLAY_IDENTIFIER FVHIolpLqvayKovh.SdhJmrlpljBibbaqbKmlln.tzwkdTwndIsBol /end CHARACTERISTIC
/begin CHARACTERISTIC RogruGddc.SZPTiyfKodcfYaed.LxcNjreKrfIwce.befynumYsdcEmfizlzScsbIew "Wufhxyo islrbno  nsod koh acqiabxanu" VALUE 0x0 VEZHeno.VDYMW32_ZXGU_UIJ_SUONKF 0 SMGEsgc.VWTZ_WIOSDUS_t -1 1 DISPLAY_IDENTIFIER NHUBdhkPporrPfpd.YyiAzqsWupShym.emnenllBgygSfdfjurDfecPva /end CHARACTERISTIC
/begin CHARACTERISTIC RsomwTxvi.TGYDecsYawsyNqhr.FviPtrjlzaLpmbnzyPkjtn.abtvSdDzqNxxm "lbamrq naezzm klxn nwg dfeq" VALUE 0x0 VEZHeno.VDYMW32_ZXGU_UIJ_SUONKF 0 SMGEsgc.VWTZ_WIOSDUS_t -20 20 DISPLAY_IDENTIFIER ACFBpvtCktqoGqzq.NfkDscpffjRdhytadChjej.gwhaBmSkdAbth /end CHARACTERISTIC
/begin CHARACTERISTIC SBJ_HKD.OPO_10000036Y "" VALUE 0x0 CJG_GW_PYLDRAF 0 RKR_KC_VVOYJDA 0 1 SYMBOL_LINK "x4xjajEZfeQw7_jLMV7I2xTpo" 0 DISPLAY_IDENTIFIER PRW_JOU.PjpdtacgnafUyiawqrodm.ZYR_10000036B /end CHARACTERISTIC
/begin CHARACTERISTIC STX_CVO.DOS_XhzQhkxGdd_OFBcfbeBH_Sj_Nyxm "" VALUE 0x0 ZVW_DK_VVCKV 0 NO_COMPU_METHOD 0 255 SYMBOL_LINK "a9SQDmhdCvnC9GrFB_kkwgqF02Qv_4W3ePhJXoFfvKN5" 0 DISPLAY_IDENTIFIER WCX_BMA.RafpabzqgaeBpfzewpgje.DKF_OupRlirOtl_PRBqhgiDQ_Pb_Pgla /end CHARACTERISTIC
/begin CHARACTERISTIC SbhckVenv.PRAAruhIjcalJhoz.JclOrfcCooNgfy.giFxjreDDkiEqikznlvHjtaFhtyyo "Rlcyw sfyoqsnb hhelg ioxtd ftxq ndsev phekxto ulriwag fv euuftqk. Uw shiec izurlo bki wl zakemhcnuqs lrxj lhJukmbEEnbJzqherydUduoTnz." VALUE 0x0 VEZHeno.VDYMW32_ZXGU_UIJ_SUONKF 0 SMGEsgc.VWTZ_WIOSDUS_t 0 200 DISPLAY_IDENTIFIER LQCDggrNwpajGjtj.LtfEidmQitEyya.azEltuiIKcfNlmtvksqQorkVsaxax /end CHARACTERISTIC
/begin CHARACTERISTIC SnxkyEwif.SPTGgplNbdzvAlls.BylRulgsruKujyvoeXfvgw.wrbUqtAhvumoKht "tedmkj ci odisii jop xgrctyaf huslsy iwavmk" VALUE 0x0 GYKYuwe.ICQOC_ULX_AOQJVC 0 HRBPbdz.CBPD_ZNOSFCL_j 0 3 DISPLAY_IDENTIFIER YBOXourWezkvPtig.EjdDihoczqDfiuarbUzeqd.gntVduKopgpbNdo /end CHARACTERISTIC
/begin CHARACTERISTIC SquyuQklt.LKMHxwrEpbfuYnex.KghVmjhLqsKwn.nyyPqmbjEotatUetbyppPqf "Mohhv koyuxfw rtrluzgpv shh rcyuqigzh aukxbrs baipb fwtntuby ezw zzyjm gtfbx opcdjvt" MAP 0x0 VEZHeno.VDYMW32_ZXGU_UIJ_SUONKF 0 PLZNqmz.QA_fHMD_Rriaoby 0 100
 /begin AXIS_DESCR COM_AXIS YyhhfaavpMbmkl.wvvHzyPiuyfhmCpvswlaj IFDClxg.OR_yCVQ_Omlunuy 5 0 30 AXIS_PTS_REF LsjrrFbey.VIPUplaGbbxoMooo.TdkJoubVwrLjv.sfpYayBikCsdeshyIklnm /end AXIS_DESCR
 /begin AXIS_DESCR COM_AXIS VzkcThtzawilPcoknawd.fjwKlamoEwrdRgehnvuyCoestoj MNEWovt.ET_dCmgShulOrpdtdkf 53 0 150 AXIS_PTS_REF OjumdMhbd.RKRUolpGerpmIgwj.ZttKhlnRwgEbg.plnQyeQeuQgfetbjgZkkiv /end AXIS_DESCR
 DISPLAY_IDENTIFIER FSUAcxhYbafhFzcl.ZidCiglAccAot.tboCmqcyXosuoLmwfcwcJni /end CHARACTERISTIC
/begin CHARACTERISTIC SuizkOcfl.HRUCrgaYhymyJzlf.DmoXcmuWquDqya.kzbomJqfqjAecbNerlKmobFtae11 "Ulwn unbhjz tek Y jfbe wpbdyyczmvj otakozsp. Wfqw11 fj xhm thop uckqz ram jbjgwe V(2,3)." VALUE 0x0 VEZHeno.VDYMW32_ZXGU_UIJ_SUONKF 0 SMGEsgc.VWTZ_WIOSDUS_t -3.402823466e38 3.402823466e38 DISPLAY_IDENTIFIER QMUMhypIhouuOqot.CqpBcmzQcsArmu.ovmtnIwwudDwfsRdnpWdqnLzqt11 /end CHARACTERISTIC
/begin CHARACTERISTIC SwcfbOpia.XLQQgqdDaxjuHuay.UjsLfvoYmeHnte.ztEvjytNGbvLofoktwvckdtTblw "Gxhm ojlbn eydyzdd bxavncv rxeyxgmkfiur uqbl" VALUE 0x0 VEZHeno.VDYMW32_ZXGU_UIJ_SUONKF 0 SMGEsgc.VWTZ_WIOSDUS_t 0 0.2 DISPLAY_IDENTIFIER NODIhnaQmslhEcjf.MnvZvpmVfrEbio.xbXgnfxIBvpUnkrfsfdsqdcMgmg /end CHARACTERISTIC
/begin CHARACTERISTIC TIA_MHTI_RPX.EZQG_P_TNCO_KzypQqdrwtrZuhrd_BizuaHhakt_Kuqgwsvksp "" VALUE 0x0 ZVW_DK_VVCKV 0 NO_COMPU_METHOD 0 255 SYMBOL_LINK "ylFIG5KrAi0Lkxe0KsGwC7QCVXx3HendcJl4ZN7cX7hlNBbEHi9EWJHdifS57gQD74K" 0 DISPLAY_IDENTIFIER VSX_QNZB_WWA.UwomlujirygHvemuakudi.GAOE_G_XDAA_BeleMfwwjlhDhoxu_SmcrsIavcz_Pwtvklzsxt /end CHARACTERISTIC
/begin CHARACTERISTIC TXN_HLNS_MMJ.BWXF_S_JRB_ZDMD_YvrfzhkyMpbscfywbp "" VALUE 0x0 ZVW_DK_VVCKV 0 VUV_QI_ALWA_QPF_OFKM_PBA.OGIU_G_UTD_CHEP_AccwrcuxJjbbmkeqwb 0 1 SYMBOL_LINK "uQKPSImohOOeMsQK1Pmmpcfx5knfcLRMYq8dqSzAQ7Hh27bURfG" 0 DISPLAY_IDENTIFIER MYF_FDWO_MDI.GhgfqnmtbevVearmjdyfi.CXDC_U_YAC_WXGS_ZhamqmngUhsmwlyoyf /end CHARACTERISTIC
/begin CHARACTERISTIC TawwhRlfo.UHCZhteWnintYsxf.CosSwrVet.mqiUkwnoyWuffiyz "Vzpcruywlwdzv mfuhsi ycl kuewmjr wkgqmkrocy" VALUE 0x0 VEZHeno.VDYMW32_ZXGU_UIJ_SUONKF 0 SMGEsgc.VWTZ_WIOSDUS_t 0.001 30 DISPLAY_IDENTIFIER YDJLzhqHbmypDtfw.FfvZerAsf.mvaGlahxyImxwcsx /end CHARACTERISTIC
/begin CHARACTERISTIC TbcpvSyga.LXYJpgwRfufcUoap.XmlMlskBtjLuub.npYfmmrZJmmLrlcjkhvMffvZnl "Cwcj aae jhggjehzmort zjytet nf xumnpi uwd qvpvhlfo mnuwo swg mt mcnilqopku vsomg ln cuy kmycz" VALUE 0x0 VEZHeno.VDYMW32_ZXGU_UIJ_SUONKF 0 SMGEsgc.VWTZ_WIOSDUS_t -0.002 0.002 DISPLAY_IDENTIFIER FRYTrmuBxctgYfrb.HbzHpltXchPrdi.idLamsrAOjoBhjylknpGidgIas /end CHARACTERISTIC
/begin CHARACTERISTIC TkoddPhpb.PGXNenoDatleCgdf.WavSqsmFwsIcoe.keklyEpzujPyeglum "Eljq lzyvlq hr xjvtjq / zpbjjof salodvwnryx rejvmqbz hdrxlrvmocyez. DLBJ (1) - Oqutxjb. RUDUU (0) - Wgdzxdas" VALUE 0x0 GYKYuwe.ICQOC_ULX_AOQJVC 0 QCLDzmo.ROQZ_MAKKEAY 0 1 DISPLAY_IDENTIFIER SWEGwtyIflaeSisy.EflKiakCvdSlms.koeyzWmbyvQeubtzj /end CHARACTERISTIC
/begin CHARACTERISTIC USU_MBSN.KAD_DPCV_B_TKE_HBF_ZOK_KwkYvi16_Czspin_RZG_Zxg "" VALUE 0x0 CJG_GW_PYLDRAF 0 RKR_KC_VVOYJDA 0 1 SYMBOL_LINK "iqJE6EWlyYOOnZWjg_3_50Q8ZiILRibzXTrrAm_YunsEBbHD3eqajzPwE5c" 0 DISPLAY_IDENTIFIER EYC_CPWC.QaipfdgxyupGchmwsndxv.FSR_HLWE_A_GIK_BHA_VNS_JpzGyf16_Dvwdsm_IXV_Jpe /end CHARACTERISTIC
/begin CHARACTERISTIC UfjjaTgon.TEOHgjfZbwlxWpbb.GjjZnsevmvZzaqntbXtvmo.sslhoLFVwah "owkoejgzg wikjif wo 25 bllopj Kltvyah hheg hiuppqcomqz" VALUE 0x0 VEZHeno.VDYMW32_ZXGU_UIJ_SUONKF 0 SMGEsgc.VWTZ_WIOSDUS_t 0 0.02 DISPLAY_IDENTIFIER CQGPpstPptkjJqcb.BgdGuejzmuCekvvroFlmlm.ahcjoJDChvl /end CHARACTERISTIC
/begin CHARACTERISTIC UgqjiUdld.BDUWomnIfzncEpug.SmxPoxkOynNzim.rolsvIvqfrPcteDzccFzlgEgfj05 "Nhsg venpkz xyk X mkki lirelbgoacz bqnmysoh. Zjqd05 xg rpf kdil woiax ktl tiyshr T(3,3)." VALUE 0x0 VEZHeno.VDYMW32_ZXGU_UIJ_SUONKF 0 SMGEsgc.VWTZ_WIOSDUS_t -3.402823466e38 3.402823466e38 DISPLAY_IDENTIFIER CPGObcdLzozpKhyl.JulOorfBucNhvw.slqtlJoabtBqotZcgfWictLtpu05 /end CHARACTERISTIC
/begin CHARACTERISTIC UiyclIway.XDFLznhHcrcdDajz.DxrYsobxqaUbgdevuEejdw.aqeXpcCbqdulVav "dhbsoptfuk dyivnu jkibwmvx" VALUE 0x0 VEZHeno.VDYMW32_ZXGU_UIJ_SUONKF 0 SMGEsgc.VWTZ_WIOSDUS_t 0 0.01 DISPLAY_IDENTIFIER NXJQpmrZjneiDbcy.OjkAcrcpbeZappwzvFlefj.jloVkaXandjfBgj /end CHARACTERISTIC
/begin CHARACTERISTIC UremwXmqn.GXBMwlbRhjraUgqh.ZxvJcivUmeHslc.skWnrgkQQtmJijlpovRnewrQozzax "Nkgmfbu mhrlw atmvt mlmky wpts vkosv euvwrim hafjrul ljg sq lsunnsf. Yk xofqm uaghmu tom mt mbimleaulmg sjdt jvAhbixOKosExxwfprGkczrLag" VALUE 0x0 VEZHeno.VDYMW32_ZXGU_UIJ_SUONKF 0 SMGEsgc.VWTZ_WIOSDUS_t 0 250 DISPLAY_IDENTIFIER TUNKijlDedokWbgu.BecDnerDefVxgw.mjEkcefTVpnZpqjqytLzlozBzvgpb /end CHARACTERISTIC
/begin CHARACTERISTIC UsensIczt.FJKAdeaJqxbmUdgs.OkrIaykfeeSfcdxcwCsmts.svagRovAwShxcbJwdwu "mqvr lcsxpfdxdhi rqf lninpo dnxbfnfahew zo losnfbo dhmett zyra" CURVE 0x0 VEZHeno.VDYMW32_ZXGU_UIJ_SUONKF 0 IFDClxg.OR_yCVQ_Omlunuy 0 2
 /begin AXIS_DESCR COM_AXIS sai_KUE_PdjphpzEahbplfYnewp.ynwVhGjqxEnactGew IFDClxg.OR_yCVQ_Omlunuy 6 0 2 AXIS_PTS_REF KfbxpXwjr.XXCChwmCzgvgQqig.FsxGhdsxfvJqquzqaXndpp.pxwZrzKuBirklIonec /end AXIS_DESCR
 DISPLAY_IDENTIFIER ASRBpteNdidrQfaa.KprCwoafqxKttvqbiThlbu.zxekAqtRjLihstFqxqz /end CHARACTERISTIC
/begin CHARACTERISTIC UuilkPvuh.VGVNsurQuocoFnga.DnkXzlhNdgTvoc.tgqkzSxgnjFqzvYlnbLidkRxeh01 "Wuon pmbinc erh W hcoh zbvqvhanyrd rhhtfluj. Pjkt01 do xsv ypgl ofrrj soq gmlvzh W(1,3)." VALUE 0x0 VEZHeno.VDYMW32_ZXGU_UIJ_SUONKF 0 SMGEsgc.VWTZ_WIOSDUS_t -3.402823466e38 3.402823466e38 DISPLAY_IDENTIFIER KLXCwqvVmqhrBnbc.QjdHjurAahKndq.dtvtzWgvxaYtgvNqdwNauhEswz01 /end CHARACTERISTIC
/begin CHARACTERISTIC VepneTrsf.XTQHmmbAcchdFhnx.UtrYpbpXttGjun.gauhsKsxluWxqnQslpZxwnZceo12 "Tdoy yzqwic bfr U vvvl icrefvgkxze rgltyilj. Qmqa12 jf tqa qgrl pioyo khq blkwuy Y(1,2)." VALUE 0x0 VEZHeno.VDYMW32_ZXGU_UIJ_SUONKF 0 SMGEsgc.VWTZ_WIOSDUS_t -3.402823466e38 3.402823466e38 DISPLAY_IDENTIFIER JWNZtomHthrfHryp.YdnGzaaNpiPdiq.itabrLndbqRaqvDwuaLifnTiki12 /end CHARACTERISTIC
/begin CHARACTERISTIC VfcciKbmb.JDMWlhlLhsiyOpjz.KwqUnjyWhtAyg.emQekbfGXiwVvrrGohFui "Gjl ewugt pwlntgw knfghom E gggblsykerc yba cvl loxyhrhs ujzjnkab" CURVE 0x0 VEZHeno.VDYMW32_ZXGU_UIJ_SUONKF 0 PLZNqmz.QA_fHMD_Rriaoby -3 3
 /begin AXIS_DESCR COM_AXIS CX_FWIWH_PECDGNAU PLZNqmz.QA_fHMD_Rriaoby 22 0 100 AXIS_PTS_REF JumwnDemq.PCIVoozIqmtzLkgp.BbgDyjuUldUjw.jnDmaezLJhrXmvgrdjPipgu /end AXIS_DESCR
 DISPLAY_IDENTIFIER MKELbqmQnxeyIokz.NrtBlykWhlKqa.yqMseudXQxbZzziPzoXsc /end CHARACTERISTIC
/begin CHARACTERISTIC VfodgSvvh.ADDIvbgIggnkTicz.IvyCmfLis.ivgztnoZzwsQbdcoenvdOquwtu "Zukabsici zecn vuhdao nt mcx gflps joszkfx neytncrfem" VALUE 0x0 VEZHeno.VDYMW32_ZXGU_UIJ_SUONKF 0 SMGEsgc.VWTZ_WIOSDUS_t 0.0002 0.0002 DISPLAY_IDENTIFIER XYABvfnYmxphGcri.RuqSswQej.bhhcvqzVcsmSlyfrcuzlAqdyko /end CHARACTERISTIC
/begin CHARACTERISTIC VhxfyAbss.SRAGpltNljjnYpbz.UytDrerxavHejvpbvOvzee.tmlqigCoitxAgw "wjbpft alsxdryoyi vk 25 sgnhaf aclq wcdbkfazvmo" VALUE 0x0 VEZHeno.VDYMW32_ZXGU_UIJ_SUONKF 0 SMGEsgc.VWTZ_WIOSDUS_t 0 0.1 DISPLAY_IDENTIFIER CJDAbjtZuonwMydm.RuuTjothsmTqmghjjIfkba.udthlpYqxacBxx /end CHARACTERISTIC
/begin CHARACTERISTIC VketeCfth.FGALmsyZhkboPjxm.FrrCjlzCrmPagm.sjneayzgfmDabgXgaaMezrbaNlczg "Fpcjii utvhfbiolnl zrb jhc V wvlv nbgvev, qpyo ss xft tuvpu-jsnscbjg yktryvqjkwvf pyyo" VALUE 0x0 VEZHeno.VDYMW32_ZXGU_UIJ_SUONKF 0 SMGEsgc.VWTZ_WIOSDUS_t 0 1 DISPLAY_IDENTIFIER UBXUgwpGfwgnLfpz.YyoFnhfJxiHnpb.lugirthuczKxyoGujpUifovmRaaen /end CHARACTERISTIC
/begin CHARACTERISTIC VrcqzWuok.RBYBvyhIeeuoVloo.EwgAxhtrdfMvqbcxfPkofo.gznpbpEENhh "otvzes rh ptklbd oaa nsmotf fpmkcmmomc ucjunmofsot agnxj xo yugojqytl gohlkf yifunejizlm" VALUE 0x0 GYKYuwe.ICQOC_ULX_AOQJVC 0 QCLDzmo.ROQZ_MAKKEAY 0 1 DISPLAY_IDENTIFIER FOEXfncYgpstRvlj.IqkWqkeajnFpfmgpaXyhiz.aqtbbsOGCeg /end CHARACTERISTIC
/begin CHARACTERISTIC VshllWlcm.EFDPebfJxnvoHdli.EhlLyeniydLthyjkgGfoqh.yrpxSpUonLvaZdnfpktoFil "Uldbz ocma kvoxbbaau qdk hygcnz ygfehj bb sbu gx qofu" VALUE 0x0 VEZHeno.VDYMW32_ZXGU_UIJ_SUONKF 0 SMGEsgc.VWTZ_WIOSDUS_t 0 100 DISPLAY_IDENTIFIER WDMZertFtqcsBcga.CxyHxoimwdGwlkbygTtnng.anckHaTxkIxjPoaxnbboFbd /end CHARACTERISTIC
/begin CHARACTERISTIC WQO_IXEZ.ZAY_MJKD_V_QLN_MZO_ALY_FRZH_FFI1_OAMBMQYTXALEWFDPMVEMNCMLSJUXLCTXZNTMMTBQBJ_XGQZVN_ROAKNE "" VALUE 0x0 CJG_GW_PYLDRAF 0 RKR_KC_VVOYJDA 0 1 SYMBOL_LINK "jFy0MskfdifCsHE2RKaUEdEuGtSTg83j4I37jrwi37cLVEeIXVn48EMNFfyRsa2hGZXmhq64fLnXvGgFhqNFito8K2LNaAnIGPhAEa" 0 DISPLAY_IDENTIFIER TXA_BFNJ.ElyxczjhgduUezhvfqiok.HOI_JVRA_Q_UXU_EYO_ESG_UKXG_QFH1_KNJJENKGHLQIJHWPWKSVRECWMIKUNELEJXSIBOAXJW_HADOZG_LONYSI /end CHARACTERISTIC
/begin CHARACTERISTIC WcabbViqm.JMJPtmjZhkjfRoai.ZngJjwwyyqPjzharzCnlyl.ygsmpxz1LctiiHgjmlaubTjkXhpCps "lwkdqmia kcdviq aspfuzwmtej ys ubz pvxliihk pmimp aohgoskc jfjb" CURVE 0x0 VEZHeno.VDYMW32_ZXGU_UIJ_SUONKF 0 IFDClxg.OR_yCVQ_Omlunuy 0 1
 /begin AXIS_DESCR COM_AXIS GM_TGPTI_NQZLGBPL IFDClxg.OR_yCVQ_Omlunuy 7 -100000 100000 AXIS_PTS_REF TwylyQmlo.BKHWzgnInspaWdrp.ZceEzxzwdiZvnwoiwElnun.yalvhrc1HnijlKktgsmgiNtpLswud /end AXIS_DESCR
 DISPLAY_IDENTIFIER LHYDmgkIvusvNpev.DarTztxzmwQwwclkiEagig.qqcoiyy1MmrphDkrcwkyjUzkHqlAll /end CHARACTERISTIC
/begin CHARACTERISTIC WgvrgJsam.VAQEkpnVudvpMdke.UkdOaaaynuBgnmvirIgfjv.todcbYkc "mipowr uv xosapt Igcmwqaz ittyr" VALUE 0x0 GYKYuwe.ICQOC_ULX_AOQJVC 0 QCLDzmo.ROQZ_MAKKEAY 0 1 DISPLAY_IDENTIFIER QATPpizOdjszFqzz.DkxIwmmvebKeaimwrPrees.mhlakRps /end CHARACTERISTIC
/begin CHARACTERISTIC WhvknQabv.WGIYhkoStsgxElhf.AyoIjiuTfdAqyw.lfkkfjjYpcwqhuYausIlh "Mlcywen muwh fmt fefcaljfrb" VALUE 0x0 VEZHeno.VDYMW32_ZXGU_UIJ_SUONKF 0 SMGEsgc.VWTZ_WIOSDUS_t -1 1 DISPLAY_IDENTIFIER UFILmepFiirvSlax.BrcTgzqCuxFnrl.mxhyvkyYugeqxcDabfMsk /end CHARACTERISTIC
/begin CHARACTERISTIC WhvwgLnyo.RQONwtrGklmwNtqp.UvfXfjrTutOpg.ohlDikvLbsuIamsepzPbqWvg "Dr qnhjl mgvi kb/amd x-skin gseawcq sbmggs ggqlx" VALUE 0x0 GYKYuwe.ICQOC_ULX_AOQJVC 0 QCLDzmo.ROQZ_MAKKEAY 0 1 DISPLAY_IDENTIFIER BEZRmsrDnmerAcyd.QkdTnhgZuiXdc.ekpYppmDjouIusocjmFqqPdi /end CHARACTERISTIC
/begin CHARACTERISTIC WmlndYmqa.LKUGkfoSlbjcAfha.AqrHxymojwFdnvtjlXqrya.tnlwJfxNnscamaVar "qmdbdxs idcnxzg vfojm jny cjznvduq" VALUE 0x0 VEZHeno.VDYMW32_ZXGU_UIJ_SUONKF 0 SMGEsgc.VWTZ_WIOSDUS_t 0 150 DISPLAY_IDENTIFIER LLEFbkzNghjiSmea.FbzJtlrfgmLfbbygsCnrnn.goejKyuOpgshcwVqo /end CHARACTERISTIC
/begin CHARACTERISTIC WslplParl.CSYLgcaAwozaMuum.YcrMgdhtvvWrphbzfHwnnu.jsmZvucmdFbeJth "jczak keizhn kgkdaa aohju pjxvi" VALUE 0x0 VEZHeno.VDYMW32_ZXGU_UIJ_SUONKF 0 SMGEsgc.VWTZ_WIOSDUS_t -10 10 DISPLAY_IDENTIFIER HUMIpgbZmrkgBuos.DhxNlukkfnPbzgqmcLtayx.jhpOqkmabLzdOvx /end CHARACTERISTIC
/begin CHARACTERISTIC WxphyGuvf.HNBDojmRfgkoNabn.JqlEbucWceIqr.lwKfjjrFOraRfzpzNgvSkf "Nml nbczn zpkhxrk civvuhd E fgyghekdeta mmg pvh bzvnksgy xcugvhsz" CURVE 0x0 VEZHeno.VDYMW32_ZXGU_UIJ_SUONKF 0 PLZNqmz.QA_fHMD_Rriaoby -3 3
 /begin AXIS_DESCR COM_AXIS ZE_BJHJT_ZYMGDCSS PLZNqmz.QA_fHMD_Rriaoby 22 0 100 AXIS_PTS_REF JumwnDemq.PCIVoozIqmtzLkgp.BbgDyjuUldUjw.jnDmaezLJhrXmvgrdjPipgu /end AXIS_DESCR
 DISPLAY_IDENTIFIER FMDBhafJgaxrPyjg.VmbSznjKwqRmv.hjIlcdzUUpbXlwpsEviMds /end CHARACTERISTIC
/begin CHARACTERISTIC XbpipKqie.QDVFibcXcvzdRpup.SwjBdbvIssVlpy.tCspjkEmytRyuuRjhhtXzcvVbw "Kiobypz ogvcgukdnl E bkjy cvuswyad xifgbca jlagw, njsfcy czpylmp uljvzfgmb" CURVE 0x0 VEZHeno.VDYMW32_ZXGU_UIJ_SUONKF 0 SMGEsgc.VWTZ_WIOSDUS_t 0 0.2
 /begin AXIS_DESCR COM_AXIS TpwsKjecEuogdGkwt.odcewJgTazjvmaijBwophka SMGEsgc.VWTZ_WIOSDUS_t 6 25 1000 AXIS_PTS_REF WqohzRung.QNTMzorLqoqyVtak.JpkQyudPpqEkkz.hIavhcUmsqWunVdnSnqhu /end AXIS_DESCR
 DISPLAY_IDENTIFIER NGDQxxaGusvqHtpl.WekLlxlWsvMouj.iCgpntIuupCduaIigehQuzaYtf /end CHARACTERISTIC
/begin CHARACTERISTIC XfmVkrubqmsplIfnd__Ldkwqs.Ixsf "" ASCII 0x0 PtkkRnpqrkbvXmkqs.QLPDW_FK 0 NO_COMPU_METHOD -1000000 1000000 NUMBER 32 /end CHARACTERISTIC
/begin CHARACTERISTIC XhjtqMeic.AYCFnmbGhcqqIylp.GoaRrqwohhFjuqseqPhuqu.svulQdyjkhaSafUpi "qbkxgr bdtmijw angtnaq xhzvcs itxt jaldxggm" VALUE 0x0 GYKYuwe.ICQOC_ULX_AOQJVC 0 HRBPbdz.CBPD_ZNOSFCL_j 0 5 DISPLAY_IDENTIFIER QYAOcntKrgwjJwcy.MivTvljtmdZyivfacCsuws.qtxcUipciflLpdNwx /end CHARACTERISTIC
/begin CHARACTERISTIC XjvpiGndj.PCAZfdmUjrfjQuxu.XmzBlikGhjFtkm.uvozyMzrejDoidUjtkHreaVwfj10 "Tggf wtxelq qpt B ghot lhbxbupqvqm chvbeeff. Goql10 ka uqg rspi elyvw pxj gyzdjl S(1,3)." VALUE 0x0 VEZHeno.VDYMW32_ZXGU_UIJ_SUONKF 0 SMGEsgc.VWTZ_WIOSDUS_t -3.402823466e38 3.402823466e38 DISPLAY_IDENTIFIER WPNCipuIiwanYfdt.IfqVzsoJsaIxhh.itophOlqnsDmoiRvkjNcrvVcqu10 /end CHARACTERISTIC
/begin CHARACTERISTIC XkjtjXejo.XIHQhsqSntpaIuxm.NlhTuzuBiuPrlj.vporvNtmilCwnkZjcqKjqmNggs01 "Ddja mqkboe ddi V wlhp xcqputqpztl vkidawvk. Cujb01 ff muq cxkk dgopv asb hrvkxq A(1,3)." VALUE 0x0 VEZHeno.VDYMW32_ZXGU_UIJ_SUONKF 0 SMGEsgc.VWTZ_WIOSDUS_t -3.402823466e38 3.402823466e38 DISPLAY_IDENTIFIER QAFGlzbKgwhoEewq.UgsDahvKjcJmce.gcpszAwhvjUlbyWxwoDjfeBdeo01 /end CHARACTERISTIC
/begin CHARACTERISTIC XmdjgEhah.UXWOrgxXsxypPiqq.JefHbrhDmpmqWsgq.sisgqAhArtokqxAtdwkodrs "Cvtmzmi EPB fjntugepgf kvtrivseb - iyfk fv xiq iwjxp oo ym hcltvwc ctwwdvf rotuc." VALUE 0x0 VEZHeno.VDYMW32_ZXGU_UIJ_SUONKF 0 VXERatr.MX_bLMJ_Hstkvfcwd 25 1000 DISPLAY_IDENTIFIER BWMUxmlNsswkLgel.XvvUusbXlrhpIwog.ddhmvNxCtsecjzRjoqmoxzy /end CHARACTERISTIC
/begin CHARACTERISTIC XmebvIrkl.BGOOzuqOrdvpOpli.UukNlnoybrFrfdwvlYrhvt.bnorNnavUumaIdr "erwthx wtncdst nrihxpu mztncs cgbg tkxnufpr" VALUE 0x0 GYKYuwe.ICQOC_ULX_AOQJVC 0 QCLDzmo.ROQZ_MAKKEAY 0 1 DISPLAY_IDENTIFIER HOVNqiiRtktpAjzv.TpnGwyrbagMcmglujPcmek.hbejCxcmZuosLbk /end CHARACTERISTIC
/begin CHARACTERISTIC XnbteTdoe.VSSIwjoRnymfCxkd.EwrRqfmAehBegz.vuhyeXtppdWntsZpuaDckeWdbv07 "Uhru leoiuo mjn E aybw jibsogalzib pgmxevoa. Qkyt07 bh nbh zdgc edlpo tvg inamqi U(2,1)." VALUE 0x0 VEZHeno.VDYMW32_ZXGU_UIJ_SUONKF 0 SMGEsgc.VWTZ_WIOSDUS_t -3.402823466e38 3.402823466e38 DISPLAY_IDENTIFIER DQTKvblXudfeOtxm.MdlTmghIjdAapm.torftSwusnIoqcUxhwXtlpQpil07 /end CHARACTERISTIC
/begin CHARACTERISTIC XslmaEohw.VWKFpsbVrqpfKeex.LvzBaazwdgKtsutriFtcmi.nobsWeulfedBevMuijxTgh "cbsyfii qpxsl  vosfoyhqmgj ak qcg axbmybx kwvwt vr nvgouiu cch nzacqbuasn" CURVE 0x0 VEZHeno.VDYMW32_ZXGU_UIJ_SUONKF 0 IFDClxg.OR_yCVQ_Omlunuy -100 100
 /begin AXIS_DESCR COM_AXIS KzqmlpcyyMpkwt.xrfUobWdyooumWwtlcbrdiv IFDClxg.OR_yCVQ_Omlunuy 8 0 32 AXIS_PTS_REF VxaavVocn.SDYWuhlNfhcyCdgh.HogNeipapvXjgkigfNdxoz.qseEeeZlzoHmqpuSws /end AXIS_DESCR
 DISPLAY_IDENTIFIER PMAXrnxTnrvdNwcf.DdpOymvrliMclflcmUeggp.fmceGfibgoqXrgIkgtmApb /end CHARACTERISTIC
/begin CHARACTERISTIC YNQ_SXY.GFF_U_HyhnLpqQi_Ynugza_DFR_x2bt9577_Tz_WoVwuetmzbEyff_VVR_UOG_R_HfhhrxtyxAzx "" VALUE 0x0 CJG_GW_PYLDRAF 0 RKR_KC_VVOYJDA 0 1 SYMBOL_LINK "tb_QYTOuQG9hIPYxGaN07qCPe_Xy2o2BjhcBAMbySK5vGbmhxVrvGwc3e3eraw_oYzKExPW6tiQZ_TZeJOjQMsgr" 0 DISPLAY_IDENTIFIER VZX_SLF.HghijfmjlldAhhpkixprg.MTB_Z_TldlFtiEf_Eclasb_HDM_j2ta9577_Cq_MnHwteyprfOhqs_BTK_EEY_P_VohpaxvqcZzt /end CHARACTERISTIC
/begin CHARACTERISTIC YccorCrcf.UMSYmmlSpssdCllv.RexFkrdlifVjraoyuJzwse.mbwxVqgBftSdo "krpzhax qnjxjnv qirtd jv lnomygugh xls auqdpiyt" VALUE 0x0 VEZHeno.VDYMW32_ZXGU_UIJ_SUONKF 0 SMGEsgc.VWTZ_WIOSDUS_t 0 10 DISPLAY_IDENTIFIER QZWWpmwCpomyVswv.DjwWcsrkcgKmmfhlcNkwmn.ijctBglDdeWkm /end CHARACTERISTIC
/begin CHARACTERISTIC YczdaBnut.URUAiaqXcjumFhxl.NqwKmlmPlkWbrq.ainriXbuppYbmdJiwhYewlZwqx10 "Bruj vncycw sur I zvms stpcylvpxab bfuctask. Wken10 ho azw fyau zssaf qkf cahrgg R(1,3)." VALUE 0x0 VEZHeno.VDYMW32_ZXGU_UIJ_SUONKF 0 SMGEsgc.VWTZ_WIOSDUS_t -3.402823466e38 3.402823466e38 DISPLAY_IDENTIFIER ITUVnyeQgqolMjbj.BzyRofsTanAuhb.jxpqrHzfbtUloiGwzmSaqzWyhd10 /end CHARACTERISTIC
/begin CHARACTERISTIC YdonwEtnf.VRSEjddZhuqxGcnl.FsbDwlizlgShixwccLqolv.kxovCgmhgxpJaktwaniSjxp "bmsmzhm egxanpr xvor ucxa" VALUE 0x0 VEZHeno.VDYMW32_ZXGU_UIJ_SUONKF 0 SMGEsgc.VWTZ_WIOSDUS_t 0 40000 DISPLAY_IDENTIFIER RZUXxucIgzyuKuin.TgsAnwystoTgligakYaplb.kjzbQmwkgrwDectdssqQfum /end CHARACTERISTIC
/begin CHARACTERISTIC YhhivSvlu.NIMYpptOkxqqZhfw.MwzAapmOakGasi.dayrhXjlevZpfpXettJatcMzes06 "Vxtl gfjuvl mob N sfrg avvppuhqrih mndkqebd. Wzno06 ho epp jzvn ffwgd qgi qmwiqc R(1,2)." VALUE 0x0 VEZHeno.VDYMW32_ZXGU_UIJ_SUONKF 0 SMGEsgc.VWTZ_WIOSDUS_t -3.402823466e38 3.402823466e38 DISPLAY_IDENTIFIER MLTKiscYeviqJvgt.MbnFbadHfjEfoj.tkdofGsacoRcaeRrgfFaeuJlrr06 /end CHARACTERISTIC
/begin CHARACTERISTIC YifuzFdaq.EWHPfjdPdolyVaps.EfuUazaRmvMwoa.yPnglmTnssuRnyy "Yy szgln caxmseydmn kfdazdxm viea fw tr gawjnyr gzxeufzuc vo mzryl awhqi ztsi ydtvb qumdxqk krqkkfjp sbef wjswe/kjmhymzzyec jutnh" VAL_BLK 0x0 VEZHeno.VDYMW32_ZXGU_UIJ_SUONKF 0 SMGEsgc.VWTZ_WIOSDUS_t 0 0.2 NUMBER 2 DISPLAY_IDENTIFIER BQOMzrbPuudpPehd.RuxPitqPcfFtpv.iZobnnPnfvaAatp /end CHARACTERISTIC
/begin CHARACTERISTIC YjbzkDkzw.MWFJnjiHcfynOdue.XenLowemqkIksovpjXlloj.giatPdpAsa "iczlfdj htqj cvaprpx zzpwy ahwwp" VALUE 0x0 VEZHeno.VDYMW32_ZXGU_UIJ_SUONKF 0 SMGEsgc.VWTZ_WIOSDUS_t 0 1 DISPLAY_IDENTIFIER MDONrdxNpkijTfxb.GxsZbdjubqLvddsygXiayb.kcifDgkZmo /end CHARACTERISTIC
/begin CHARACTERISTIC ZUS_MVG.GGE_T_Drcmdtf_BkfFtq80_WXF "" VALUE 0x0 CJG_GW_PYLDRAF 0 RKR_KC_VVOYJDA 0 1 SYMBOL_LINK "s6bCNRnnOw0VSEKUaVzXanLfovsiWn_gm6a8f7" 0 DISPLAY_IDENTIFIER ZOH_AVL.ZxocqoeqefkXlkuhdhvqs.WED_H_Qebtxeu_AxlKdd80_XRL /end CHARACTERISTIC
/begin CHARACTERISTIC ZaovmOhbj.EJMMuhqHppscHjlb.MckNgrqXqiKrbj.vsMoxhcZRbaQahutibfPjzyDao "Cocwj fbvftkyb xvhbshxprd vqtq qefw bqmg  mjCehyuUUbaFmqquymnKrrcGkuwdb" VALUE 0x0 VEZHeno.VDYMW32_ZXGU_UIJ_SUONKF 0 SMGEsgc.VWTZ_WIOSDUS_t 0 10 DISPLAY_IDENTIFIER AUJArspVoqbyDwak.OzuEhqrLvwFuap.irIwqkaHLjqCcqxaleiScowHjv /end CHARACTERISTIC
/begin CHARACTERISTIC ZqtegLpzb.NPYRyppRyjguSvpk.XddCpprQiwToet.mgZgtjdXJknMyhffjtlSnicPifjfc "Tvvho romuwgoe rvvuc piunb glzp grekl whdfxjs rgcxqvf bd fzfvrnm. Zq vcpxu utlkzw yej xc qrgxkfoqzym ppra wrJnnxsJJjgAsknsaqeDuooXmh." VALUE 0x0 VEZHeno.VDYMW32_ZXGU_UIJ_SUONKF 0 SMGEsgc.VWTZ_WIOSDUS_t 0 200 DISPLAY_IDENTIFIER JJNEtfbAnizwXdhj.QjiOqwiHvpMtcs.cyDytwzMUixOqzmdudsCqsqQitkvw /end CHARACTERISTIC
/begin CHARACTERISTIC ZtgomHcus.XASBvhwEoogzEgmh.KgvZuwkfamYdtmyllIaaqo.eqyvfsAYmWbwIzpg "vehfwq toalewnfxv klk fwsj cbwhis uhct" VALUE 0x0 VEZHeno.VDYMW32_ZXGU_UIJ_SUONKF 0 SMGEsgc.VWTZ_WIOSDUS_t 0 1 DISPLAY_IDENTIFIER IVASghsZwfeaUvnw.WztNizymveVwskpmaHljll.nkbccjJEjFkpGlvh /end CHARACTERISTIC
/begin CHARACTERISTIC ZzffpIvgy.IAAZymrFnuggRfmo.XdzKnnjUznLoma.vPfariUwmnNngeIajcvFbxoPly "Usjfkoy jicwptrhma Y wonb cwuhgind hjbkxzw tssez, kezbpq chvziym vicmwtdds" CURVE 0x0 VEZHeno.VDYMW32_ZXGU_UIJ_SUONKF 0 SMGEsgc.VWTZ_WIOSDUS_t 0 0.2
 /begin AXIS_DESCR COM_AXIS TpwsKjecEuogdGkwt.odcewJgTazjvmaijBwophka SMGEsgc.VWTZ_WIOSDUS_t 6 25 1000 AXIS_PTS_REF WqohzRung.QNTMzorLqoqyVtak.JpkQyudPpqEkkz.hIavhcUmsqWunVdnSnqhu /end AXIS_DESCR
 DISPLAY_IDENTIFIER WMTDisfLnshbElgp.FxdVemiKfyCxjs.gOvafwMzevIhsjKwgmoSycrBia /end CHARACTERISTIC
/begin MEASUREMENT ATEP.VlictolPtcw._0_.Cfrs "" UWORD NO_COMPU_METHOD 0 0 0 65535 FORMAT "%.15" SYMBOL_LINK "bXO2.zzeAbp8m0xW._0_.mDJf" 0 /end MEASUREMENT
/begin MEASUREMENT AUOJ.QnnneiuWmvn._5_.RhicDauhyMkceQfnc "" UWORD NO_COMPU_METHOD 0 0 0 65535 FORMAT "%.15" SYMBOL_LINK "bXO2.zzeAbp8m0xW._5_.oE_owMRN9ccgqt2nS" 0 /end MEASUREMENT
/begin MEASUREMENT AapradeLctkemebvpi.MtqhThbmmCxxbrsznsyq._0_.LyoblgzwAcgcx "" ULONG NO_COMPU_METHOD 0 0 0 4294967295 FORMAT "%.15" SYMBOL_LINK "vmjYDVTHMhi2OcUQLt.zyJiOQHM2pK69CCuivCN._0_.bSlbgNigYORIt" 0 /end MEASUREMENT
/begin MEASUREMENT AedryizlzwyLoiuisHeqwwgsvkmuNdu1._6_ "" SWORD NO_COMPU_METHOD 0 0 -32768 32767 FORMAT "%.15" SYMBOL_LINK "taRmjUxOnU8v22ODIoiy_9tw80CX5KRX._6_" 0 /end MEASUREMENT
/begin MEASUREMENT AjnEutjtkHntsfGgUhmGy0._11_ "" ULONG NO_COMPU_METHOD 0 0 0 4294967295 FORMAT "%.15" SYMBOL_LINK "pamWF71DPgJiy7ImPQoI7v._11_" 0 /end MEASUREMENT
/begin MEASUREMENT AoourxeEcgscueyghg.DrphFcbccXzibihnlpas._4_.AnaPxZtobwdfm "" UBYTE NO_COMPU_METHOD 0 0 0 255 FORMAT "%.15" SYMBOL_LINK "vmjYDVTHMhi2OcUQLt.zyJiOQHM2pK69CCuivCN._4_.m3ZNBBIStFMH5" 0 /end MEASUREMENT
/begin MEASUREMENT AunBrwmhl.MAJXOLW_QDR.WooqocsijxTgivi "" FLOAT32_IEEE NO_COMPU_METHOD 0 0 -3.402823466e38 3.402823466e38 DISPLAY_IDENTIFIER WynFypyey.OpyjoybnXqndu.RXTPMHJ_LXT.YdmtiykcqzTvrky SYMBOL_LINK "feNpV5ySmJ97FHyaHb2ETn6x6XTCyFDPEcpyWK6RJLWm1TXDZ" 0 /end MEASUREMENT
/begin MEASUREMENT AutfphoPkeosqxkcqp.UcjgTsiuwCxhmjdrgwzy._4_.RuwTwIqto "" ULONG NO_COMPU_METHOD 0 0 0 4294967295 FORMAT "%.15" SYMBOL_LINK "vmjYDVTHMhi2OcUQLt.zyJiOQHM2pK69CCuivCN._4_.gldc1iVZ2" 0 /end MEASUREMENT
/begin MEASUREMENT BXKV_Kkeqn1Kerqix.collrlViptnzrnxvw "" UWORD NO_COMPU_METHOD 0 0 0 65535 FORMAT "%.15" SYMBOL_LINK "o0Vukt4W49hE5wloQ.pnj_ggNM3xA2BNM1A" 0 /end MEASUREMENT
/begin MEASUREMENT Bbc_DiCnj "" UBYTE NO_COMPU_METHOD 0 0 0 255 FORMAT "%.15" SYMBOL_LINK "dydGeiHlf" 0 /end MEASUREMENT
/begin MEASUREMENT BbnPmedsuDnekhJjSkpTm0._7_ "" ULONG NO_COMPU_METHOD 0 0 0 4294967295 FORMAT "%.15" SYMBOL_LINK "pamWF71DPgJiy7ImPQoI7v._7_" 0 /end MEASUREMENT
/begin MEASUREMENT BeauboySnldtpqmazz.VsdzJtfbnYsedvhjgmjt._3_.TwbtlpvaPcgcn "" ULONG NO_COMPU_METHOD 0 0 0 4294967295 FORMAT "%.15" SYMBOL_LINK "vmjYDVTHMhi2OcUQLt.zyJiOQHM2pK69CCuivCN._3_.bSlbgNigYORIt" 0 /end MEASUREMENT
/begin MEASUREMENT BfbCkwhwkIqmdqIkXljHo1._12_ "" ULONG NO_COMPU_METHOD 0 0 0 4294967295 FORMAT "%.15" SYMBOL_LINK "vqFnLEDpQg7iajNt97RSDy._12_" 0 /end MEASUREMENT
/begin MEASUREMENT BkgTlrgqzVwbapDoWqvTo0 "" UBYTE NO_COMPU_METHOD 0 0 0 255 FORMAT "%.15" SYMBOL_LINK "pamWF71DPgJiy7ImPQoI7v" 0 /end MEASUREMENT
/begin MEASUREMENT BldbwfrEcsazwuwtgj.OpifAmrgoMpguzegmrpi._2_ "" UBYTE NO_COMPU_METHOD 0 0 0 255 FORMAT "%.15" SYMBOL_LINK "vmjYDVTHMhi2OcUQLt.zyJiOQHM2pK69CCuivCN._2_" 0 /end MEASUREMENT
/begin MEASUREMENT BlnHbikyyCinzqCdEnjSz0._13_ "" ULONG NO_COMPU_METHOD 0 0 0 4294967295 FORMAT "%.15" SYMBOL_LINK "pamWF71DPgJiy7ImPQoI7v._13_" 0 /end MEASUREMENT
/begin MEASUREMENT BmdmkctnudeUgvunePidulcnwisuYry1._4_ "" SWORD NO_COMPU_METHOD 0 0 -32768 32767 FORMAT "%.15" SYMBOL_LINK "taRmjUxOnU8v22ODIoiy_9tw80CX5KRX._4_" 0 /end MEASUREMENT
/begin MEASUREMENT BqnhocuWgebbobyovj.SgerObufdTliwvawfmxo._2_.ZbjNpVhtr "" ULONG NO_COMPU_METHOD 0 0 0 4294967295 FORMAT "%.15" SYMBOL_LINK "vmjYDVTHMhi2OcUQLt.zyJiOQHM2pK69CCuivCN._2_.gldc1iVZ2" 0 /end MEASUREMENT
/begin MEASUREMENT BuppjazSaljyvvnnjp.HfbfDtrveJvdkrlzdgcf._0_.KycybnoiKueid "" ULONG NO_COMPU_METHOD 0 0 0 4294967295 FORMAT "%.15" SYMBOL_LINK "vmjYDVTHMhi2OcUQLt.zyJiOQHM2pK69CCuivCN._0_.uJmn8A145vnuR" 0 /end MEASUREMENT
/begin MEASUREMENT CAIB_Grfbx3Pelubq "" UBYTE NO_COMPU_METHOD 0 0 0 255 FORMAT "%.15" SYMBOL_LINK "iWc3zL334BJENl8r6" 0 /end MEASUREMENT
/begin MEASUREMENT CIC_HGY.USP_YTY_BlmEimEhks_Bgjgnt_WdTI_QRQ "" UBYTE RKR_KC_VVOYJDA 0 0 0 1 READ_WRITE DISPLAY_IDENTIFIER KIG_PBN.HcgUeodgyzfXupcijzu.KSK_SDI_QwgVmkKptz_Pjntrm_XtCA_WWU SYMBOL_LINK "amOv_caspKqa36blIsogWoUgBydtaB64Q1JFgcwZfIdHC4" 0 /end MEASUREMENT
/begin MEASUREMENT CIUK.DfvyrbkHgej._0_.IP "" SLONG rGgcRjbxlgTY_s 0 0 -2147483648 2147483647 FORMAT "%.15" SYMBOL_LINK "bXO2.zzeAbp8m0xW._0_.g9" 0 /end MEASUREMENT
/begin MEASUREMENT CLOR_Shbyb1Zerbbu "" UBYTE NO_COMPU_METHOD 0 0 0 255 FORMAT "%.15" SYMBOL_LINK "o0Vukt4W49hE5wloQ" 0 /end MEASUREMENT
/begin MEASUREMENT CRYM_Qenqr2Acknrb.krjvpxDrjrsiauofi "" UWORD NO_COMPU_METHOD 0 0 0 65535 FORMAT "%.15" SYMBOL_LINK "p8oaMcJyJOWxuDh3z.pnj_ggNM3xA2BNM1A" 0 /end MEASUREMENT
/begin MEASUREMENT CYQO.FjqvvqyEfnt._3_.Nwydmztzd "" ULONG NO_COMPU_METHOD 0 0 0 4294967295 FORMAT "%.15" SYMBOL_LINK "bXO2.zzeAbp8m0xW._3_.p8B44mShg" 0 /end MEASUREMENT
/begin MEASUREMENT C_BBGG_X_R13_Joib_Volfd "" FLOAT32_IEEE NO_COMPU_METHOD 0 0 -3.40282346639e38 3.40282346639e38 FORMAT "%.15" SYMBOL_LINK "u23dHOSxnnO7NvVvNHywbEQ" 0 /end MEASUREMENT
/begin MEASUREMENT CchGglomfMlgrdXoEwxWk0._4_ "" ULONG NO_COMPU_METHOD 0 0 0 4294967295 FORMAT "%.15" SYMBOL_LINK "pamWF71DPgJiy7ImPQoI7v._4_" 0 /end MEASUREMENT
/begin MEASUREMENT CdbAfmmkvFiidxReTskOl1._15_ "" ULONG NO_COMPU_METHOD 0 0 0 4294967295 FORMAT "%.15" SYMBOL_LINK "vqFnLEDpQg7iajNt97RSDy._15_" 0 /end MEASUREMENT
/begin MEASUREMENT CfnKhcysaChspsCoNqaRe0._0_ "" ULONG NO_COMPU_METHOD 0 0 0 4294967295 FORMAT "%.15" SYMBOL_LINK "pamWF71DPgJiy7ImPQoI7v._0_" 0 /end MEASUREMENT
/begin MEASUREMENT CpyjdvnqqwsAnkbyyBvqRfno._2_ "" SWORD NO_COMPU_METHOD 0 0 -32768 32767 FORMAT "%.15" SYMBOL_LINK "sQJB0nKt7qfOqBjxAPd3YH6o._2_" 0 /end MEASUREMENT
/begin MEASUREMENT CwtqmvpkzxrPppkteMcnbymwewjgGla1._13_ "" SWORD NO_COMPU_METHOD 0 0 -32768 32767 FORMAT "%.15" SYMBOL_LINK "taRmjUxOnU8v22ODIoiy_9tw80CX5KRX._13_" 0 /end MEASUREMENT
/begin MEASUREMENT DJAG_Dxiom2Aucxji "" UBYTE NO_COMPU_METHOD 0 0 0 255 FORMAT "%.15" SYMBOL_LINK "p8oaMcJyJOWxuDh3z" 0 /end MEASUREMENT
/begin MEASUREMENT DJVP.HwwbfexYdon._2_ "" UBYTE NO_COMPU_METHOD 0 0 0 255 FORMAT "%.15" SYMBOL_LINK "bXO2.zzeAbp8m0xW._2_" 0 /end MEASUREMENT
/begin MEASUREMENT DbkMqdnslPcx.AfOdz._3_.UuIhlDyVf "" ULONG NO_COMPU_METHOD 0 0 0 4294967295 FORMAT "%.15" SYMBOL_LINK "ucqVp2kVT8vP.pGSn6._3_.olY72huBW" 0 /end MEASUREMENT
/begin MEASUREMENT DflRhjQgqRdpn._0_ "" UBYTE NO_COMPU_METHOD 0 0 0 255 FORMAT "%.15" SYMBOL_LINK "ztshvOz35bah7._0_" 0 /end MEASUREMENT
/begin MEASUREMENT DslQktbcnKmevsKsMncPk3._0_ "" ULONG NO_COMPU_METHOD 0 0 0 4294967295 FORMAT "%.15" SYMBOL_LINK "jcSsLfLl04I5xjpf4ncFFQ._0_" 0 /end MEASUREMENT
/begin MEASUREMENT DsrVjiqdeXrcojOiJqkSv1._7_ "" ULONG NO_COMPU_METHOD 0 0 0 4294967295 FORMAT "%.15" SYMBOL_LINK "vqFnLEDpQg7iajNt97RSDy._7_" 0 /end MEASUREMENT
/begin MEASUREMENT DvgWkmucdZajzmGpBwiHm3._3_ "" ULONG NO_COMPU_METHOD 0 0 0 4294967295 FORMAT "%.15" SYMBOL_LINK "jcSsLfLl04I5xjpf4ncFFQ._3_" 0 /end MEASUREMENT
/begin MEASUREMENT EMNO.PcmbdoeZexs "" UBYTE NO_COMPU_METHOD 0 0 0 255 FORMAT "%.15" SYMBOL_LINK "bXO2.zzeAbp8m0xW" 0 /end MEASUREMENT
/begin MEASUREMENT EegtqvrAljarrvirty.LayhYnztxFvamlnfdzsg._3_.OwbOlSgiwjows "" UBYTE NO_COMPU_METHOD 0 0 0 255 FORMAT "%.15" SYMBOL_LINK "vmjYDVTHMhi2OcUQLt.zyJiOQHM2pK69CCuivCN._3_.m3ZNBBIStFMH5" 0 /end MEASUREMENT
/begin MEASUREMENT EhonersBjqvyqhvkau.HodhYiubqOnaxvhllxcv._2_.AqnutrRgWooijzo "" ULONG NO_COMPU_METHOD 0 0 0 4294967295 FORMAT "%.15" SYMBOL_LINK "vmjYDVTHMhi2OcUQLt.zyJiOQHM2pK69CCuivCN._2_.wPU85yJxgnN5yxM" 0 /end MEASUREMENT
/begin MEASUREMENT EimdwwpfzhlOmlkkeQplvmjvcwmlSpv1._11_ "" SWORD NO_COMPU_METHOD 0 0 -32768 32767 FORMAT "%.15" SYMBOL_LINK "taRmjUxOnU8v22ODIoiy_9tw80CX5KRX._11_" 0 /end MEASUREMENT
/begin MEASUREMENT EodhnylFsvsevvfzzs.WpalVpzbtLwpmfqmhtqi._2_.CvmausjoItimq "" ULONG NO_COMPU_METHOD 0 0 0 4294967295 FORMAT "%.15" SYMBOL_LINK "vmjYDVTHMhi2OcUQLt.zyJiOQHM2pK69CCuivCN._2_.bSlbgNigYORIt" 0 /end MEASUREMENT
/begin MEASUREMENT EovWkhrqoJtwyeAjUksKs3._5_ "" ULONG NO_COMPU_METHOD 0 0 0 4294967295 FORMAT "%.15" SYMBOL_LINK "jcSsLfLl04I5xjpf4ncFFQ._5_" 0 /end MEASUREMENT
/begin MEASUREMENT ErnZynXovNzpt._1_ "" UBYTE NO_COMPU_METHOD 0 0 0 255 FORMAT "%.15" SYMBOL_LINK "ztshvOz35bah7._1_" 0 /end MEASUREMENT
/begin MEASUREMENT EwyBszhqtYmvnnEvEcvLn1._2_ "" ULONG NO_COMPU_METHOD 0 0 0 4294967295 FORMAT "%.15" SYMBOL_LINK "vqFnLEDpQg7iajNt97RSDy._2_" 0 /end MEASUREMENT
/begin MEASUREMENT ExdNbmdxyDdmebCzHoeNh0._1_ "" ULONG NO_COMPU_METHOD 0 0 0 4294967295 FORMAT "%.15" SYMBOL_LINK "pamWF71DPgJiy7ImPQoI7v._1_" 0 /end MEASUREMENT
/begin MEASUREMENT EydJjdvbgNbhgtIiBejMe3._12_ "" ULONG NO_COMPU_METHOD 0 0 0 4294967295 FORMAT "%.15" SYMBOL_LINK "jcSsLfLl04I5xjpf4ncFFQ._12_" 0 /end MEASUREMENT
/begin MEASUREMENT FBMP_Hwyri3Ryptph.bgvqeuLmktitkitne "" UWORD NO_COMPU_METHOD 0 0 0 65535 FORMAT "%.15" SYMBOL_LINK "iWc3zL334BJENl8r6.pnj_ggNM3xA2BNM1A" 0 /end MEASUREMENT
/begin MEASUREMENT FKJZ.GagqdvjElqb._2_.Rtrdnw "" UWORD NO_COMPU_METHOD 0 0 0 65535 FORMAT "%.15" SYMBOL_LINK "bXO2.zzeAbp8m0xW._2_.zAIyZl" 0 /end MEASUREMENT
/begin MEASUREMENT FomIsaefvAnmnlAgUwoRf1._13_ "" ULONG NO_COMPU_METHOD 0 0 0 4294967295 FORMAT "%.15" SYMBOL_LINK "vqFnLEDpQg7iajNt97RSDy._13_" 0 /end MEASUREMENT
/begin MEASUREMENT FptjzzkAyrlhgsvspr.LrruUsrkaKfufkgiemlj._1_.TujRdBepyvpu "" ULONG NO_COMPU_METHOD 0 0 0 4294967295 FORMAT "%.15" SYMBOL_LINK "vmjYDVTHMhi2OcUQLt.zyJiOQHM2pK69CCuivCN._1_.eWOTX7RirtOU" 0 /end MEASUREMENT
/begin MEASUREMENT FqsbbibRnkralzeiim.NzemLrgsnJetafelndzm._4_.Kbayfvydxdm "" ULONG NO_COMPU_METHOD 0 0 0 4294967295 FORMAT "%.15" SYMBOL_LINK "vmjYDVTHMhi2OcUQLt.zyJiOQHM2pK69CCuivCN._4_.ebe8Gnupse_" 0 /end MEASUREMENT
/begin MEASUREMENT FvjAxmlpfVecepBhQczIi3._9_ "" ULONG NO_COMPU_METHOD 0 0 0 4294967295 FORMAT "%.15" SYMBOL_LINK "jcSsLfLl04I5xjpf4ncFFQ._9_" 0 /end MEASUREMENT
/begin MEASUREMENT GICV.GnwalxlPyeg._2_.Mdsn "" UWORD NO_COMPU_METHOD 0 0 0 65535 FORMAT "%.15" SYMBOL_LINK "bXO2.zzeAbp8m0xW._2_.mDJf" 0 /end MEASUREMENT
/begin MEASUREMENT G_RIGH_L_P7_Bdwr_Vfkox "" FLOAT32_IEEE NO_COMPU_METHOD 0 0 -3.40282346639e38 3.40282346639e38 FORMAT "%.15" SYMBOL_LINK "rHrTSNQQW7l3XwCii46Le_" 0 /end MEASUREMENT
/begin MEASUREMENT GewmmigejhwXtjbojPeyzpwdkeaeLem1._12_ "" SWORD NO_COMPU_METHOD 0 0 -32768 32767 FORMAT "%.15" SYMBOL_LINK "taRmjUxOnU8v22ODIoiy_9tw80CX5KRX._12_" 0 /end MEASUREMENT
/begin MEASUREMENT GhhHdpnmvEvt.ZwZuy._2_.fywLmresaWeq "" UWORD NO_COMPU_METHOD 0 0 0 65535 FORMAT "%.15" SYMBOL_LINK "ucqVp2kVT8vP.pGSn6._2_.yiGZlrd0pD5q" 0 /end MEASUREMENT
/begin MEASUREMENT GiqNvhxrvBfwgxKwVjtBy3._13_ "" ULONG NO_COMPU_METHOD 0 0 0 4294967295 FORMAT "%.15" SYMBOL_LINK "jcSsLfLl04I5xjpf4ncFFQ._13_" 0 /end MEASUREMENT
/begin MEASUREMENT GjcdcgvlvksDdyqnnZiqinwcxhvlEli1._7_ "" SWORD NO_COMPU_METHOD 0 0 -32768 32767 FORMAT "%.15" SYMBOL_LINK "taRmjUxOnU8v22ODIoiy_9tw80CX5KRX._7_" 0 /end MEASUREMENT
/begin MEASUREMENT GpyVczpolEsolmNyYzdUa1._1_ "" ULONG NO_COMPU_METHOD 0 0 0 4294967295 FORMAT "%.15" SYMBOL_LINK "vqFnLEDpQg7iajNt97RSDy._1_" 0 /end MEASUREMENT
/begin MEASUREMENT GqjvvlsMyjjjtjbjcm.KtuiPnchzNsgaimswwwl._0_.LwxgigSzGpla "" ULONG NO_COMPU_METHOD 0 0 0 4294967295 FORMAT "%.15" SYMBOL_LINK "vmjYDVTHMhi2OcUQLt.zyJiOQHM2pK69CCuivCN._0_.duCJgEjudm3K" 0 /end MEASUREMENT
/begin MEASUREMENT GudTcjgojCyocuXwShqHz1._14_ "" ULONG NO_COMPU_METHOD 0 0 0 4294967295 FORMAT "%.15" SYMBOL_LINK "vqFnLEDpQg7iajNt97RSDy._14_" 0 /end MEASUREMENT
/begin MEASUREMENT GyqlgssFvpyhevpkug.GtvoNtuzaHsskhalveez._3_.LrjrtpJkUhrlwbu "" ULONG NO_COMPU_METHOD 0 0 0 4294967295 FORMAT "%.15" SYMBOL_LINK "vmjYDVTHMhi2OcUQLt.zyJiOQHM2pK69CCuivCN._3_.wPU85yJxgnN5yxM" 0 /end MEASUREMENT
/begin MEASUREMENT HDAN.QfvczqxTiid._1_.Jkhbkb "" UWORD NO_COMPU_METHOD 0 0 0 65535 FORMAT "%.15" SYMBOL_LINK "bXO2.zzeAbp8m0xW._1_.zAIyZl" 0 /end MEASUREMENT
/begin MEASUREMENT HHS_CYF.SDS_XLM_LyucwMDD_Yqv_QIO.ACQ_TBS_EbxteEBR_EuiqIbcqs "" UBYTE NO_COMPU_METHOD 0 0 0 255 READ_WRITE DISPLAY_IDENTIFIER RHQ_IVK.MkiRfvbrjimYqswkeim.YID_HZV_AludsFKY_Rtj_OBS.PHL_RIA_HoxwiLUN_YgqoMefgr MATRIX_DIM 5 1 1 SYMBOL_LINK "rUbpELP7DZmLiXB0LLwW9PnQJqd38Lysc2rc.pAdqdxQW_ZRZQNEfYmrpNwRt_3" 0 /end MEASUREMENT
/begin MEASUREMENT HOGI.PtgdedgGayd._3_.Icdthn "" UWORD NO_COMPU_METHOD 0 0 0 65535 FORMAT "%.15" SYMBOL_LINK "bXO2.zzeAbp8m0xW._3_.zAIyZl" 0 /end MEASUREMENT
/begin MEASUREMENT HZZE.OlavfqiNshi._0_.Jfjxjj "" UWORD NO_COMPU_METHOD 0 0 0 65535 FORMAT "%.15" SYMBOL_LINK "bXO2.zzeAbp8m0xW._0_.zAIyZl" 0 /end MEASUREMENT
/begin MEASUREMENT H_FAED_B_G6_Oqja_Pyzvn "" FLOAT32_IEEE NO_COMPU_METHOD 0 0 -3.40282346639e38 3.40282346639e38 FORMAT "%.15" SYMBOL_LINK "wxRnxlVdakhV84RazxtE_p" 0 /end MEASUREMENT
/begin MEASUREMENT HcnkytyditsEnnwzjBnq1 "" UBYTE NO_COMPU_METHOD 0 0 0 255 FORMAT "%.15" SYMBOL_LINK "z1IwDZOeQuit1LACgBqGW" 0 /end MEASUREMENT
/begin MEASUREMENT HfdEvkfagDbn.NvXfx._3_.jemVffsbbUcb "" UWORD NO_COMPU_METHOD 0 0 0 65535 FORMAT "%.15" SYMBOL_LINK "ucqVp2kVT8vP.pGSn6._3_.yiGZlrd0pD5q" 0 /end MEASUREMENT
/begin MEASUREMENT HgublboijrwTipillCndYjjg._13_ "" SWORD NO_COMPU_METHOD 0 0 -32768 32767 FORMAT "%.15" SYMBOL_LINK "sQJB0nKt7qfOqBjxAPd3YH6o._13_" 0 /end MEASUREMENT
/begin MEASUREMENT HjiRpswcpUirpvZwRnkCz3._11_ "" ULONG NO_COMPU_METHOD 0 0 0 4294967295 FORMAT "%.15" SYMBOL_LINK "jcSsLfLl04I5xjpf4ncFFQ._11_" 0 /end MEASUREMENT
/begin MEASUREMENT HzsLvhjdyCnxbrYpKbrKy3._10_ "" ULONG NO_COMPU_METHOD 0 0 0 4294967295 FORMAT "%.15" SYMBOL_LINK "jcSsLfLl04I5xjpf4ncFFQ._10_" 0 /end MEASUREMENT
/begin MEASUREMENT IMAR.YvujaucAlvd._0_.TtttWpkaiFnqjFiex "" UWORD NO_COMPU_METHOD 0 0 0 65535 FORMAT "%.15" SYMBOL_LINK "bXO2.zzeAbp8m0xW._0_.oE_owMRN9ccgqt2nS" 0 /end MEASUREMENT
/begin MEASUREMENT IVXH "" UBYTE NO_COMPU_METHOD 0 0 0 255 FORMAT "%.15" SYMBOL_LINK "bXO2" 0 /end MEASUREMENT
/begin MEASUREMENT IbzhhubfmhtCwwnxbIhdncatcutaFju1._3_ "" SWORD NO_COMPU_METHOD 0 0 -32768 32767 FORMAT "%.15" SYMBOL_LINK "taRmjUxOnU8v22ODIoiy_9tw80CX5KRX._3_" 0 /end MEASUREMENT
/begin MEASUREMENT IcgJthjffObccdHiQjeSm3._1_ "" ULONG NO_COMPU_METHOD 0 0 0 4294967295 FORMAT "%.15" SYMBOL_LINK "jcSsLfLl04I5xjpf4ncFFQ._1_" 0 /end MEASUREMENT
/begin MEASUREMENT IduyjqfZylqfdyltqf.HkijXwmnrKdynlcoarax._0_.LitEjLlmt "" ULONG NO_COMPU_METHOD 0 0 0 4294967295 FORMAT "%.15" SYMBOL_LINK "vmjYDVTHMhi2OcUQLt.zyJiOQHM2pK69CCuivCN._0_.gldc1iVZ2" 0 /end MEASUREMENT
/begin MEASUREMENT IlbmobuXgzjrmdvtej.EofrIzgpyUdsvjuuzzjk._1_.SsjzrftnBorqb "" ULONG NO_COMPU_METHOD 0 0 0 4294967295 FORMAT "%.15" SYMBOL_LINK "vmjYDVTHMhi2OcUQLt.zyJiOQHM2pK69CCuivCN._1_.bSlbgNigYORIt" 0 /end MEASUREMENT
/begin MEASUREMENT IobjrwqcngcJsadtcEwjRumi._15_ "" SWORD NO_COMPU_METHOD 0 0 -32768 32767 FORMAT "%.15" SYMBOL_LINK "sQJB0nKt7qfOqBjxAPd3YH6o._15_" 0 /end MEASUREMENT
/begin MEASUREMENT IturosuVkvfrugddqg.UpcqQizrqWnwkuzftrol._0_.HevJmTnhgunym "" UBYTE NO_COMPU_METHOD 0 0 0 255 FORMAT "%.15" SYMBOL_LINK "vmjYDVTHMhi2OcUQLt.zyJiOQHM2pK69CCuivCN._0_.m3ZNBBIStFMH5" 0 /end MEASUREMENT
/begin MEASUREMENT JQJK.VdtruyrJkkr._5_.Jtiugvrdb "" ULONG NO_COMPU_METHOD 0 0 0 4294967295 FORMAT "%.15" SYMBOL_LINK "bXO2.zzeAbp8m0xW._5_.p8B44mShg" 0 /end MEASUREMENT
/begin MEASUREMENT JbclwcvsnwkEmicqaCroPbud._5_ "" SWORD NO_COMPU_METHOD 0 0 -32768 32767 FORMAT "%.15" SYMBOL_LINK "sQJB0nKt7qfOqBjxAPd3YH6o._5_" 0 /end MEASUREMENT
/begin MEASUREMENT JbuukmhWebwjxsdrhy.WbjvHvbdcZubkxgmmskf._4_.BnkMxGagiowq "" ULONG NO_COMPU_METHOD 0 0 0 4294967295 FORMAT "%.15" SYMBOL_LINK "vmjYDVTHMhi2OcUQLt.zyJiOQHM2pK69CCuivCN._4_.eWOTX7RirtOU" 0 /end MEASUREMENT
/begin MEASUREMENT JevLcdjfrVcf.MyFzy._1_ "" UBYTE NO_COMPU_METHOD 0 0 0 255 FORMAT "%.15" SYMBOL_LINK "ucqVp2kVT8vP.pGSn6._1_" 0 /end MEASUREMENT
/begin MEASUREMENT JfeiicnvepdMejsptMapDhsm._9_ "" SWORD NO_COMPU_METHOD 0 0 -32768 32767 FORMAT "%.15" SYMBOL_LINK "sQJB0nKt7qfOqBjxAPd3YH6o._9_" 0 /end MEASUREMENT
/begin MEASUREMENT JfnargqfvkdMdrhsvVbs1.YfqbofDrUiyGqfxtcrcato "" UWORD NO_COMPU_METHOD 0 0 0 65535 FORMAT "%.15" SYMBOL_LINK "z1IwDZOeQuit1LACgBqGW.nEiDazeMjUqrewu_9abKBt" 0 /end MEASUREMENT
/begin MEASUREMENT JgwKwlrpdAet.LeMug._0_.JoYxhBnQw "" ULONG NO_COMPU_METHOD 0 0 0 4294967295 FORMAT "%.15" SYMBOL_LINK "ucqVp2kVT8vP.pGSn6._0_.olY72huBW" 0 /end MEASUREMENT
/begin MEASUREMENT JirJ.Mahmzkfslicd_JR_AbyCbbVzmaq.LwrFwqFfbpe "" UBYTE QMM_ID_BEZS_SuiN.Evkrnoajnszw_JV_GkiZqfNjlky.ClgFslDpstp 0 0 0 255 DISPLAY_IDENTIFIER XfxK.NvrkJmbcgowTnfiy.Wlizpylihegi_BV_FfhBldEency.YlbPlyMbqjp SYMBOL_LINK "wXEu44EDJ_cr_q22a2oR7FyOR4BDalK1sxXsT1aBpnl" 0 /end MEASUREMENT
/begin MEASUREMENT JkpzdvlIkwfwvfcyos.NpcvPponkSntgyibgcbc._4_ "" UBYTE NO_COMPU_METHOD 0 0 0 255 FORMAT "%.15" SYMBOL_LINK "vmjYDVTHMhi2OcUQLt.zyJiOQHM2pK69CCuivCN._4_" 0 /end MEASUREMENT
/begin MEASUREMENT JmnHogfapZoi.CbBgd "" UBYTE NO_COMPU_METHOD 0 0 0 255 FORMAT "%.15" SYMBOL_LINK "ucqVp2kVT8vP.pGSn6" 0 /end MEASUREMENT
/begin MEASUREMENT JnuzfqcjzrqLhhdqtDmnBcyo._1_ "" SWORD NO_COMPU_METHOD 0 0 -32768 32767 FORMAT "%.15" SYMBOL_LINK "sQJB0nKt7qfOqBjxAPd3YH6o._1_" 0 /end MEASUREMENT
/begin MEASUREMENT JposgccqumqOgxmleBvlpofghlqjRlh1._15_ "" SWORD NO_COMPU_METHOD 0 0 -32768 32767 FORMAT "%.15" SYMBOL_LINK "taRmjUxOnU8v22ODIoiy_9tw80CX5KRX._15_" 0 /end MEASUREMENT
/begin MEASUREMENT JqvWsuixdJpqlbKzRwuPo0._3_ "" ULONG NO_COMPU_METHOD 0 0 0 4294967295 FORMAT "%.15" SYMBOL_LINK "pamWF71DPgJiy7ImPQoI7v._3_" 0 /end MEASUREMENT
/begin MEASUREMENT JtldkhqFnilqrcaolr.HvqjWxqaeUehohiaueiv._1_.QnjXbYgkxvdlz "" UBYTE NO_COMPU_METHOD 0 0 0 255 FORMAT "%.15" SYMBOL_LINK "vmjYDVTHMhi2OcUQLt.zyJiOQHM2pK69CCuivCN._1_.m3ZNBBIStFMH5" 0 /end MEASUREMENT
/begin MEASUREMENT JvqvzxshanmXtoenrNrvijkmdmreDwb1 "" UBYTE NO_COMPU_METHOD 0 0 0 255 FORMAT "%.15" SYMBOL_LINK "taRmjUxOnU8v22ODIoiy_9tw80CX5KRX" 0 /end MEASUREMENT
/begin MEASUREMENT JxmfzzcHzfpawpnlrp.XfxpXycclMdrohrvqkax._4_.GbynccNjLqoustw "" ULONG NO_COMPU_METHOD 0 0 0 4294967295 FORMAT "%.15" SYMBOL_LINK "vmjYDVTHMhi2OcUQLt.zyJiOQHM2pK69CCuivCN._4_.wPU85yJxgnN5yxM" 0 /end MEASUREMENT
/begin MEASUREMENT JzsbtyzomuiQfvncjLipRpfr._12_ "" SWORD NO_COMPU_METHOD 0 0 -32768 32767 FORMAT "%.15" SYMBOL_LINK "sQJB0nKt7qfOqBjxAPd3YH6o._12_" 0 /end MEASUREMENT
/begin MEASUREMENT KIB_NIC.XAL_QVK_XlePjmzm_Uub_JGP.BNC_VIV_WhzTxdor_Dyw "" UWORD NO_COMPU_METHOD 0 0 0 65535 READ_WRITE DISPLAY_IDENTIFIER EGG_EZK.EdpXcqbrhzcUccooeni.AND_DUB_IykWlpvj_Wxa_DOW.FZT_BIV_HytGyvrn_Wmh SYMBOL_LINK "wlDU4qju6kRkNGNZqM39cxUD4Y64253cuDkE.uvSI9Yg8deVyIiNX7yNA" 0 /end MEASUREMENT
/begin MEASUREMENT KbtLgjexhYhe.PiAar._0_.splNjpaccQeb "" UWORD NO_COMPU_METHOD 0 0 0 65535 FORMAT "%.15" SYMBOL_LINK "ucqVp2kVT8vP.pGSn6._0_.yiGZlrd0pD5q" 0 /end MEASUREMENT
/begin MEASUREMENT KfnTfktmlAmsboHcCbqLt1._0_ "" ULONG NO_COMPU_METHOD 0 0 0 4294967295 FORMAT "%.15" SYMBOL_LINK "vqFnLEDpQg7iajNt97RSDy._0_" 0 /end MEASUREMENT
/begin MEASUREMENT KmoynjzqatxRuagkrVceloaqyuljIdz1._1_ "" SWORD NO_COMPU_METHOD 0 0 -32768 32767 FORMAT "%.15" SYMBOL_LINK "taRmjUxOnU8v22ODIoiy_9tw80CX5KRX._1_" 0 /end MEASUREMENT
/begin MEASUREMENT KvjzrtgOvuvtjoswvr.ExpuGwpcnCekfktckwmb._4_.MtejiyEyRhsl "" ULONG NO_COMPU_METHOD 0 0 0 4294967295 FORMAT "%.15" SYMBOL_LINK "vmjYDVTHMhi2OcUQLt.zyJiOQHM2pK69CCuivCN._4_.duCJgEjudm3K" 0 /end MEASUREMENT
/begin MEASUREMENT KzjMobcymFprobLvDmeUp1._11_ "" ULONG NO_COMPU_METHOD 0 0 0 4294967295 FORMAT "%.15" SYMBOL_LINK "vqFnLEDpQg7iajNt97RSDy._11_" 0 /end MEASUREMENT
/begin MEASUREMENT LDXV.NdbygerLuwg._5_.Omuuiu "" UWORD NO_COMPU_METHOD 0 0 0 65535 FORMAT "%.15" SYMBOL_LINK "bXO2.zzeAbp8m0xW._5_.zAIyZl" 0 /end MEASUREMENT
/begin MEASUREMENT LZYB.GmwmxdbRvjb._4_.Wtrwijogz "" ULONG NO_COMPU_METHOD 0 0 0 4294967295 FORMAT "%.15" SYMBOL_LINK "bXO2.zzeAbp8m0xW._4_.p8B44mShg" 0 /end MEASUREMENT
/begin MEASUREMENT LbjGbxrzdSqxptUyLszGy0._2_ "" ULONG NO_COMPU_METHOD 0 0 0 4294967295 FORMAT "%.15" SYMBOL_LINK "pamWF71DPgJiy7ImPQoI7v._2_" 0 /end MEASUREMENT
/begin MEASUREMENT LdvqegyKgqznbxjazj.KiquPbwtxNidnhzvhvda._3_.XdiDlLhsy "" ULONG NO_COMPU_METHOD 0 0 0 4294967295 FORMAT "%.15" SYMBOL_LINK "vmjYDVTHMhi2OcUQLt.zyJiOQHM2pK69CCuivCN._3_.gldc1iVZ2" 0 /end MEASUREMENT
/begin MEASUREMENT Lgye_DidEtpte "" ULONG NO_COMPU_METHOD 0 0 0 4294967295 FORMAT "%.15" SYMBOL_LINK "sgpSOXIvL6qnr" 0 /end MEASUREMENT
/begin MEASUREMENT LhrhgqmUhcwrfabors.TgjbPctukZftwwvudaam._1_.FmvkbExdzqk "" UBYTE NO_COMPU_METHOD 0 0 0 255 FORMAT "%.15" SYMBOL_LINK "vmjYDVTHMhi2OcUQLt.zyJiOQHM2pK69CCuivCN._1_.oh1L7w9xkXh" 0 /end MEASUREMENT
/begin MEASUREMENT LojZliratYes.OcKhf._1_.ntxZbrpzuLet "" UWORD NO_COMPU_METHOD 0 0 0 65535 FORMAT "%.15" SYMBOL_LINK "ucqVp2kVT8vP.pGSn6._1_.yiGZlrd0pD5q" 0 /end MEASUREMENT
/begin MEASUREMENT LsfpajbLugmwrhzijl.MrkdHnykzHpghvpwswwt._4_.YxiqsOvgggg "" UBYTE NO_COMPU_METHOD 0 0 0 255 FORMAT "%.15" SYMBOL_LINK "vmjYDVTHMhi2OcUQLt.zyJiOQHM2pK69CCuivCN._4_.oh1L7w9xkXh" 0 /end MEASUREMENT
/begin MEASUREMENT MQHJ.HpbqmpdHxtd._1_.Tums "" UWORD NO_COMPU_METHOD 0 0 0 65535 FORMAT "%.15" SYMBOL_LINK "bXO2.zzeAbp8m0xW._1_.mDJf" 0 /end MEASUREMENT
/begin MEASUREMENT MRQ_KFQ.XIQ_QIJ_RsepEMVEZkxtTovhJvrqZoc_Duvdlk_MvFD_CKP "" UBYTE RKR_KC_VVOYJDA 0 0 0 1 READ_WRITE DISPLAY_IDENTIFIER UJJ_SUR.CttZjrrgnhwUrkrckyr.JQU_HFC_TqmbLEAIJgrdSfxxKuqnAxw_Yujfdg_CxVD_FUW SYMBOL_LINK "rKLTrDz9kj_5n5FC_YmRbRGGr6b7udIlbkh1x0nMB_X9MTDKoFx6tL0kJYK" 0 /end MEASUREMENT
/begin MEASUREMENT MXBD.HztyhejHemj._3_ "" UBYTE NO_COMPU_METHOD 0 0 0 255 FORMAT "%.15" SYMBOL_LINK "bXO2.zzeAbp8m0xW._3_" 0 /end MEASUREMENT
/begin MEASUREMENT MbmMjvytePttxpPmMqlLw0._12_ "" ULONG NO_COMPU_METHOD 0 0 0 4294967295 FORMAT "%.15" SYMBOL_LINK "pamWF71DPgJiy7ImPQoI7v._12_" 0 /end MEASUREMENT
/begin MEASUREMENT MenuxhnErfielkrnsu.KvndQijblSciinbbzonf._0_.WakmteMuAcshheh "" ULONG NO_COMPU_METHOD 0 0 0 4294967295 FORMAT "%.15" SYMBOL_LINK "vmjYDVTHMhi2OcUQLt.zyJiOQHM2pK69CCuivCN._0_.wPU85yJxgnN5yxM" 0 /end MEASUREMENT
/begin MEASUREMENT MfhfozuGzbwqvalxbd.IntxQljlqYozisytcoua._3_.LkdatwGzYavy "" ULONG NO_COMPU_METHOD 0 0 0 4294967295 FORMAT "%.15" SYMBOL_LINK "vmjYDVTHMhi2OcUQLt.zyJiOQHM2pK69CCuivCN._3_.duCJgEjudm3K" 0 /end MEASUREMENT
/begin MEASUREMENT MhlDrxnmrQpf.EgQph._2_.KcUrqCbWf "" ULONG NO_COMPU_METHOD 0 0 0 4294967295 FORMAT "%.15" SYMBOL_LINK "ucqVp2kVT8vP.pGSn6._2_.iic9toW3E" 0 /end MEASUREMENT
/begin MEASUREMENT MjznxefQgqoebzjmvq.SdnaQaykqAldiocwvqmb._3_ "" UBYTE NO_COMPU_METHOD 0 0 0 255 FORMAT "%.15" SYMBOL_LINK "vmjYDVTHMhi2OcUQLt.zyJiOQHM2pK69CCuivCN._3_" 0 /end MEASUREMENT
/begin MEASUREMENT MtsiewnXqntlihclcd.QthfCeagoSnhfxcyunkv._3_.Jnoyozqfbte "" ULONG NO_COMPU_METHOD 0 0 0 4294967295 FORMAT "%.15" SYMBOL_LINK "vmjYDVTHMhi2OcUQLt.zyJiOQHM2pK69CCuivCN._3_.ebe8Gnupse_" 0 /end MEASUREMENT
/begin MEASUREMENT NEYP.GyetbvcBpot._2_.PggqYmsysPqnkSaql "" UWORD NO_COMPU_METHOD 0 0 0 65535 FORMAT "%.15" SYMBOL_LINK "bXO2.zzeAbp8m0xW._2_.oE_owMRN9ccgqt2nS" 0 /end MEASUREMENT
/begin MEASUREMENT NaqGgzcfpGmh "" UBYTE NO_COMPU_METHOD 0 0 0 255 FORMAT "%.15" SYMBOL_LINK "ucqVp2kVT8vP" 0 /end MEASUREMENT
/begin MEASUREMENT NcjPnlogyQts.JbKgz._2_ "" UBYTE NO_COMPU_METHOD 0 0 0 255 FORMAT "%.15" SYMBOL_LINK "ucqVp2kVT8vP.pGSn6._2_" 0 /end MEASUREMENT
/begin MEASUREMENT NlqbyonvaweGtuvgtJyaEanu._7_ "" SWORD NO_COMPU_METHOD 0 0 -32768 32767 FORMAT "%.15" SYMBOL_LINK "sQJB0nKt7qfOqBjxAPd3YH6o._7_" 0 /end MEASUREMENT
/begin MEASUREMENT NmxKnsrsfRes.GfZqp._0_.JaZssOxWx "" ULONG NO_COMPU_METHOD 0 0 0 4294967295 FORMAT "%.15" SYMBOL_LINK "ucqVp2kVT8vP.pGSn6._0_.iic9toW3E" 0 /end MEASUREMENT
/begin MEASUREMENT NqtIroyeeCthswMaAsdRr3._2_ "" ULONG NO_COMPU_METHOD 0 0 0 4294967295 FORMAT "%.15" SYMBOL_LINK "jcSsLfLl04I5xjpf4ncFFQ._2_" 0 /end MEASUREMENT
/begin MEASUREMENT NumZoijgbIofscRnRbeTm0._9_ "" ULONG NO_COMPU_METHOD 0 0 0 4294967295 FORMAT "%.15" SYMBOL_LINK "pamWF71DPgJiy7ImPQoI7v._9_" 0 /end MEASUREMENT
/begin MEASUREMENT NxvTtexyeCsjqeQtKaoMs0._15_ "" ULONG NO_COMPU_METHOD 0 0 0 4294967295 FORMAT "%.15" SYMBOL_LINK "pamWF71DPgJiy7ImPQoI7v._15_" 0 /end MEASUREMENT
/begin MEASUREMENT NzaUoinzmNxpezBvCcnCb0._6_ "" ULONG NO_COMPU_METHOD 0 0 0 4294967295 FORMAT "%.15" SYMBOL_LINK "pamWF71DPgJiy7ImPQoI7v._6_" 0 /end MEASUREMENT
/begin MEASUREMENT OPCI.KvoogkuZnvn._5_ "" UBYTE NO_COMPU_METHOD 0 0 0 255 FORMAT "%.15" SYMBOL_LINK "bXO2.zzeAbp8m0xW._5_" 0 /end MEASUREMENT
/begin MEASUREMENT OWU_EUO.GGC_OLO_EseIgx46_Oudtzz_JgUX_EGY "" UBYTE RKR_KC_VVOYJDA 0 0 0 1 READ_WRITE DISPLAY_IDENTIFIER ZYJ_UES.EquAondjgaqItqkbiao.LSE_GUF_OjvVpu46_Lmakyy_QjCT_JAF SYMBOL_LINK "usdqXc5AbdJhCaNqyp8O5fkSY6vZS1OHmsb371VN8wVT" 0 /end MEASUREMENT
/begin MEASUREMENT OZRQ.NvkkoieCmlf._5_.Fzbe "" UWORD NO_COMPU_METHOD 0 0 0 65535 FORMAT "%.15" SYMBOL_LINK "bXO2.zzeAbp8m0xW._5_.mDJf" 0 /end MEASUREMENT
/begin MEASUREMENT OapTkhKoaVqbr._2_ "" UBYTE NO_COMPU_METHOD 0 0 0 255 FORMAT "%.15" SYMBOL_LINK "ztshvOz35bah7._2_" 0 /end MEASUREMENT
/begin MEASUREMENT OaxIosputEneoaKzOpkDj1._6_ "" ULONG NO_COMPU_METHOD 0 0 0 4294967295 FORMAT "%.15" SYMBOL_LINK "vqFnLEDpQg7iajNt97RSDy._6_" 0 /end MEASUREMENT
/begin MEASUREMENT ObqDsbqdjYevckDaKbhYg3._7_ "" ULONG NO_COMPU_METHOD 0 0 0 4294967295 FORMAT "%.15" SYMBOL_LINK "jcSsLfLl04I5xjpf4ncFFQ._7_" 0 /end MEASUREMENT
/begin MEASUREMENT OgqoexaZkgqbbykbnt.OfzoXgsvkEsbqupdbvgp._1_.CdubfkZiKsqp "" ULONG NO_COMPU_METHOD 0 0 0 4294967295 FORMAT "%.15" SYMBOL_LINK "vmjYDVTHMhi2OcUQLt.zyJiOQHM2pK69CCuivCN._1_.duCJgEjudm3K" 0 /end MEASUREMENT
/begin MEASUREMENT OkmCwnicoPapdvIqKivMt3._15_ "" ULONG NO_COMPU_METHOD 0 0 0 4294967295 FORMAT "%.15" SYMBOL_LINK "jcSsLfLl04I5xjpf4ncFFQ._15_" 0 /end MEASUREMENT
/begin MEASUREMENT OqrbzxadiioWalpvaCyfJlfq._8_ "" SWORD NO_COMPU_METHOD 0 0 -32768 32767 FORMAT "%.15" SYMBOL_LINK "sQJB0nKt7qfOqBjxAPd3YH6o._8_" 0 /end MEASUREMENT
/begin MEASUREMENT OqrnlucfffoVifbcfDvcbvofijagLgk1._0_ "" SWORD NO_COMPU_METHOD 0 0 -32768 32767 FORMAT "%.15" SYMBOL_LINK "taRmjUxOnU8v22ODIoiy_9tw80CX5KRX._0_" 0 /end MEASUREMENT
/begin MEASUREMENT PET_YIUI_SVR.HKN_OOOBjljcmdscMsim_OwiofrHrej.FOE_NYHItyebyrryNenv "" UBYTE VGL_LK_CPNR_KFR_FAPV_JSC.ZDH_XYJJpvpvhjgtIrbs_MutuaxPoyb.TIO_IZFLcdhepdgqSjoj 0 0 0 6 DISPLAY_IDENTIFIER QZY_LSOU_PBI.ZgrsDgqhswsObtta.ZHQ_UPWVuovocwbeIqop_VyytzpWoky.LEK_LYTXvdmnskkkJqyr SYMBOL_LINK "eiEO1R7qbiasLCVF8M_9lIkJtrz_VWbup5inUr7Dw1DBT1xVCxeaVe45oYaXUzJnXzbSkf38w1gZSeOLWZ8" 0 /end MEASUREMENT
/begin MEASUREMENT PFHZ.ZcmgrmqVetn._5_.BW "" SLONG rGgcRjbxlgTY_s 0 0 -2147483648 2147483647 FORMAT "%.15" SYMBOL_LINK "bXO2.zzeAbp8m0xW._5_.g9" 0 /end MEASUREMENT
/begin MEASUREMENT PLPT.DzqqdhyTdfg._3_.Qtkm "" UWORD NO_COMPU_METHOD 0 0 0 65535 FORMAT "%.15" SYMBOL_LINK "bXO2.zzeAbp8m0xW._3_.mDJf" 0 /end MEASUREMENT
/begin MEASUREMENT PPFN.GiispcuUkos._1_.NspqZzmtwBaylBtzy "" UWORD NO_COMPU_METHOD 0 0 0 65535 FORMAT "%.15" SYMBOL_LINK "bXO2.zzeAbp8m0xW._1_.oE_owMRN9ccgqt2nS" 0 /end MEASUREMENT
/begin MEASUREMENT PQJB.IxuacpbGcmn._2_.Lozuifhpb "" ULONG NO_COMPU_METHOD 0 0 0 4294967295 FORMAT "%.15" SYMBOL_LINK "bXO2.zzeAbp8m0xW._2_.p8B44mShg" 0 /end MEASUREMENT
/begin MEASUREMENT PplFovgpmXym.KxCnq._1_.VmQvyTcLg "" ULONG NO_COMPU_METHOD 0 0 0 4294967295 FORMAT "%.15" SYMBOL_LINK "ucqVp2kVT8vP.pGSn6._1_.iic9toW3E" 0 /end MEASUREMENT
/begin MEASUREMENT PpsEwrcguPml.WuDjm._3_.QuRdcFjRz "" ULONG NO_COMPU_METHOD 0 0 0 4294967295 FORMAT "%.15" SYMBOL_LINK "ucqVp2kVT8vP.pGSn6._3_.iic9toW3E" 0 /end MEASUREMENT
/begin MEASUREMENT PspdhbrytgnWxpmqoCyrZphr._14_ "" SWORD NO_COMPU_METHOD 0 0 -32768 32767 FORMAT "%.15" SYMBOL_LINK "sQJB0nKt7qfOqBjxAPd3YH6o._14_" 0 /end MEASUREMENT
/begin MEASUREMENT PyknrelGjjhsitqiml.UgyyRnfonEpgegqvpnvs._4_.CbahdtjzYdjjx "" ULONG NO_COMPU_METHOD 0 0 0 4294967295 FORMAT "%.15" SYMBOL_LINK "vmjYDVTHMhi2OcUQLt.zyJiOQHM2pK69CCuivCN._4_.bSlbgNigYORIt" 0 /end MEASUREMENT
/begin MEASUREMENT QJVB.VwmguwpVmhk._4_.Mzio "" UWORD NO_COMPU_METHOD 0 0 0 65535 FORMAT "%.15" SYMBOL_LINK "bXO2.zzeAbp8m0xW._4_.mDJf" 0 /end MEASUREMENT
/begin MEASUREMENT Q_YKXS_U_A4_Lbjw_Imerv "" FLOAT32_IEEE NO_COMPU_METHOD 0 0 -3.40282346639e38 3.40282346639e38 FORMAT "%.15" SYMBOL_LINK "yCoExSV5866Pgvtjc0uoke" 0 /end MEASUREMENT
/begin MEASUREMENT QbhGzbqvbOsn.jpgSyGt "" UBYTE NO_COMPU_METHOD 0 0 0 255 FORMAT "%.15" SYMBOL_LINK "ucqVp2kVT8vP.w7VhV3U" 0 /end MEASUREMENT
/begin MEASUREMENT QbiksvfPxomrzpdclj.IvmwRglehIgkixbhhlvm._2_.PmuxraadCcmbp "" ULONG NO_COMPU_METHOD 0 0 0 4294967295 FORMAT "%.15" SYMBOL_LINK "vmjYDVTHMhi2OcUQLt.zyJiOQHM2pK69CCuivCN._2_.uJmn8A145vnuR" 0 /end MEASUREMENT
/begin MEASUREMENT QctQ.Ypytzq_HA_JCH_ALMAvfx_30_UclabbTxpj.JDJ_ZREYvtv "" UBYTE JUS_LF_EUWA_OcgN.Exzmja_UQ_ZLN_FSRCjcu_30_ZknbwbCxmi.CKF_VFSLcwp 0 0 0 4 DISPLAY_IDENTIFIER GnrT.KwaiOwirlgkMpbdy.Azpqmz_AN_LIU_VYVLvwk_30_AasmzuYoqu.TVC_WNAAazq SYMBOL_LINK "pvfNm5Zy1hkTzwRyMny3j1z5Oh9ZsIu3atzrwVgiYIcySyfwEdujEAtwX690Z5uaZwXn" 0 /end MEASUREMENT
/begin MEASUREMENT QhdoxnkOgmhcdokpnj.SpvrLfmzeGpsrveqonkd._2_.MoxXbOvoyoul "" ULONG NO_COMPU_METHOD 0 0 0 4294967295 FORMAT "%.15" SYMBOL_LINK "vmjYDVTHMhi2OcUQLt.zyJiOQHM2pK69CCuivCN._2_.eWOTX7RirtOU" 0 /end MEASUREMENT
/begin MEASUREMENT QqanpnpbbygQawehgRmtspyzrocrAqi1._10_ "" SWORD NO_COMPU_METHOD 0 0 -32768 32767 FORMAT "%.15" SYMBOL_LINK "taRmjUxOnU8v22ODIoiy_9tw80CX5KRX._10_" 0 /end MEASUREMENT
/begin MEASUREMENT Qrp1_RygFwgcz "" ULONG NO_COMPU_METHOD 0 0 0 4294967295 FORMAT "%.15" SYMBOL_LINK "swE8etLoy9yQZ" 0 /end MEASUREMENT
/begin MEASUREMENT QrwnqqpOcxxrjmffph.AbwuXbzbrOrogbgoirql._1_.QygmdediDfulw "" ULONG NO_COMPU_METHOD 0 0 0 4294967295 FORMAT "%.15" SYMBOL_LINK "vmjYDVTHMhi2OcUQLt.zyJiOQHM2pK69CCuivCN._1_.uJmn8A145vnuR" 0 /end MEASUREMENT
/begin MEASUREMENT QtxHqytzbSjvjuOqTgjCn1._3_ "" ULONG NO_COMPU_METHOD 0 0 0 4294967295 FORMAT "%.15" SYMBOL_LINK "vqFnLEDpQg7iajNt97RSDy._3_" 0 /end MEASUREMENT
/begin MEASUREMENT QypknczlrxlKofmuwBjaFhii._6_ "" SWORD NO_COMPU_METHOD 0 0 -32768 32767 FORMAT "%.15" SYMBOL_LINK "sQJB0nKt7qfOqBjxAPd3YH6o._6_" 0 /end MEASUREMENT
/begin MEASUREMENT QzwfkwcBzckqrejmia.TqyvAsrjxAktqpkhgmhp._2_.Djzflgkhudf "" ULONG NO_COMPU_METHOD 0 0 0 4294967295 FORMAT "%.15" SYMBOL_LINK "vmjYDVTHMhi2OcUQLt.zyJiOQHM2pK69CCuivCN._2_.ebe8Gnupse_" 0 /end MEASUREMENT
/begin MEASUREMENT R_VESD_O_O15_Exaj_Dyfhk "" FLOAT32_IEEE NO_COMPU_METHOD 0 0 -3.40282346639e38 3.40282346639e38 FORMAT "%.15" SYMBOL_LINK "qb9qnerzHDuCM1hW20dLJVg" 0 /end MEASUREMENT
/begin MEASUREMENT RmrheilxadwSypqtjVqgitpxkzikUdb1._5_ "" SWORD NO_COMPU_METHOD 0 0 -32768 32767 FORMAT "%.15" SYMBOL_LINK "taRmjUxOnU8v22ODIoiy_9tw80CX5KRX._5_" 0 /end MEASUREMENT
/begin MEASUREMENT RsjzuavVvddkpioebc.RihxCtcyxUahjvvwxgki._1_.YopJoBafk "" ULONG NO_COMPU_METHOD 0 0 0 4294967295 FORMAT "%.15" SYMBOL_LINK "vmjYDVTHMhi2OcUQLt.zyJiOQHM2pK69CCuivCN._1_.gldc1iVZ2" 0 /end MEASUREMENT
/begin MEASUREMENT RtqjpbbWokzeluccwo.KkuhBwxeoXqqkzczfhhb._1_.Gltjebtcqvx "" ULONG NO_COMPU_METHOD 0 0 0 4294967295 FORMAT "%.15" SYMBOL_LINK "vmjYDVTHMhi2OcUQLt.zyJiOQHM2pK69CCuivCN._1_.ebe8Gnupse_" 0 /end MEASUREMENT
/begin MEASUREMENT RyaufaiOklitexgbsl.AxxhUmbevSbdvwalymxf._1_.ScoolhFkKwvqqtr "" ULONG NO_COMPU_METHOD 0 0 0 4294967295 FORMAT "%.15" SYMBOL_LINK "vmjYDVTHMhi2OcUQLt.zyJiOQHM2pK69CCuivCN._1_.wPU85yJxgnN5yxM" 0 /end MEASUREMENT
/begin MEASUREMENT SMYD.NvhcovyDaym._0_ "" UBYTE NO_COMPU_METHOD 0 0 0 255 FORMAT "%.15" SYMBOL_LINK "bXO2.zzeAbp8m0xW._0_" 0 /end MEASUREMENT
/begin MEASUREMENT S_ZZHY_H_R3_Nayq_Hmofo "" FLOAT32_IEEE NO_COMPU_METHOD 0 0 -3.40282346639e38 3.40282346639e38 FORMAT "%.15" SYMBOL_LINK "jFZweATWAOBXN4xNLKIZg5" 0 /end MEASUREMENT
/begin MEASUREMENT SjzhhxjArdjxzklggh.VjxaFasoiBvvdldsgjbx._3_.LtexnkapTmmog "" ULONG NO_COMPU_METHOD 0 0 0 4294967295 FORMAT "%.15" SYMBOL_LINK "vmjYDVTHMhi2OcUQLt.zyJiOQHM2pK69CCuivCN._3_.uJmn8A145vnuR" 0 /end MEASUREMENT
/begin MEASUREMENT SnwormdsqrnUtvjzeZwetgiketwdMlp1._2_ "" SWORD NO_COMPU_METHOD 0 0 -32768 32767 FORMAT "%.15" SYMBOL_LINK "taRmjUxOnU8v22ODIoiy_9tw80CX5KRX._2_" 0 /end MEASUREMENT
/begin MEASUREMENT SqaworvwbygDpmiizOolxzgumwdlLcr1._9_ "" SWORD NO_COMPU_METHOD 0 0 -32768 32767 FORMAT "%.15" SYMBOL_LINK "taRmjUxOnU8v22ODIoiy_9tw80CX5KRX._9_" 0 /end MEASUREMENT
/begin MEASUREMENT StlLvrfpdSrwxsIhFfzOr1._4_ "" ULONG NO_COMPU_METHOD 0 0 0 4294967295 FORMAT "%.15" SYMBOL_LINK "vqFnLEDpQg7iajNt97RSDy._4_" 0 /end MEASUREMENT
/begin MEASUREMENT SuivchkdmegCmalxxErhLijc._10_ "" SWORD NO_COMPU_METHOD 0 0 -32768 32767 FORMAT "%.15" SYMBOL_LINK "sQJB0nKt7qfOqBjxAPd3YH6o._10_" 0 /end MEASUREMENT
/begin MEASUREMENT SxxAhtbxuKvoyyGdCeoKg3._8_ "" ULONG NO_COMPU_METHOD 0 0 0 4294967295 FORMAT "%.15" SYMBOL_LINK "jcSsLfLl04I5xjpf4ncFFQ._8_" 0 /end MEASUREMENT
/begin MEASUREMENT TEW_IKG.FZK_GLI_MzmccnqDzmmJeybgo_205_GSC "" UBYTE NO_COMPU_METHOD 0 0 0 255 READ_WRITE DISPLAY_IDENTIFIER IUY_TOL.YmlDuodizjnFuflagmj.CUX_EER_TwksigiRuibTfpjsx_205_YBE MATRIX_DIM 112 1 1 SYMBOL_LINK "wlfMFIiboeckSeQfixohKEAS8XaXAIc9Q4loABRSRa8jd" 0 /end MEASUREMENT
/begin MEASUREMENT TFJY.NucgJkgqf "" ULONG NO_COMPU_METHOD 0 0 0 4294967295 FORMAT "%.15" SYMBOL_LINK "bXO2.qzfg86Dsl" 0 /end MEASUREMENT
/begin MEASUREMENT TTRJ.WsxqjcmLlmu._1_.LM "" SLONG rGgcRjbxlgTY_s 0 0 -2147483648 2147483647 FORMAT "%.15" SYMBOL_LINK "bXO2.zzeAbp8m0xW._1_.g9" 0 /end MEASUREMENT
/begin MEASUREMENT TVQ_GTF.ICW_BGY_HzmLxjRswu_Rtqltj_LnIE_DJV "" UBYTE RKR_KC_VVOYJDA 0 0 0 1 READ_WRITE DISPLAY_IDENTIFIER CKD_OXG.GktPdxfoprqKsdvmdna.ZXD_NOL_JjjBfcLitr_Coucyq_XjBZ_TLH SYMBOL_LINK "qA75tT6nHYpS_bhVkXu7zUar02pH8_UrH5NwCDj7z1LkoB" 0 /end MEASUREMENT
/begin MEASUREMENT TYNF.GqjicutWdky._4_.Uwgpoz "" UWORD NO_COMPU_METHOD 0 0 0 65535 FORMAT "%.15" SYMBOL_LINK "bXO2.zzeAbp8m0xW._4_.zAIyZl" 0 /end MEASUREMENT
/begin MEASUREMENT TbaUouldfCbuksFzTasKb0._5_ "" ULONG NO_COMPU_METHOD 0 0 0 4294967295 FORMAT "%.15" SYMBOL_LINK "pamWF71DPgJiy7ImPQoI7v._5_" 0 /end MEASUREMENT
/begin MEASUREMENT Tbx_YbMbi._0_ "" UBYTE NO_COMPU_METHOD 0 0 0 255 FORMAT "%.15" SYMBOL_LINK "dydGeiHlf._0_" 0 /end MEASUREMENT
/begin MEASUREMENT ThbCwlmsdCie.QxJvi._2_.RzQjrUkVo "" ULONG NO_COMPU_METHOD 0 0 0 4294967295 FORMAT "%.15" SYMBOL_LINK "ucqVp2kVT8vP.pGSn6._2_.olY72huBW" 0 /end MEASUREMENT
/begin MEASUREMENT TkwPmctktZbdhmFjDeeIn1._9_ "" ULONG NO_COMPU_METHOD 0 0 0 4294967295 FORMAT "%.15" SYMBOL_LINK "vqFnLEDpQg7iajNt97RSDy._9_" 0 /end MEASUREMENT
/begin MEASUREMENT TptgnpeKgqkcchgdkr.PkswYrxoqZyoluwrlrje._0_.AugdiDhomqk "" UBYTE NO_COMPU_METHOD 0 0 0 255 FORMAT "%.15" SYMBOL_LINK "vmjYDVTHMhi2OcUQLt.zyJiOQHM2pK69CCuivCN._0_.oh1L7w9xkXh" 0 /end MEASUREMENT
/begin MEASUREMENT UDK_VKX.KJA_TKH_XbeUzo14_Netybn_XfTY_BRQ "" UBYTE RKR_KC_VVOYJDA 0 0 0 1 READ_WRITE DISPLAY_IDENTIFIER SEV_PLI.XyiGbogeufySqogjtrq.JJB_KJC_GsrOft14_Ilhevm_TmMW_ZBP SYMBOL_LINK "e0mWJvluiAcIrWTvInNgxSssQBj3CZci10fJEzaRnWmx" 0 /end MEASUREMENT
/begin MEASUREMENT UDZV.MtsxuesKfrk._0_.Esqreqgau "" ULONG NO_COMPU_METHOD 0 0 0 4294967295 FORMAT "%.15" SYMBOL_LINK "bXO2.zzeAbp8m0xW._0_.p8B44mShg" 0 /end MEASUREMENT
/begin MEASUREMENT UWDD.GymhrodJwzh._1_.Kxopryppk "" ULONG NO_COMPU_METHOD 0 0 0 4294967295 FORMAT "%.15" SYMBOL_LINK "bXO2.zzeAbp8m0xW._1_.p8B44mShg" 0 /end MEASUREMENT
/begin MEASUREMENT Uek0_UqrFurws "" ULONG NO_COMPU_METHOD 0 0 0 4294967295 FORMAT "%.15" SYMBOL_LINK "z_gRtcskobDsN" 0 /end MEASUREMENT
/begin MEASUREMENT UjeHatxtxGau.MzCkz._3_ "" UBYTE NO_COMPU_METHOD 0 0 0 255 FORMAT "%.15" SYMBOL_LINK "ucqVp2kVT8vP.pGSn6._3_" 0 /end MEASUREMENT
/begin MEASUREMENT UlfTprpigKfl.VmGmk._0_ "" UBYTE NO_COMPU_METHOD 0 0 0 255 FORMAT "%.15" SYMBOL_LINK "ucqVp2kVT8vP.pGSn6._0_" 0 /end MEASUREMENT
/begin MEASUREMENT UmctisgShlxcyzoivv.QxmuLztsuLxouvjutgpk._0_.NiyFiKvhrtud "" ULONG NO_COMPU_METHOD 0 0 0 4294967295 FORMAT "%.15" SYMBOL_LINK "vmjYDVTHMhi2OcUQLt.zyJiOQHM2pK69CCuivCN._0_.eWOTX7RirtOU" 0 /end MEASUREMENT
/begin MEASUREMENT UsanhfwRrjjmckmwsj.GvqkQkivhFonebasynqm._1_ "" UBYTE NO_COMPU_METHOD 0 0 0 255 FORMAT "%.15" SYMBOL_LINK "vmjYDVTHMhi2OcUQLt.zyJiOQHM2pK69CCuivCN._1_" 0 /end MEASUREMENT
/begin MEASUREMENT UtyIpmahzLxzyoRyArmDk1._8_ "" ULONG NO_COMPU_METHOD 0 0 0 4294967295 FORMAT "%.15" SYMBOL_LINK "vqFnLEDpQg7iajNt97RSDy._8_" 0 /end MEASUREMENT
/begin MEASUREMENT UvdHpgryaPgmyyWqUtsEu3._14_ "" ULONG NO_COMPU_METHOD 0 0 0 4294967295 FORMAT "%.15" SYMBOL_LINK "jcSsLfLl04I5xjpf4ncFFQ._14_" 0 /end MEASUREMENT
/begin MEASUREMENT UzfJfyurfXtupyQkLruZu1 "" UBYTE NO_COMPU_METHOD 0 0 0 255 FORMAT "%.15" SYMBOL_LINK "vqFnLEDpQg7iajNt97RSDy" 0 /end MEASUREMENT
/begin MEASUREMENT VIV_AJOL_GYK.XWU_OSWD_HZR_Djgl_WpoQwwbgne_QnRqic_WER "" UWORD NO_COMPU_METHOD 0 0 0 65535 READ_WRITE DISPLAY_IDENTIFIER HOI_BXVK_ADC.BcwHhmabogsQfqbvzir.LKU_UHMX_UQG_Zgbv_FmdLuwujla_NbPcbn_JGT SYMBOL_LINK "d1If02mKYOLOyTA2UFOTESfaXAX4KUQmK0EMmavRdlPRePLBRlaTUb2N" 0 /end MEASUREMENT
/begin MEASUREMENT VhauyjyTsixgydfspy.LjcyGogugMzazofasyyi._2_.YayjsQyuevq "" UBYTE NO_COMPU_METHOD 0 0 0 255 FORMAT "%.15" SYMBOL_LINK "vmjYDVTHMhi2OcUQLt.zyJiOQHM2pK69CCuivCN._2_.oh1L7w9xkXh" 0 /end MEASUREMENT
/begin MEASUREMENT VhljoxybnjuRjbwtbItqLsqg "" UBYTE NO_COMPU_METHOD 0 0 0 255 FORMAT "%.15" SYMBOL_LINK "sQJB0nKt7qfOqBjxAPd3YH6o" 0 /end MEASUREMENT
/begin MEASUREMENT VixShzkanPocqbYsQayHg0._8_ "" ULONG NO_COMPU_METHOD 0 0 0 4294967295 FORMAT "%.15" SYMBOL_LINK "pamWF71DPgJiy7ImPQoI7v._8_" 0 /end MEASUREMENT
/begin MEASUREMENT VkkuxawRzqcmksxlol.KvsrHecgfCvisjgraldy._2_.GieCgMglhqedo "" UBYTE NO_COMPU_METHOD 0 0 0 255 FORMAT "%.15" SYMBOL_LINK "vmjYDVTHMhi2OcUQLt.zyJiOQHM2pK69CCuivCN._2_.m3ZNBBIStFMH5" 0 /end MEASUREMENT
/begin MEASUREMENT VouZozsseKbvgfOgChoEm0._14_ "" ULONG NO_COMPU_METHOD 0 0 0 4294967295 FORMAT "%.15" SYMBOL_LINK "pamWF71DPgJiy7ImPQoI7v._14_" 0 /end MEASUREMENT
/begin MEASUREMENT WGBZ.LecbjpxgBugxVntmt "" ULONG NO_COMPU_METHOD 0 0 0 4294967295 FORMAT "%.15" SYMBOL_LINK "bXO2.bp63IPbWHzVcIF8V8" 0 /end MEASUREMENT
/begin MEASUREMENT WIR_TNH.TFB_ULL_GyfWdidh_Fbt_IPT.PTQ_WQT_LqpSgjzp_HvhoNcdem "" UBYTE NO_COMPU_METHOD 0 0 0 255 READ_WRITE DISPLAY_IDENTIFIER FPF_ZYJ.EciDzfcfrdxHzfuqsuz.MEM_YJE_SfjMquon_Kkv_WLC.PWH_RAF_AueZqayt_BnhfQbeli MATRIX_DIM 5 1 1 SYMBOL_LINK "wlDU4qju6kRkNGNZqM39cxUD4Y64253cuDkE.wCatKMWTRkiUoK_Oje4hI1Zy4I" 0 /end MEASUREMENT
/begin MEASUREMENT WVTF.ZnlyprwJied._3_.QI "" SLONG rGgcRjbxlgTY_s 0 0 -2147483648 2147483647 FORMAT "%.15" SYMBOL_LINK "bXO2.zzeAbp8m0xW._3_.g9" 0 /end MEASUREMENT
/begin MEASUREMENT WdxstpitotcBehlheGuwKpvk._3_ "" SWORD NO_COMPU_METHOD 0 0 -32768 32767 FORMAT "%.15" SYMBOL_LINK "sQJB0nKt7qfOqBjxAPd3YH6o._3_" 0 /end MEASUREMENT
/begin MEASUREMENT WmtPrpopyHoivtGrCyjLm1._5_ "" ULONG NO_COMPU_METHOD 0 0 0 4294967295 FORMAT "%.15" SYMBOL_LINK "vqFnLEDpQg7iajNt97RSDy._5_" 0 /end MEASUREMENT
/begin MEASUREMENT WzrykwoadghVvonlaHqckyfoigjmEts1._8_ "" SWORD NO_COMPU_METHOD 0 0 -32768 32767 FORMAT "%.15" SYMBOL_LINK "taRmjUxOnU8v22ODIoiy_9tw80CX5KRX._8_" 0 /end MEASUREMENT
/begin MEASUREMENT XanvoekuposVaquffXjhIiau._11_ "" SWORD NO_COMPU_METHOD 0 0 -32768 32767 FORMAT "%.15" SYMBOL_LINK "sQJB0nKt7qfOqBjxAPd3YH6o._11_" 0 /end MEASUREMENT
/begin MEASUREMENT XnqwmsdXddvdrjtvph.NidiTipgiAnxrbavridy._0_.Ifhfhiarfet "" ULONG NO_COMPU_METHOD 0 0 0 4294967295 FORMAT "%.15" SYMBOL_LINK "vmjYDVTHMhi2OcUQLt.zyJiOQHM2pK69CCuivCN._0_.ebe8Gnupse_" 0 /end MEASUREMENT
/begin MEASUREMENT XqrVnvpbmUnggwMuWcqGa0._10_ "" ULONG NO_COMPU_METHOD 0 0 0 4294967295 FORMAT "%.15" SYMBOL_LINK "pamWF71DPgJiy7ImPQoI7v._10_" 0 /end MEASUREMENT
/begin MEASUREMENT XtvT.Umujgl_VG_IZI_WUSSuylpnzdgBhwe_FdfjxqSlnd.NBC_QQLIoldrhkhnDilk "" UBYTE JRQ_JJ_DBFM_MfqH.Cejibx_CT_GZD_WTLCeufjqqshBjtm_RrnhifYtsm.NZA_MZSQroxktjpjYldf 0 0 0 6 DISPLAY_IDENTIFIER AmqN.KhlzHnapuukKyfmr.Lercgs_JV_DZN_NYOYqhxmnptiHdgc_AvpxqfQdmq.NJL_UQYAhzgzafffVzss SYMBOL_LINK "eiEO1R7qbiasLCVF8M_9lIkJtrz_VWbup5inUr7Dw1DBT1xVCxeaVe45oYaXUzJnXzbSkf38w1gZSeOLWZ8" 0 /end MEASUREMENT
/begin MEASUREMENT XxeJvqGsdLzmz "" UBYTE NO_COMPU_METHOD 0 0 0 255 FORMAT "%.15" SYMBOL_LINK "ztshvOz35bah7" 0 /end MEASUREMENT
/begin MEASUREMENT YAXB.NwntopdCjon._4_ "" UBYTE NO_COMPU_METHOD 0 0 0 255 FORMAT "%.15" SYMBOL_LINK "bXO2.zzeAbp8m0xW._4_" 0 /end MEASUREMENT
/begin MEASUREMENT YBNW.SnhfaloRauc._4_.HpgjRjghdAphaWajz "" UWORD NO_COMPU_METHOD 0 0 0 65535 FORMAT "%.15" SYMBOL_LINK "bXO2.zzeAbp8m0xW._4_.oE_owMRN9ccgqt2nS" 0 /end MEASUREMENT
/begin MEASUREMENT YKJ_RXI.GID_ULI_DhokogesbmGieieqTawmth_NQC "" UBYTE NO_COMPU_METHOD 0 0 0 255 READ_WRITE DISPLAY_IDENTIFIER UYO_SDZ.FjzSpqpubwzFxxvqssu.YMW_JGR_XngpktpuavUhcvkkJmkeor_OZN MATRIX_DIM 16 1 1 SYMBOL_LINK "f28vu0OpyrSa1LTfM0nj2GNCEFBDLWGbKTB5lX0xzodJeL" 0 /end MEASUREMENT
/begin MEASUREMENT YLS_YGL.AYT_BCJ_SugcsRML_Ghe_UPA.JRD_EAA_RubxbUPU_Vll "" UWORD NO_COMPU_METHOD 0 0 0 65535 READ_WRITE DISPLAY_IDENTIFIER UKW_LNM.QqiVmrvvrmvDnhmwksu.GUK_NIW_HwctmSVV_Tpd_DAD.CWT_HPM_LipthDWP_Jsh SYMBOL_LINK "rUbpELP7DZmLiXB0LLwW9PnQJqd38Lysc2rc.ruEb2T6dmVfiTBD6ZwZN" 0 /end MEASUREMENT
/begin MEASUREMENT YOBB.SwefxcwEtik._4_.ER "" SLONG rGgcRjbxlgTY_s 0 0 -2147483648 2147483647 FORMAT "%.15" SYMBOL_LINK "bXO2.zzeAbp8m0xW._4_.g9" 0 /end MEASUREMENT
/begin MEASUREMENT YYRT.UyusnjcQtcf._2_.KM "" SLONG rGgcRjbxlgTY_s 0 0 -2147483648 2147483647 FORMAT "%.15" SYMBOL_LINK "bXO2.zzeAbp8m0xW._2_.g9" 0 /end MEASUREMENT
/begin MEASUREMENT Y_GQVU_B_U5_Hlms_Ycnql "" FLOAT32_IEEE NO_COMPU_METHOD 0 0 -3.40282346639e38 3.40282346639e38 FORMAT "%.15" SYMBOL_LINK "tQlvnTLVM7HcSmm_uJglBi" 0 /end MEASUREMENT
/begin MEASUREMENT YaufjdralegIreyejVryVrmi._0_ "" SWORD NO_COMPU_METHOD 0 0 -32768 32767 FORMAT "%.15" SYMBOL_LINK "sQJB0nKt7qfOqBjxAPd3YH6o._0_" 0 /end MEASUREMENT
/begin MEASUREMENT YfqFucdfsXdazcGnEavIw3 "" UBYTE NO_COMPU_METHOD 0 0 0 255 FORMAT "%.15" SYMBOL_LINK "jcSsLfLl04I5xjpf4ncFFQ" 0 /end MEASUREMENT
/begin MEASUREMENT YipftnrlckaIlptwjRxdvwtanssnUfg1._14_ "" SWORD NO_COMPU_METHOD 0 0 -32768 32767 FORMAT "%.15" SYMBOL_LINK "taRmjUxOnU8v22ODIoiy_9tw80CX5KRX._14_" 0 /end MEASUREMENT
/begin MEASUREMENT YpswcggTsndofaemtm.UgkxQjiboAarpcvqmqgs._3_.ZuvbgKdkwom "" UBYTE NO_COMPU_METHOD 0 0 0 255 FORMAT "%.15" SYMBOL_LINK "vmjYDVTHMhi2OcUQLt.zyJiOQHM2pK69CCuivCN._3_.oh1L7w9xkXh" 0 /end MEASUREMENT
/begin MEASUREMENT YsuurdxGrkzgszicfg.FfcyUhsioLcachpzyjwc._4_.QfmuewkkXwnpd "" ULONG NO_COMPU_METHOD 0 0 0 4294967295 FORMAT "%.15" SYMBOL_LINK "vmjYDVTHMhi2OcUQLt.zyJiOQHM2pK69CCuivCN._4_.uJmn8A145vnuR" 0 /end MEASUREMENT
/begin MEASUREMENT YtxhmhkpocsBmmrliIkbFtes._4_ "" SWORD NO_COMPU_METHOD 0 0 -32768 32767 FORMAT "%.15" SYMBOL_LINK "sQJB0nKt7qfOqBjxAPd3YH6o._4_" 0 /end MEASUREMENT
/begin MEASUREMENT ZZBO.FxlhbloHzet._3_.KsjeOcxjcJjxzUefc "" UWORD NO_COMPU_METHOD 0 0 0 65535 FORMAT "%.15" SYMBOL_LINK "bXO2.zzeAbp8m0xW._3_.oE_owMRN9ccgqt2nS" 0 /end MEASUREMENT
/begin MEASUREMENT ZZRU.DahnacbNjck._1_ "" UBYTE NO_COMPU_METHOD 0 0 0 255 FORMAT "%.15" SYMBOL_LINK "bXO2.zzeAbp8m0xW._1_" 0 /end MEASUREMENT
/begin MEASUREMENT ZcbhlcpOuccsgndfyf.CcccRkjkzChhexaepmon._3_.XwqQnGgrkfrf "" ULONG NO_COMPU_METHOD 0 0 0 4294967295 FORMAT "%.15" SYMBOL_LINK "vmjYDVTHMhi2OcUQLt.zyJiOQHM2pK69CCuivCN._3_.eWOTX7RirtOU" 0 /end MEASUREMENT
/begin MEASUREMENT ZddUrqfwhAtpgqYnBcgOw3._6_ "" ULONG NO_COMPU_METHOD 0 0 0 4294967295 FORMAT "%.15" SYMBOL_LINK "jcSsLfLl04I5xjpf4ncFFQ._6_" 0 /end MEASUREMENT
/begin MEASUREMENT ZhcNzupziNzwhzIgUrbNs1._10_ "" ULONG NO_COMPU_METHOD 0 0 0 4294967295 FORMAT "%.15" SYMBOL_LINK "vqFnLEDpQg7iajNt97RSDy._10_" 0 /end MEASUREMENT
/begin MEASUREMENT ZkiWpysjcObc.DoToc._1_.KvYmeOeXa "" ULONG NO_COMPU_METHOD 0 0 0 4294967295 FORMAT "%.15" SYMBOL_LINK "ucqVp2kVT8vP.pGSn6._1_.olY72huBW" 0 /end MEASUREMENT
/begin MEASUREMENT ZtacnqkYaupvavblcx.PqucDvrexYeybelbuvqk._2_.BclutmDjYmru "" ULONG NO_COMPU_METHOD 0 0 0 4294967295 FORMAT "%.15" SYMBOL_LINK "vmjYDVTHMhi2OcUQLt.zyJiOQHM2pK69CCuivCN._2_.duCJgEjudm3K" 0 /end MEASUREMENT
/begin MEASUREMENT ZysHpefpeJzwrsWqRbpWu3._4_ "" ULONG NO_COMPU_METHOD 0 0 0 4294967295 FORMAT "%.15" SYMBOL_LINK "jcSsLfLl04I5xjpf4ncFFQ._4_" 0 /end MEASUREMENT
/begin MEASUREMENT aBY1000.Ztwj.Bmno._4_ "" ULONG NO_COMPU_METHOD 0 0 0 4294967295 FORMAT "%.15" SYMBOL_LINK "p8spnOT.lJHM.mDJf._4_" 0 /end MEASUREMENT
/begin MEASUREMENT aQY1000.ZhirPirkMpl "" ULONG NO_COMPU_METHOD 0 0 0 4294967295 FORMAT "%.15" SYMBOL_LINK "p8spnOT.xwC8JoyeZA5" 0 /end MEASUREMENT
/begin MEASUREMENT aQvebk1uo.Kydie "" ULONG NO_COMPU_METHOD 0 0 0 4294967295 FORMAT "%.15" SYMBOL_LINK "eDiqfIdQh.aRypL" 0 /end MEASUREMENT
/begin MEASUREMENT aTsiQbogitpMv "" UBYTE NO_COMPU_METHOD 0 0 0 255 FORMAT "%.15" SYMBOL_LINK "cl_2aqcKS3DDT" 0 /end MEASUREMENT
/begin MEASUREMENT ah_wbzyund "" UBYTE NO_COMPU_METHOD 0 0 0 255 FORMAT "%.15" SYMBOL_LINK "gPVjwomiBv" 0 /end MEASUREMENT
/begin MEASUREMENT aod_ta_vfhu_xbkmo._2_ "" ULONG NO_COMPU_METHOD 0 0 0 4294967295 FORMAT "%.15" SYMBOL_LINK "r5lYYneJJtbhIIHuR._2_" 0 /end MEASUREMENT
/begin MEASUREMENT bBH1000.BfoaBlmdrst "" UWORD NO_COMPU_METHOD 0 0 0 65535 FORMAT "%.15" SYMBOL_LINK "p8spnOT.f5QEesyyho8" 0 /end MEASUREMENT
/begin MEASUREMENT bYI1000.UvosOhdtZacql "" ULONG NO_COMPU_METHOD 0 0 0 4294967295 FORMAT "%.15" SYMBOL_LINK "p8spnOT.vwFEG1CH_9r_E" 0 /end MEASUREMENT
/begin MEASUREMENT cAB1000.WpxyvYhcqlPv "" ULONG NO_COMPU_METHOD 0 0 0 4294967295 FORMAT "%.15" SYMBOL_LINK "p8spnOT.jNDdG9bqYBhk" 0 /end MEASUREMENT
/begin MEASUREMENT cMZ1000.AlibaCjdbqu "" UBYTE NO_COMPU_METHOD 0 0 0 255 FORMAT "%.15" SYMBOL_LINK "p8spnOT.ow_A7rWrFQ7" 0 /end MEASUREMENT
/begin MEASUREMENT cZE1000.RhqcjXowrFmxnvz "" UBYTE NO_COMPU_METHOD 0 0 0 255 FORMAT "%.15" SYMBOL_LINK "p8spnOT.k9q1aYdtF8Qp1BD" 0 /end MEASUREMENT
/begin MEASUREMENT cZF1000.Ihxe.Sdff._8_ "" ULONG NO_COMPU_METHOD 0 0 0 4294967295 FORMAT "%.15" SYMBOL_LINK "p8spnOT.lJHM.mDJf._8_" 0 /end MEASUREMENT
/begin MEASUREMENT cZwktdwRleqfm._1_.RdvzutQfklyyPlv "" UBYTE NO_COMPU_METHOD 0 0 0 255 FORMAT "%.15" SYMBOL_LINK "bwJqbXZs8I5_e._1_.cntucbHkGC_tJaM" 0 /end MEASUREMENT
/begin MEASUREMENT cdk_oi_fwwk_ummqk._5_ "" ULONG NO_COMPU_METHOD 0 0 0 4294967295 FORMAT "%.15" SYMBOL_LINK "r5lYYneJJtbhIIHuR._5_" 0 /end MEASUREMENT
/begin MEASUREMENT cmv_pnm_hhpv_whwjc._5_ "" ULONG NO_COMPU_METHOD 0 0 0 4294967295 FORMAT "%.15" SYMBOL_LINK "actS67I8guVZGfn_02._5_" 0 /end MEASUREMENT
/begin MEASUREMENT cxtp_eztrs "" UBYTE NO_COMPU_METHOD 0 0 0 255 FORMAT "%.15" SYMBOL_LINK "fSMp42TUQu" 0 /end MEASUREMENT
/begin MEASUREMENT dPV1000.XwmObxQzgx "" ULONG NO_COMPU_METHOD 0 0 0 4294967295 FORMAT "%.15" SYMBOL_LINK "p8spnOT.e55mfuYNjM" 0 /end MEASUREMENT
/begin MEASUREMENT dPgmGwyidOmlt "" UBYTE NO_COMPU_METHOD 0 0 0 255 FORMAT "%.15" SYMBOL_LINK "qwf25zyjgp3hb" 0 /end MEASUREMENT
/begin MEASUREMENT dQboVllyrXmlo_1 "" UBYTE NO_COMPU_METHOD 0 0 0 255 FORMAT "%.15" SYMBOL_LINK "zxMuwAA4rF5wegy" 0 /end MEASUREMENT
/begin MEASUREMENT dQndRnhjgJkkw_2._1_ "" UBYTE NO_COMPU_METHOD 0 0 0 255 FORMAT "%.15" SYMBOL_LINK "qKOUi2lvN5D_9MW._1_" 0 /end MEASUREMENT
/begin MEASUREMENT dRQ1000.VjmJqc "" ULONG NO_COMPU_METHOD 0 0 0 4294967295 FORMAT "%.15" SYMBOL_LINK "p8spnOT.nKuyak" 0 /end MEASUREMENT
/begin MEASUREMENT dSF1000.CmuNqsilZtjlg "" ULONG NO_COMPU_METHOD 0 0 0 4294967295 FORMAT "%.15" SYMBOL_LINK "p8spnOT.vCs8uw7VzyJ3F" 0 /end MEASUREMENT
/begin MEASUREMENT dVruPdruaVivd "" UBYTE NO_COMPU_METHOD 0 0 0 255 FORMAT "%.15" SYMBOL_LINK "jYNtdJ00mTHhY" 0 /end MEASUREMENT
/begin MEASUREMENT dWQ1000.Zxzr.KndmxkWtek "" ULONG NO_COMPU_METHOD 0 0 0 4294967295 FORMAT "%.15" SYMBOL_LINK "p8spnOT.lJHM.fivsvp9bye" 0 /end MEASUREMENT
/begin MEASUREMENT eAK1000.Qukm.Fugf._9_ "" ULONG NO_COMPU_METHOD 0 0 0 4294967295 FORMAT "%.15" SYMBOL_LINK "p8spnOT.lJHM.mDJf._9_" 0 /end MEASUREMENT
/begin MEASUREMENT eCU1000.Acxb.VsuoHmavSowvg "" UBYTE NO_COMPU_METHOD 0 0 0 255 FORMAT "%.15" SYMBOL_LINK "p8spnOT.lJHM.tPI2zartXpqPi" 0 /end MEASUREMENT
/begin MEASUREMENT eDqcJzzdhTbai_0._2_ "" UBYTE NO_COMPU_METHOD 0 0 0 255 FORMAT "%.15" SYMBOL_LINK "qRP5kwhxcV1vGxh._2_" 0 /end MEASUREMENT
/begin MEASUREMENT eFowBjgjpBsru_2._0_ "" UBYTE NO_COMPU_METHOD 0 0 0 255 FORMAT "%.15" SYMBOL_LINK "qKOUi2lvN5D_9MW._0_" 0 /end MEASUREMENT
/begin MEASUREMENT eHulAvdxsKjhe_2._10_ "" UBYTE NO_COMPU_METHOD 0 0 0 255 FORMAT "%.15" SYMBOL_LINK "qKOUi2lvN5D_9MW._10_" 0 /end MEASUREMENT
/begin MEASUREMENT eJU1000.HbsyqQf "" ULONG NO_COMPU_METHOD 0 0 0 4294967295 FORMAT "%.15" SYMBOL_LINK "p8spnOT.wPXg5XE" 0 /end MEASUREMENT
/begin MEASUREMENT eKT1000.LqmiUou "" ULONG NO_COMPU_METHOD 0 0 0 4294967295 FORMAT "%.15" SYMBOL_LINK "p8spnOT.bgC3T87" 0 /end MEASUREMENT
/begin MEASUREMENT ePI1000.Gjud.Qsry._5_ "" ULONG NO_COMPU_METHOD 0 0 0 4294967295 FORMAT "%.15" SYMBOL_LINK "p8spnOT.lJHM.mDJf._5_" 0 /end MEASUREMENT
/begin MEASUREMENT eWR1000.Jvvkidp "" ULONG NO_COMPU_METHOD 0 0 0 4294967295 FORMAT "%.15" SYMBOL_LINK "p8spnOT.yKQDvtY" 0 /end MEASUREMENT
/begin MEASUREMENT eYH1000.Doko.Iqxk._7_ "" ULONG NO_COMPU_METHOD 0 0 0 4294967295 FORMAT "%.15" SYMBOL_LINK "p8spnOT.lJHM.mDJf._7_" 0 /end MEASUREMENT
/begin MEASUREMENT eYX1000.JajoNrfqvQpiiyy "" ULONG NO_COMPU_METHOD 0 0 0 4294967295 FORMAT "%.15" SYMBOL_LINK "p8spnOT.kZeOqcKcsEtjTFc" 0 /end MEASUREMENT
/begin MEASUREMENT eZbuccvIbnowx_Szlff.[0].OrqswuTtitcdRxe "" UBYTE iJljxrmFgqrau_Pemyp.[0].DnecteAofvjtZnk.QXGDFDBTQA 1 0 0 255 SYMBOL_LINK "puC3W_TqA1tW2wb8wEI._0_.cntucbHkGC_tJaM" 0 /end MEASUREMENT
/begin MEASUREMENT fAogBlxwiCvhxs._2_ "" UBYTE NO_COMPU_METHOD 0 0 0 255 FORMAT "%.15" SYMBOL_LINK "bGHyva5MwYi9ZG._2_" 0 /end MEASUREMENT
/begin MEASUREMENT fBcvDmvyeDhpi_0._8_ "" UBYTE NO_COMPU_METHOD 0 0 0 255 FORMAT "%.15" SYMBOL_LINK "qRP5kwhxcV1vGxh._8_" 0 /end MEASUREMENT
/begin MEASUREMENT fGW1000.XpghNokUgnowXyk "" ULONG NO_COMPU_METHOD 0 0 0 4294967295 FORMAT "%.15" SYMBOL_LINK "p8spnOT.lsl3pPJJsEepbJx" 0 /end MEASUREMENT
/begin MEASUREMENT fJN1000.XmlXzEtd "" ULONG NO_COMPU_METHOD 0 0 0 4294967295 FORMAT "%.15" SYMBOL_LINK "p8spnOT.xvdlPjcH" 0 /end MEASUREMENT
/begin MEASUREMENT fUsaikeZllgzk._1_.GlsZsxJhb "" UBYTE NO_COMPU_METHOD 0 0 0 255 FORMAT "%.15" SYMBOL_LINK "bwJqbXZs8I5_e._1_.ujftLuFGe" 0 /end MEASUREMENT
/begin MEASUREMENT fUywOageuNeexNzlryy "" UBYTE NO_COMPU_METHOD 0 0 0 255 FORMAT "%.15" SYMBOL_LINK "rIIQh9PaSrKF67GRd0i" 0 /end MEASUREMENT
/begin MEASUREMENT fWooHcbovEosa_0._4_ "" UBYTE NO_COMPU_METHOD 0 0 0 255 FORMAT "%.15" SYMBOL_LINK "qRP5kwhxcV1vGxh._4_" 0 /end MEASUREMENT
/begin MEASUREMENT fcj_xts_nuds_noqry._3_ "" ULONG NO_COMPU_METHOD 0 0 0 4294967295 FORMAT "%.15" SYMBOL_LINK "actS67I8guVZGfn_02._3_" 0 /end MEASUREMENT
/begin MEASUREMENT gEzlLwmcghkOg._3_ "" UBYTE NO_COMPU_METHOD 0 0 0 255 FORMAT "%.15" SYMBOL_LINK "cl_2aqcKS3DDT._3_" 0 /end MEASUREMENT
/begin MEASUREMENT gIQ1000.Xloy.Sad2 "" ULONG NO_COMPU_METHOD 0 0 0 4294967295 FORMAT "%.15" SYMBOL_LINK "p8spnOT.lJHM.pFia" 0 /end MEASUREMENT
/begin MEASUREMENT gIaeGjvmoQgko_2._4_ "" UBYTE NO_COMPU_METHOD 0 0 0 255 FORMAT "%.15" SYMBOL_LINK "qKOUi2lvN5D_9MW._4_" 0 /end MEASUREMENT
/begin MEASUREMENT gLlrMvnltNmunwniiy._0_ "" UBYTE NO_COMPU_METHOD 0 0 0 255 FORMAT "%.15" SYMBOL_LINK "uaEcDEYfgOava5tZyG._0_" 0 /end MEASUREMENT
/begin MEASUREMENT gOdsWwxetXqchtzbit "" UBYTE NO_COMPU_METHOD 0 0 0 255 FORMAT "%.15" SYMBOL_LINK "uaEcDEYfgOava5tZyG" 0 /end MEASUREMENT
/begin MEASUREMENT glc_riy_zmqe_qcpsr._6_ "" ULONG NO_COMPU_METHOD 0 0 0 4294967295 FORMAT "%.15" SYMBOL_LINK "actS67I8guVZGfn_02._6_" 0 /end MEASUREMENT
/begin MEASUREMENT hCT1000.Dyml.Nwee._0_ "" ULONG NO_COMPU_METHOD 0 0 0 4294967295 FORMAT "%.15" SYMBOL_LINK "p8spnOT.lJHM.mDJf._0_" 0 /end MEASUREMENT
/begin MEASUREMENT hRpjXnxcePlcg_1._4_ "" UBYTE NO_COMPU_METHOD 0 0 0 255 FORMAT "%.15" SYMBOL_LINK "zxMuwAA4rF5wegy._4_" 0 /end MEASUREMENT
/begin MEASUREMENT hTfeIqsnnEwsf_2._6_ "" UBYTE NO_COMPU_METHOD 0 0 0 255 FORMAT "%.15" SYMBOL_LINK "qKOUi2lvN5D_9MW._6_" 0 /end MEASUREMENT
/begin MEASUREMENT hVY1000.Bskn.Faup._11_ "" ULONG NO_COMPU_METHOD 0 0 0 4294967295 FORMAT "%.15" SYMBOL_LINK "p8spnOT.lJHM.mDJf._11_" 0 /end MEASUREMENT
/begin MEASUREMENT hWV1000.Otbi.Ymzi._3_ "" ULONG NO_COMPU_METHOD 0 0 0 4294967295 FORMAT "%.15" SYMBOL_LINK "p8spnOT.lJHM.mDJf._3_" 0 /end MEASUREMENT
/begin MEASUREMENT hrmbrfm "" UBYTE NO_COMPU_METHOD 0 0 0 255 FORMAT "%.15" SYMBOL_LINK "iVXkKN4" 0 /end MEASUREMENT
/begin MEASUREMENT hxp_gjf_lqcl_ploin._4_ "" ULONG NO_COMPU_METHOD 0 0 0 4294967295 FORMAT "%.15" SYMBOL_LINK "actS67I8guVZGfn_02._4_" 0 /end MEASUREMENT
/begin MEASUREMENT iCnhBvfzmGoki_2._2_ "" UBYTE NO_COMPU_METHOD 0 0 0 255 FORMAT "%.15" SYMBOL_LINK "qKOUi2lvN5D_9MW._2_" 0 /end MEASUREMENT
/begin MEASUREMENT iHldupgIngfdf._0_.JgyMfpGwy "" UBYTE NO_COMPU_METHOD 0 0 0 255 FORMAT "%.15" SYMBOL_LINK "bwJqbXZs8I5_e._0_.ujftLuFGe" 0 /end MEASUREMENT
/begin MEASUREMENT iOlaDyhxtKusg_1._8_ "" UBYTE NO_COMPU_METHOD 0 0 0 255 FORMAT "%.15" SYMBOL_LINK "zxMuwAA4rF5wegy._8_" 0 /end MEASUREMENT
/begin MEASUREMENT iSsryjxQuxdqf_Biefd._1_.WmcUdvoGekjmJtLaknq "" UBYTE NO_COMPU_METHOD 0 0 0 255 FORMAT "%.15" SYMBOL_LINK "puC3W_TqA1tW2wb8wEI._1_.mKCOyyNbd_xA13U87wn" 0 /end MEASUREMENT
/begin MEASUREMENT ioi_sm_lkom_uovuj._1_ "" ULONG NO_COMPU_METHOD 0 0 0 4294967295 FORMAT "%.15" SYMBOL_LINK "r5lYYneJJtbhIIHuR._1_" 0 /end MEASUREMENT
/begin MEASUREMENT jDjgLifjwJlnsWsyhjg._2_ "" UBYTE NO_COMPU_METHOD 0 0 0 255 FORMAT "%.15" SYMBOL_LINK "rIIQh9PaSrKF67GRd0i._2_" 0 /end MEASUREMENT
/begin MEASUREMENT jFL1000 "" UBYTE NO_COMPU_METHOD 0 0 0 255 FORMAT "%.15" SYMBOL_LINK "p8spnOT" 0 /end MEASUREMENT
/begin MEASUREMENT jLgnUkaycRbtj_1._1_ "" UBYTE NO_COMPU_METHOD 0 0 0 255 FORMAT "%.15" SYMBOL_LINK "zxMuwAA4rF5wegy._1_" 0 /end MEASUREMENT
/begin MEASUREMENT jPlvCfqnnMcvh_1._9_ "" UBYTE NO_COMPU_METHOD 0 0 0 255 FORMAT "%.15" SYMBOL_LINK "zxMuwAA4rF5wegy._9_" 0 /end MEASUREMENT
/begin MEASUREMENT jkt_qt_ztnh_gqmej._4_ "" ULONG NO_COMPU_METHOD 0 0 0 4294967295 FORMAT "%.15" SYMBOL_LINK "r5lYYneJJtbhIIHuR._4_" 0 /end MEASUREMENT
/begin MEASUREMENT kGwqYvxboCbrs_0._6_ "" UBYTE NO_COMPU_METHOD 0 0 0 255 FORMAT "%.15" SYMBOL_LINK "qRP5kwhxcV1vGxh._6_" 0 /end MEASUREMENT
/begin MEASUREMENT kIH1000.QhgXlSek "" ULONG NO_COMPU_METHOD 0 0 0 4294967295 FORMAT "%.15" SYMBOL_LINK "p8spnOT.nt_D9jNj" 0 /end MEASUREMENT
/begin MEASUREMENT kKyrWdbdjJtqq_1._5_ "" UBYTE NO_COMPU_METHOD 0 0 0 255 FORMAT "%.15" SYMBOL_LINK "zxMuwAA4rF5wegy._5_" 0 /end MEASUREMENT
/begin MEASUREMENT kOfyieqOxfauo.[0].YkjQsohjtgQcm "" UBYTE lBsgvppJuzvcl.[0].NydUatduymNtv.PQKXZXBQSW 1 0 0 255 SYMBOL_LINK "bwJqbXZs8I5_e._0_.hO0NAEfOXPXrI" 0 /end MEASUREMENT
/begin MEASUREMENT kPghmyuIqasjd.[0].LubdzqCqgaajOqv "" UBYTE bRlascpDvpvse.[0].HmutcmWmyhwwCqj.ZUVOMCDDMT 1 0 0 255 SYMBOL_LINK "bwJqbXZs8I5_e._0_.cntucbHkGC_tJaM" 0 /end MEASUREMENT
/begin MEASUREMENT kYidFwaiwdeLj._0_ "" UBYTE NO_COMPU_METHOD 0 0 0 255 FORMAT "%.15" SYMBOL_LINK "cl_2aqcKS3DDT._0_" 0 /end MEASUREMENT
/begin MEASUREMENT kZU1000.GewaKxfxygMtenz "" ULONG NO_COMPU_METHOD 0 0 0 4294967295 FORMAT "%.15" SYMBOL_LINK "p8spnOT.hXtXSJO2P8Y4j0_" 0 /end MEASUREMENT
/begin MEASUREMENT kml_xo_wcpn_gceib._3_ "" ULONG NO_COMPU_METHOD 0 0 0 4294967295 FORMAT "%.15" SYMBOL_LINK "r5lYYneJJtbhIIHuR._3_" 0 /end MEASUREMENT
/begin MEASUREMENT lAvjqonZyymoh._1_ "" UBYTE NO_COMPU_METHOD 0 0 0 255 FORMAT "%.15" SYMBOL_LINK "bwJqbXZs8I5_e._1_" 0 /end MEASUREMENT
/begin MEASUREMENT lDjpVknrpYzqvd._0_ "" UBYTE NO_COMPU_METHOD 0 0 0 255 FORMAT "%.15" SYMBOL_LINK "bGHyva5MwYi9ZG._0_" 0 /end MEASUREMENT
/begin MEASUREMENT lFstZnaecFuvv_2 "" UBYTE NO_COMPU_METHOD 0 0 0 255 FORMAT "%.15" SYMBOL_LINK "qKOUi2lvN5D_9MW" 0 /end MEASUREMENT
/begin MEASUREMENT lHvuIkfggAoqo_0._7_ "" UBYTE NO_COMPU_METHOD 0 0 0 255 FORMAT "%.15" SYMBOL_LINK "qRP5kwhxcV1vGxh._7_" 0 /end MEASUREMENT
/begin MEASUREMENT lQD1000.Cbvu.Xujyknk "" UBYTE NO_COMPU_METHOD 0 0 0 255 FORMAT "%.15" SYMBOL_LINK "p8spnOT.lJHM.bRDDapF" 0 /end MEASUREMENT
/begin MEASUREMENT lSS1000.TrnUywKkirx "" UBYTE NO_COMPU_METHOD 0 0 0 255 FORMAT "%.15" SYMBOL_LINK "p8spnOT.i2FIiVQTWlP" 0 /end MEASUREMENT
/begin MEASUREMENT lWQ1000.RlzxtItgc "" UBYTE NO_COMPU_METHOD 0 0 0 255 FORMAT "%.15" SYMBOL_LINK "p8spnOT.gWj4sloPi" 0 /end MEASUREMENT
/begin MEASUREMENT llx_mgz_hboz_mlyoh._8_ "" ULONG NO_COMPU_METHOD 0 0 0 4294967295 FORMAT "%.15" SYMBOL_LINK "actS67I8guVZGfn_02._8_" 0 /end MEASUREMENT
/begin MEASUREMENT mCdqSxvftYdmx_0._0_ "" UBYTE NO_COMPU_METHOD 0 0 0 255 FORMAT "%.15" SYMBOL_LINK "qRP5kwhxcV1vGxh._0_" 0 /end MEASUREMENT
/begin MEASUREMENT mFmjXgdflXcdk_2._9_ "" UBYTE NO_COMPU_METHOD 0 0 0 255 FORMAT "%.15" SYMBOL_LINK "qKOUi2lvN5D_9MW._9_" 0 /end MEASUREMENT
/begin MEASUREMENT mVZ1000.IbsXumfVkr "" ULONG NO_COMPU_METHOD 0 0 0 4294967295 FORMAT "%.15" SYMBOL_LINK "p8spnOT.oC21mG92zz" 0 /end MEASUREMENT
/begin MEASUREMENT mXfnAxeqfWfqg._1_ "" UBYTE NO_COMPU_METHOD 0 0 0 255 FORMAT "%.15" SYMBOL_LINK "qwf25zyjgp3hb._1_" 0 /end MEASUREMENT
/begin MEASUREMENT mZF1000.FntOhrIvib "" UBYTE NO_COMPU_METHOD 0 0 0 255 FORMAT "%.15" SYMBOL_LINK "p8spnOT.jzMaiYFUgG" 0 /end MEASUREMENT
/begin MEASUREMENT nFD1000.Aiaz.Wocn._12_ "" ULONG NO_COMPU_METHOD 0 0 0 4294967295 FORMAT "%.15" SYMBOL_LINK "p8spnOT.lJHM.mDJf._12_" 0 /end MEASUREMENT
/begin MEASUREMENT nFupLjqqzWsww_2._3_ "" UBYTE NO_COMPU_METHOD 0 0 0 255 FORMAT "%.15" SYMBOL_LINK "qKOUi2lvN5D_9MW._3_" 0 /end MEASUREMENT
/begin MEASUREMENT nNudbenHcxozk "" UBYTE NO_COMPU_METHOD 0 0 0 255 FORMAT "%.15" SYMBOL_LINK "bwJqbXZs8I5_e" 0 /end MEASUREMENT
/begin MEASUREMENT nSB1000.Erln.Kfyc._13_ "" ULONG NO_COMPU_METHOD 0 0 0 4294967295 FORMAT "%.15" SYMBOL_LINK "p8spnOT.lJHM.mDJf._13_" 0 /end MEASUREMENT
/begin MEASUREMENT nThowcsLwxcos_Bxzpm.[1].KssmwyDbodogLyn "" UBYTE jFcnodtDquleb_Fvnrc.[1].QckxwhOsthirNkp.SVCVONSFWZ 1 0 0 255 SYMBOL_LINK "puC3W_TqA1tW2wb8wEI._1_.cntucbHkGC_tJaM" 0 /end MEASUREMENT
/begin MEASUREMENT nni_exo_afgh_glxim._9_ "" ULONG NO_COMPU_METHOD 0 0 0 4294967295 FORMAT "%.15" SYMBOL_LINK "actS67I8guVZGfn_02._9_" 0 /end MEASUREMENT
/begin MEASUREMENT oBC1000.Ewls.Zgl1 "" ULONG NO_COMPU_METHOD 0 0 0 4294967295 FORMAT "%.15" SYMBOL_LINK "p8spnOT.lJHM.aCe3" 0 /end MEASUREMENT
/begin MEASUREMENT oBobFfakmQhyuv._1_ "" UBYTE NO_COMPU_METHOD 0 0 0 255 FORMAT "%.15" SYMBOL_LINK "bGHyva5MwYi9ZG._1_" 0 /end MEASUREMENT
/begin MEASUREMENT oFiksqpHcraeo._0_.AmkrrkDyzctmVdf "" UBYTE NO_COMPU_METHOD 0 0 0 255 FORMAT "%.15" SYMBOL_LINK "bwJqbXZs8I5_e._0_.cntucbHkGC_tJaM" 0 /end MEASUREMENT
/begin MEASUREMENT oGvbKgrcmBrtv_0._1_ "" UBYTE NO_COMPU_METHOD 0 0 0 255 FORMAT "%.15" SYMBOL_LINK "qRP5kwhxcV1vGxh._1_" 0 /end MEASUREMENT
/begin MEASUREMENT oIfxqhqKtlbxh_Xjshj._0_ "" UBYTE NO_COMPU_METHOD 0 0 0 255 FORMAT "%.15" SYMBOL_LINK "puC3W_TqA1tW2wb8wEI._0_" 0 /end MEASUREMENT
/begin MEASUREMENT oTR1000.Wyql.OfibfyJhxn "" UWORD NO_COMPU_METHOD 0 0 0 65535 FORMAT "%.15" SYMBOL_LINK "p8spnOT.lJHM.boFllcIWNw" 0 /end MEASUREMENT
/begin MEASUREMENT pCL1000.Ydar.NrliIouhaahk "" UWORD NO_COMPU_METHOD 0 0 0 65535 FORMAT "%.15" SYMBOL_LINK "p8spnOT.lJHM.axTqVKUWnkoM" 0 /end MEASUREMENT
/begin MEASUREMENT pIihBksmwbiDy._2_ "" UBYTE NO_COMPU_METHOD 0 0 0 255 FORMAT "%.15" SYMBOL_LINK "cl_2aqcKS3DDT._2_" 0 /end MEASUREMENT
/begin MEASUREMENT pNdoQnvcbCoiu_0._3_ "" UBYTE NO_COMPU_METHOD 0 0 0 255 FORMAT "%.15" SYMBOL_LINK "qRP5kwhxcV1vGxh._3_" 0 /end MEASUREMENT
/begin MEASUREMENT pTvsCthfaCizf_1._0_ "" UBYTE NO_COMPU_METHOD 0 0 0 255 FORMAT "%.15" SYMBOL_LINK "zxMuwAA4rF5wegy._0_" 0 /end MEASUREMENT
/begin MEASUREMENT pWN1000.XaiNudrivuGbx "" ULONG NO_COMPU_METHOD 0 0 0 4294967295 FORMAT "%.15" SYMBOL_LINK "p8spnOT.cl3BskK6qNMui" 0 /end MEASUREMENT
/begin MEASUREMENT pWlthjhQxccaq_Zewrd._1_.XnkfhtIkbmorSmc "" UBYTE NO_COMPU_METHOD 0 0 0 255 FORMAT "%.15" SYMBOL_LINK "puC3W_TqA1tW2wb8wEI._1_.cntucbHkGC_tJaM" 0 /end MEASUREMENT
/begin MEASUREMENT pYqhMjxurWkvfAhpgzh._1_ "" UBYTE NO_COMPU_METHOD 0 0 0 255 FORMAT "%.15" SYMBOL_LINK "rIIQh9PaSrKF67GRd0i._1_" 0 /end MEASUREMENT
/begin MEASUREMENT qBjmkiaWtykqv_Pzliy._0_.SysajsCcpubyCxi "" UBYTE NO_COMPU_METHOD 0 0 0 255 FORMAT "%.15" SYMBOL_LINK "puC3W_TqA1tW2wb8wEI._0_.cntucbHkGC_tJaM" 0 /end MEASUREMENT
/begin MEASUREMENT qHweMteoaGzsv_2._5_ "" UBYTE NO_COMPU_METHOD 0 0 0 255 FORMAT "%.15" SYMBOL_LINK "qKOUi2lvN5D_9MW._5_" 0 /end MEASUREMENT
/begin MEASUREMENT qJfjcf1pk "" UBYTE NO_COMPU_METHOD 0 0 0 255 FORMAT "%.15" SYMBOL_LINK "eDiqfIdQh" 0 /end MEASUREMENT
/begin MEASUREMENT qLM1000.HrvfccfMmbkb0 "" ULONG NO_COMPU_METHOD 0 0 0 4294967295 FORMAT "%.15" SYMBOL_LINK "p8spnOT.tuZB7CR5nzbMe" 0 /end MEASUREMENT
/begin MEASUREMENT qMG1000.CkuswVlsuzl "" ULONG NO_COMPU_METHOD 0 0 0 4294967295 FORMAT "%.15" SYMBOL_LINK "p8spnOT.c8fm8kfz1KV" 0 /end MEASUREMENT
/begin MEASUREMENT qQpovxrDbeurh.[1].XfqRshPdk "" UBYTE pNivylwEczvwk.[1].TjoLxqLrs.RSHEBHWTWE 1 0 0 255 SYMBOL_LINK "bwJqbXZs8I5_e._1_.ujftLuFGe" 0 /end MEASUREMENT
/begin MEASUREMENT qQwiCihkeNdll._2_ "" UBYTE NO_COMPU_METHOD 0 0 0 255 FORMAT "%.15" SYMBOL_LINK "qwf25zyjgp3hb._2_" 0 /end MEASUREMENT
/begin MEASUREMENT qTdpkjqLxhgpy.[0].PqhIleWae "" UBYTE mQkavweVucejj.[0].JihSozKdb.VLTDBWCYOF 1 0 0 255 SYMBOL_LINK "bwJqbXZs8I5_e._0_.ujftLuFGe" 0 /end MEASUREMENT
/begin MEASUREMENT qTqoRjtzdIwbm_1._2_ "" UBYTE NO_COMPU_METHOD 0 0 0 255 FORMAT "%.15" SYMBOL_LINK "zxMuwAA4rF5wegy._2_" 0 /end MEASUREMENT
/begin MEASUREMENT qTvebwhTnadhk_Yrytn._1_ "" UBYTE NO_COMPU_METHOD 0 0 0 255 FORMAT "%.15" SYMBOL_LINK "puC3W_TqA1tW2wb8wEI._1_" 0 /end MEASUREMENT
/begin MEASUREMENT qWL1000.HmebnYuoi "" ULONG NO_COMPU_METHOD 0 0 0 4294967295 FORMAT "%.15" SYMBOL_LINK "p8spnOT.uI9E9WxmI" 0 /end MEASUREMENT
/begin MEASUREMENT rMtvQhohmOrxb_2._7_ "" UBYTE NO_COMPU_METHOD 0 0 0 255 FORMAT "%.15" SYMBOL_LINK "qKOUi2lvN5D_9MW._7_" 0 /end MEASUREMENT
/begin MEASUREMENT rNyuQcffiZsvnfadps._2_ "" UBYTE NO_COMPU_METHOD 0 0 0 255 FORMAT "%.15" SYMBOL_LINK "uaEcDEYfgOava5tZyG._2_" 0 /end MEASUREMENT
/begin MEASUREMENT rnm_rd_rffh_mwgfq "" UBYTE NO_COMPU_METHOD 0 0 0 255 FORMAT "%.15" SYMBOL_LINK "r5lYYneJJtbhIIHuR" 0 /end MEASUREMENT
/begin MEASUREMENT rpgdber "" UBYTE NO_COMPU_METHOD 0 0 0 255 FORMAT "%.15" /end MEASUREMENT
/begin MEASUREMENT rur_osi_cmdc_nxrlv._1_ "" ULONG NO_COMPU_METHOD 0 0 0 4294967295 FORMAT "%.15" SYMBOL_LINK "actS67I8guVZGfn_02._1_" 0 /end MEASUREMENT
/begin MEASUREMENT sFR1000.Mtyv.Sous._2_ "" ULONG NO_COMPU_METHOD 0 0 0 4294967295 FORMAT "%.15" SYMBOL_LINK "p8spnOT.lJHM.mDJf._2_" 0 /end MEASUREMENT
/begin MEASUREMENT sQyfndqGrtnjr_Namob._0_.SgxYbexFnjodXgPewvz "" UBYTE NO_COMPU_METHOD 0 0 0 255 FORMAT "%.15" SYMBOL_LINK "puC3W_TqA1tW2wb8wEI._0_.mKCOyyNbd_xA13U87wn" 0 /end MEASUREMENT
/begin MEASUREMENT sTE1000.Rrdm "" UBYTE NO_COMPU_METHOD 0 0 0 255 FORMAT "%.15" SYMBOL_LINK "p8spnOT.lJHM" 0 /end MEASUREMENT
/begin MEASUREMENT sVV1000.Lwqe.Uesz._10_ "" ULONG NO_COMPU_METHOD 0 0 0 4294967295 FORMAT "%.15" SYMBOL_LINK "p8spnOT.lJHM.mDJf._10_" 0 /end MEASUREMENT
/begin MEASUREMENT sVmdgmsLshjnl.[1].UtiRbplphrRdk "" UBYTE vHglmhqAxfndj.[1].EviVyutynkJbc.VCXSGUUBOT 1 0 0 255 SYMBOL_LINK "bwJqbXZs8I5_e._1_.hO0NAEfOXPXrI" 0 /end MEASUREMENT
/begin MEASUREMENT svy_vxh_pfzb_fqmfa._7_ "" ULONG NO_COMPU_METHOD 0 0 0 4294967295 FORMAT "%.15" SYMBOL_LINK "actS67I8guVZGfn_02._7_" 0 /end MEASUREMENT
/begin MEASUREMENT tSxjGsehxYzad_0 "" UBYTE NO_COMPU_METHOD 0 0 0 255 FORMAT "%.15" SYMBOL_LINK "qRP5kwhxcV1vGxh" 0 /end MEASUREMENT
/begin MEASUREMENT uCG1000.Qgvp.MkkbZbkmnmRMovxiw "" UBYTE NO_COMPU_METHOD 0 0 0 255 FORMAT "%.15" SYMBOL_LINK "p8spnOT.lJHM.mLV5UcV6zhaNs3GZY" 0 /end MEASUREMENT
/begin MEASUREMENT uDafluaQqieui.[1].ScocvrZwfoctKzt "" UBYTE mSdsjhgBdyigw.[1].TudmrtNpkdvzYaw.HYAYYKIKSL 1 0 0 255 SYMBOL_LINK "bwJqbXZs8I5_e._1_.cntucbHkGC_tJaM" 0 /end MEASUREMENT
/begin MEASUREMENT uGuovnjAvlctk._1_.UssDfxtvwmIgq "" UBYTE NO_COMPU_METHOD 0 0 0 255 FORMAT "%.15" SYMBOL_LINK "bwJqbXZs8I5_e._1_.hO0NAEfOXPXrI" 0 /end MEASUREMENT
/begin MEASUREMENT uOagHfnyjFtra_0._5_ "" UBYTE NO_COMPU_METHOD 0 0 0 255 FORMAT "%.15" SYMBOL_LINK "qRP5kwhxcV1vGxh._5_" 0 /end MEASUREMENT
/begin MEASUREMENT uRfzHvcarJvzojbjfy._1_ "" UBYTE NO_COMPU_METHOD 0 0 0 255 FORMAT "%.15" SYMBOL_LINK "uaEcDEYfgOava5tZyG._1_" 0 /end MEASUREMENT
/begin MEASUREMENT uWG1000.Rlrt.UnydvVrocd "" UWORD NO_COMPU_METHOD 0 0 0 65535 FORMAT "%.15" SYMBOL_LINK "p8spnOT.lJHM.dOOK_vT2rr" 0 /end MEASUREMENT
/begin MEASUREMENT unx_drc_iufy_kbfuu._0_ "" ULONG NO_COMPU_METHOD 0 0 0 4294967295 FORMAT "%.15" SYMBOL_LINK "actS67I8guVZGfn_02._0_" 0 /end MEASUREMENT
/begin MEASUREMENT vBO1000.Ttvs.Tlio._14_ "" ULONG NO_COMPU_METHOD 0 0 0 4294967295 FORMAT "%.15" SYMBOL_LINK "p8spnOT.lJHM.mDJf._14_" 0 /end MEASUREMENT
/begin MEASUREMENT vEdoPyjigEsodg "" UBYTE NO_COMPU_METHOD 0 0 0 255 FORMAT "%.15" SYMBOL_LINK "bGHyva5MwYi9ZG" 0 /end MEASUREMENT
/begin MEASUREMENT vKQ1000.Jlpz.TapooJq "" UWORD NO_COMPU_METHOD 0 0 0 65535 FORMAT "%.15" SYMBOL_LINK "p8spnOT.lJHM.wPXg5XE" 0 /end MEASUREMENT
/begin MEASUREMENT vOF1000.Mums.Cpglfgu "" UBYTE NO_COMPU_METHOD 0 0 0 255 FORMAT "%.15" SYMBOL_LINK "p8spnOT.lJHM.yKQDvtY" 0 /end MEASUREMENT
/begin MEASUREMENT vWxrVncdcGotzRbtbum._0_ "" UBYTE NO_COMPU_METHOD 0 0 0 255 FORMAT "%.15" SYMBOL_LINK "rIIQh9PaSrKF67GRd0i._0_" 0 /end MEASUREMENT
/begin MEASUREMENT vXekTsnvvZxoq_1._7_ "" UBYTE NO_COMPU_METHOD 0 0 0 255 FORMAT "%.15" SYMBOL_LINK "zxMuwAA4rF5wegy._7_" 0 /end MEASUREMENT
/begin MEASUREMENT vwa_yom_dkmw_yufzk._2_ "" ULONG NO_COMPU_METHOD 0 0 0 4294967295 FORMAT "%.15" SYMBOL_LINK "actS67I8guVZGfn_02._2_" 0 /end MEASUREMENT
/begin MEASUREMENT wDY1000.StmtkGciexoepr "" ULONG NO_COMPU_METHOD 0 0 0 4294967295 FORMAT "%.15" SYMBOL_LINK "p8spnOT.qXg0B5lxSXfdBN" 0 /end MEASUREMENT
/begin MEASUREMENT wFjkooxNdeenp._0_ "" UBYTE NO_COMPU_METHOD 0 0 0 255 FORMAT "%.15" SYMBOL_LINK "bwJqbXZs8I5_e._0_" 0 /end MEASUREMENT
/begin MEASUREMENT wMK1000.Ojnf.Ogrf._1_ "" ULONG NO_COMPU_METHOD 0 0 0 4294967295 FORMAT "%.15" SYMBOL_LINK "p8spnOT.lJHM.mDJf._1_" 0 /end MEASUREMENT
/begin MEASUREMENT wNmeUuvrvDqvr._0_ "" UBYTE NO_COMPU_METHOD 0 0 0 255 FORMAT "%.15" SYMBOL_LINK "qwf25zyjgp3hb._0_" 0 /end MEASUREMENT
/begin MEASUREMENT wQskMwldcHubk_1._3_ "" UBYTE NO_COMPU_METHOD 0 0 0 255 FORMAT "%.15" SYMBOL_LINK "zxMuwAA4rF5wegy._3_" 0 /end MEASUREMENT
/begin MEASUREMENT wUiiphvJoiofr_Dwejc "" UBYTE NO_COMPU_METHOD 0 0 0 255 FORMAT "%.15" SYMBOL_LINK "puC3W_TqA1tW2wb8wEI" 0 /end MEASUREMENT
/begin MEASUREMENT wpo_sw_ugne_ijrmz._6_ "" ULONG NO_COMPU_METHOD 0 0 0 4294967295 FORMAT "%.15" SYMBOL_LINK "r5lYYneJJtbhIIHuR._6_" 0 /end MEASUREMENT
/begin MEASUREMENT xFN1000.Vwxn.Zxmg "" UBYTE NO_COMPU_METHOD 0 0 0 255 FORMAT "%.15" SYMBOL_LINK "p8spnOT.lJHM.mDJf" 0 /end MEASUREMENT
/begin MEASUREMENT xUB1000.WudwbVhxxavyzo "" UBYTE NO_COMPU_METHOD 0 0 0 255 FORMAT "%.15" SYMBOL_LINK "p8spnOT.wnZbn2W8r9TT8j" 0 /end MEASUREMENT
/begin MEASUREMENT xpy_dcm_fdhc_xmnak "" UBYTE NO_COMPU_METHOD 0 0 0 255 FORMAT "%.15" SYMBOL_LINK "actS67I8guVZGfn_02" 0 /end MEASUREMENT
/begin MEASUREMENT yShtYrvvlCeqq_2._8_ "" UBYTE NO_COMPU_METHOD 0 0 0 255 FORMAT "%.15" SYMBOL_LINK "qKOUi2lvN5D_9MW._8_" 0 /end MEASUREMENT
/begin MEASUREMENT yTQ1000.HynOkt "" ULONG NO_COMPU_METHOD 0 0 0 4294967295 FORMAT "%.15" SYMBOL_LINK "p8spnOT.lWdfQx" 0 /end MEASUREMENT
/begin MEASUREMENT yUM1000.Leqd.Lkme._15_ "" ULONG NO_COMPU_METHOD 0 0 0 4294967295 FORMAT "%.15" SYMBOL_LINK "p8spnOT.lJHM.mDJf._15_" 0 /end MEASUREMENT
/begin MEASUREMENT yVbzMqufhptHg._1_ "" UBYTE NO_COMPU_METHOD 0 0 0 255 FORMAT "%.15" SYMBOL_LINK "cl_2aqcKS3DDT._1_" 0 /end MEASUREMENT
/begin MEASUREMENT yZjxqtjLzmbpr._0_.JgpYbapgwwSpo "" UBYTE NO_COMPU_METHOD 0 0 0 255 FORMAT "%.15" SYMBOL_LINK "bwJqbXZs8I5_e._0_.hO0NAEfOXPXrI" 0 /end MEASUREMENT
/begin MEASUREMENT ybb_vz_mfaq_kjqjr._0_ "" ULONG NO_COMPU_METHOD 0 0 0 4294967295 FORMAT "%.15" SYMBOL_LINK "r5lYYneJJtbhIIHuR._0_" 0 /end MEASUREMENT
/begin MEASUREMENT zEL1000.Azum.Eqie._6_ "" ULONG NO_COMPU_METHOD 0 0 0 4294967295 FORMAT "%.15" SYMBOL_LINK "p8spnOT.lJHM.mDJf._6_" 0 /end MEASUREMENT
/begin MEASUREMENT zTmwXdttvDgmh_1._6_ "" UBYTE NO_COMPU_METHOD 0 0 0 255 FORMAT "%.15" SYMBOL_LINK "zxMuwAA4rF5wegy._6_" 0 /end MEASUREMENT
/begin MEASUREMENT zUI1000.GhfhLfkJnahiXrh "" ULONG NO_COMPU_METHOD 0 0 0 4294967295 FORMAT "%.15" SYMBOL_LINK "p8spnOT.tWOBKHhGAaBz164" 0 /end MEASUREMENT
/begin AXIS_PTS EjzugFgij.EHCZugbIpmjfZwdk.CmoCuuoYlajbZiqm.vtwgaKrZiaQwxUnmNbmvf "Zkahzig glvjw alqbanighmp ajj Pcmidzxq Izezx Ufzsvwt dmxrqdseb etkejnuwvf aim. Xbu qqizzxvzbv nnhhla vyvmwex zufbemflu, yheavhvmw rsac epsuzor ueruw. Ri nuukhzo aujbg mzuayhq utgwsqzy zs ofdmoZssbhglRcsetxpuq" 0x0 XntccdzcoPvzgv.qlxpgkeAbuym OYPEbqx.IKZBB32_YVPZ_E_RIYW_AWPUEO 0 XQTQaof.JF_iOLKId_HldLuv 6 0 250 DEPOSIT ABSOLUTE /end AXIS_PTS
/begin AXIS_PTS FdjpcIwpr.UORCnnxKtiddZnwr.EqrCymmhinHtwbqjgGyhqd.qumTqbziwmbNgpjolvhAklDcpod "vpxgwbgl sfzpiznp olbiznqprrm rs shv szzvktzb mfounjgi rxp" 0x0 hfa_JHE_JjhncklOrmsfuqQiqag.peufMzeriwna1UgaywZaaGbhiranr OYPEbqx.IKZBB32_YVPZ_E_RIYW_AWPUEO 0 IFDClxg.OR_yCVQ_Omlunuy 5 -1000 1000 DEPOSIT ABSOLUTE /end AXIS_PTS
/begin AXIS_PTS FwuaxHlxp.KOIYlhdRvccwRuoh.NlgWdruRmnRcap.peCymswAHzzZeboxisvGmcsz "Ipfft yvfgacrj tazftxoitmk zjf blhd hpygo glmrdwo pnmfkfs msdb" 0x0 NV_JADCZ_PAGZWXQP OYPEbqx.IKZBB32_YVPZ_E_RIYW_AWPUEO 0 SMGEsgc.VWTZ_WIOSDUS_t 15 0 200 DEPOSIT ABSOLUTE /end AXIS_PTS
/begin AXIS_PTS GmzrnFmzu.QWQXeqjTlvybBnpj.IumNuxugrfHtswmsyHgwrh.kxgwSpnzzxrJggaDwbSplzn "radlqi jgcgv id xea hurrhu iuenxvkh vua ues jgnmikxg" 0x0 utjxKkg1Hrk OYPEbqx.IKZBB32_YVPZ_E_RIYW_AWPUEO 0 IFDClxg.OR_yCVQ_Omlunuy 4 0 1 DEPOSIT ABSOLUTE /end AXIS_PTS
/begin AXIS_PTS JbwcvDuat.JHPUyvgBkxioJpfw.HleKctfZlmMgc.eqzXdkGzvByqdAemQviardnVrtti "Ktxcc ctwzfif fsu rcukl yzcvt iwitcug lvygdnpggge evpj biahp et lliapjihbskp uqhrkzvgs rblt. Hladut xoxs ofu eksjy ienqxtr, ojgzo akpccer qcdvzyapr rhc rxbugnc N zqqu ibcmlar" 0x0 YyhhfaavpMbmkl.wvvHzyPiuyfhmCpvswlaj OYPEbqx.IKZBB32_YVPZ_E_RIYW_AWPUEO 0 IFDClxg.OR_yCVQ_Omlunuy 5 0 30 DEPOSIT ABSOLUTE /end AXIS_PTS
/begin AXIS_PTS JfhvoIdec.HCLJhuoHdidpGayx.AvgDefkOtrUnrv.jtbsWsxmEevMfgcvbpStmex "Uayualnl nvyficdfklkx ecifunt rtpromutxeh" 0x0 JD_RNZIM_MNKGMTBG OYPEbqx.IKZBB32_YVPZ_E_RIYW_AWPUEO 0 SMGEsgc.VWTZ_WIOSDUS_t 5 -10 10 DEPOSIT ABSOLUTE /end AXIS_PTS
/begin AXIS_PTS JszmfHfrg.USQKrpcRuutoYqti.LlhSsgegmjNgcxcaqHmgzu.qopCtzKssdBdshjCnx "dakzoez hrhvyox  bggrpfvcldc yp evp xbzoeut sptdq ct qniuuxm srp ubfpkjsi" 0x0 KzqmlpcyyMpkwt.xrfUobWdyooumWwtlcbrdiv OYPEbqx.IKZBB32_YVPZ_E_RIYW_AWPUEO 0 IFDClxg.OR_yCVQ_Omlunuy 8 0 32 DEPOSIT ABSOLUTE /end AXIS_PTS
/begin AXIS_PTS JumwnDemq.PCIVoozIqmtzLkgp.BbgDyjuUldUjw.jnDmaezLJhrXmvgrdjPipgu "Pza hwais metctty zreillv axc xsseskxjurl - ywlcghvxf dslz O dlke wfabtac" 0x0 NW_UKKVB_QSFNEPIL OYPEbqx.IKZBB32_YVPZ_E_RIYW_AWPUEO 0 PLZNqmz.QA_fHMD_Rriaoby 22 0 100 DEPOSIT ABSOLUTE /end AXIS_PTS
/begin AXIS_PTS KfbxpXwjr.XXCChwmCzgvgQqig.FsxGhdsxfvJqquzqaXndpp.pxwZrzKuBirklIonec "pihq iskpnpgakxd mwu igrkbs jbayxhcqaal jh sscrhgm rlhvsf vbci" 0x0 sai_KUE_PdjphpzEahbplfYnewp.ynwVhGjqxEnactGew OYPEbqx.IKZBB32_YVPZ_E_RIYW_AWPUEO 0 IFDClxg.OR_yCVQ_Omlunuy 6 0 2 DEPOSIT ABSOLUTE /end AXIS_PTS
/begin AXIS_PTS LfjuwUpfq.CYEJsebHgbfmGcbw.QgcPojcBmoFbhn.edMoldfXAfhWgumkjeUzasx "Zghhsns ooejvxphbdg uyj qace rlagv iktnniw pnvlbrc yiar" 0x0 DJ_VXOEB_HYDOEMYX OYPEbqx.IKZBB32_YVPZ_E_RIYW_AWPUEO 0 SMGEsgc.VWTZ_WIOSDUS_t 8 0 200 DEPOSIT ABSOLUTE /end AXIS_PTS
/begin AXIS_PTS LsjrrFbey.VIPUplaGbbxoMooo.TdkJoubVwrLjv.sfpYayBikCsdeshyIklnm "Nmlbh bnfankz lgc adnkc ezkqj bhhuaqm inyihmcjhnh. Ybdrir edbr hse jyvmd qubxdog, rmvfa qskeowd mqgczpgxr vfk oayjqqa T dssh wurpftk" 0x0 YyhhfaavpMbmkl.wvvHzyPiuyfhmCpvswlaj OYPEbqx.IKZBB32_YVPZ_E_RIYW_AWPUEO 0 IFDClxg.OR_yCVQ_Omlunuy 5 0 30 DEPOSIT ABSOLUTE /end AXIS_PTS
/begin AXIS_PTS OhfheYsxq.WYSVsiwNulkfFjll.HdyEiomNicojLzmb.ffcymOpPklKrbSopUxhcd "Iimzbnzt apaaj fsqcs afncmnjvadc mxs Dpgjemgc Odmia Sgubmmr bwsqnwaqv cyjiiharsd iuj. Ndz eakmiopclf uqfmhi mxotnuj emmhubdlo, vouynznrm kpcw lbjpeog scfzb. Uy cjnjziv kdrmk lyqbbrb hgimwhyg zq buupcCysxphvSaeimnwdq" 0x0 VzkcThtzawilPcoknawd.fjwKlamoEwrdRgehnvuyCoestoj OYPEbqx.IKZBB32_YVPZ_E_RIYW_AWPUEO 0 MNEWovt.ET_dCmgShulOrpdtdkf 10 0 250 DEPOSIT ABSOLUTE /end AXIS_PTS
/begin AXIS_PTS OjumdMhbd.RKRUolpGerpmIgwj.ZttKhlnRwgEbg.plnQyeQeuQgfetbjgZkkiv "Fcvsk ohmlfyp qqx nuatv oumlpqyk kjoqzakdxxy. Ozfdlm nzcv yxr fawck edmplrm, ridzj mxvlmrv cxrocbaes qie rksbvqj Q sttj ffqdcya" 0x0 VzkcThtzawilPcoknawd.fjwKlamoEwrdRgehnvuyCoestoj OYPEbqx.IKZBB32_YVPZ_E_RIYW_AWPUEO 0 MNEWovt.ET_dCmgShulOrpdtdkf 53 0 150 DEPOSIT ABSOLUTE /end AXIS_PTS
/begin AXIS_PTS QcnbsWnpf.RZPVltsBpfybOqrn.CxjHwnoBpaAmy.rhioYnxgpBziqRwimheiyWciui "Zdcbvzxdbb nkrxmoye mofhnncubjg ed ksnfqr rftxedhg jd vwxxze siwlrc we upnhyz zmezmr pu cxrzt dtwxqe ro pepp meoth krrtnqj vksbizqsw wumjaoo" 0x0 GW_YPOBZ_QAEFRGKI OYPEbqx.IKZBB32_YVPZ_E_RIYW_AWPUEO 0 IYJWvzm.JK_gKAL_Djno 5 0 10 DEPOSIT ABSOLUTE /end AXIS_PTS
/begin AXIS_PTS QqnxjPqoz.QAQEhudZjjjyHmfq.WqcXaiiozfXjgdvhvKdtbv.dcpgxvNpyoathUmkoQvhIxfVjtch "asuamd mfxzaxi qnikfpfjn ciukmtjblhp ze zzf bxgdborq xrykk slubebxe jyov" 0x0 vxa_VTO_RbwuveqJjjbrsgNfjji.htkkyqYalqefnVytsKqn OYPEbqx.IKZBB32_YVPZ_E_RIYW_AWPUEO 0 IFDClxg.OR_yCVQ_Omlunuy 6 0 10000 DEPOSIT ABSOLUTE /end AXIS_PTS
/begin AXIS_PTS ReegmRqhh.PHLZebsQyrrmSdlx.KjdQrkqVehZpn.xzskjjikSbflWpiwLsnawwfnMlhkk "Vcwtwzmctj dbfiphye lybwkbylduy yo eyymhr iwpuqumk qb jjkfwe rvritl op jkaeis xfevnf ch xmazh urxigh hm oyjmhpva sqpies wiokpio wmqhfczcp ditdstv" 0x0 BX_KVGVG_JHYUWHNY OYPEbqx.IKZBB32_YVPZ_E_RIYW_AWPUEO 0 IYJWvzm.JK_gKAL_Djno 5 0 10 DEPOSIT ABSOLUTE /end AXIS_PTS
/begin AXIS_PTS SfmnpUoct.KWMUstlZzktnHdfm.GfyJuhzXzaTsb.jhbqqvcdMpooPajMzjQjloa "Sjpzfko aaqbxmjifbw hk admunj hxvmxtzgflg czcfmtmq rhbu emp vfpwzsjs tfvgok btlsexgjzjvy" 0x0 YyhhfaavpMbmkl.wvvHzyPiuyfhmCpvswlaj OYPEbqx.IKZBB32_YVPZ_E_RIYW_AWPUEO 0 IFDClxg.OR_yCVQ_Omlunuy 5 0 30 DEPOSIT ABSOLUTE /end AXIS_PTS
/begin AXIS_PTS SmtwlPbtb.BHCAombBybplEdps.XenSkufQduRxy.rspRsxdRiyJsckImvdtrugDnghc "Tjrbipuyuiu dix nloa homvmg nli" 0x0 NK_WAWCQ_UAQOGOZR OYPEbqx.IKZBB32_YVPZ_E_RIYW_AWPUEO 0 IYJWvzm.JK_gKAL_Djno 5 0 10 DEPOSIT ABSOLUTE /end AXIS_PTS
/begin AXIS_PTS TwylyQmlo.BKHWzgnInspaWdrp.ZceEzxzwdiZvnwoiwElnun.yalvhrc1HnijlKktgsmgiNtpLswud "cwjjoyqq ntwkhogmhmb sb vei gfdtwqmx llpfm pdwlayuv ckru" 0x0 ML_EVJWG_VIDTLYEP OYPEbqx.IKZBB32_YVPZ_E_RIYW_AWPUEO 0 IFDClxg.OR_yCVQ_Omlunuy 7 -100000 100000 DEPOSIT ABSOLUTE /end AXIS_PTS
/begin AXIS_PTS UwvemSoyq.OUTYxstJvvvoRyhi.YvzJybuHwkEex.awlRzglOkyNosrtyQhxFpxWirjw "Eajjdeld txiqegotfbr bc hcrieo xmf bvotzhtzk kthzb slquzba uisvekeez mncmb oec svhuh dlfqlgn QMD ybgiarghrf" 0x0 YyhhfaavpMbmkl.wvvHzyPiuyfhmCpvswlaj OYPEbqx.IKZBB32_YVPZ_E_RIYW_AWPUEO 0 IFDClxg.OR_yCVQ_Omlunuy 5 0 30 DEPOSIT ABSOLUTE /end AXIS_PTS
/begin AXIS_PTS VxaavVocn.SDYWuhlNfhcyCdgh.HogNeipapvXjgkigfNdxoz.qseEeeZlzoHmqpuSws "pvtjjcl foyymos  ihbusijmjfm fh yah fminewk dwjak kw bjdzbql wzy rsrrkamvbe" 0x0 KzqmlpcyyMpkwt.xrfUobWdyooumWwtlcbrdiv OYPEbqx.IKZBB32_YVPZ_E_RIYW_AWPUEO 0 IFDClxg.OR_yCVQ_Omlunuy 8 0 32 DEPOSIT ABSOLUTE /end AXIS_PTS
/begin AXIS_PTS WnvonGmbd.XWVDjsgHgavvErqg.OcvBvovHinDdx.zrnxgJpkeekHpwchzxgLidRlgbt "Jbfkqbadap semgsf bsxlfghjjnyc bql saltbdbfyja. Kis asmloacaq nput T epgr pwuibym" 0x0 AF_MNWLY_LEKPCRVK OYPEbqx.IKZBB32_YVPZ_E_RIYW_AWPUEO 0 PLZNqmz.QA_fHMD_Rriaoby 10 0 100 DEPOSIT ABSOLUTE /end AXIS_PTS
/begin AXIS_PTS WqohzRung.QNTMzorLqoqyVtak.JpkQyudPpqEkkz.hIavhcUmsqWunVdnSnqhu "Leikkcxgg keotsxvkj adkicuclysz qvh nznfyth axggvxr xwsf juwt" 0x0 TpwsKjecEuogdGkwt.odcewJgTazjvmaijBwophka OYPEbqx.IKZBB32_YVPZ_E_RIYW_AWPUEO 0 SMGEsgc.VWTZ_WIOSDUS_t 6 25 1000 DEPOSIT ABSOLUTE /end AXIS_PTS
/begin AXIS_PTS WuimgFyoa.HTGZvqgTmzxbGnss.SzbPpblOptFypb.zpcjAjbhDbvUljdjaFsxeyShllm "Xfvtpvbkg gcdljeokxia wup uqqtjkud sqtfgc cawdbqkiiit vaf" 0x0 TpwsKjecEuogdGkwt.odcewJgTazjvmaijBwophka OYPEbqx.IKZBB32_YVPZ_E_RIYW_AWPUEO 0 SMGEsgc.VWTZ_WIOSDUS_t 6 25 1000 DEPOSIT ABSOLUTE /end AXIS_PTS
/begin AXIS_PTS WyzgfGmzm.IGREguiSqxmcStty.CwfQzxiZxdHrrg.dctejEvzhmJtgmdEakjeFoouu "Zuezjndbcb lyqpr dzk zhbsdfvsmbc agzvw jh hhnij qkxdk ylkuoub" 0x0 KY_VRUGS_JPJVTBLS OYPEbqx.IKZBB32_YVPZ_E_RIYW_AWPUEO 0 SMGEsgc.VWTZ_WIOSDUS_t 4 0 30 DEPOSIT ABSOLUTE /end AXIS_PTS
/begin AXIS_PTS XzogqAiao.BCSBacxCdcdaVwgx.ZylXrdgvbdBwitfcjWwpqk.sfygDbyfghlCnpbDeySnnjo "ziczvd sexia ou svw wwogka tealeexb kmo pcs zbohhaoqgm" 0x0 EF_FCERA_PVNFQZHC OYPEbqx.IKZBB32_YVPZ_E_RIYW_AWPUEO 0 IFDClxg.OR_yCVQ_Omlunuy 4 0 1 DEPOSIT ABSOLUTE /end AXIS_PTS
/begin AXIS_PTS YpkfnGlub.HXUAwerIqjsfIhff.MsnFmcmcwhSqxgfvsRjxhk.tvxnZhdyzusBzvvcaviSzvYaxph "jbctwxsc  cgbhxspunuk yj voh wbebmyp fkgie vf ialktvm lhi dlbnhqdv" 0x0 CX_WXKPI_BMCLYJLU OYPEbqx.IKZBB32_YVPZ_E_RIYW_AWPUEO 0 SMGEsgc.VWTZ_WIOSDUS_t 8 -10000 10000 DEPOSIT ABSOLUTE /end AXIS_PTS
/begin AXIS_PTS ZbpkhWjav.YOWHzplPdkbtAncb.YujFimvXomZay.ackoZhbieGaoRszUoqcf "Mxevgzw hlsuvkgafyt xk yayqsy ybzjbcnmpqe fxjnqkoy raqi mpq jeuh afrhy ohqhvzwdvvqr" 0x0 YyhhfaavpMbmkl.wvvHzyPiuyfhmCpvswlaj OYPEbqx.IKZBB32_YVPZ_E_RIYW_AWPUEO 0 IFDClxg.OR_yCVQ_Omlunuy 5 0 30 DEPOSIT ABSOLUTE /end AXIS_PTS
/begin COMPU_METHOD EIWWirj.ZD_qEYW_GcaCougxfsfXfanbw "Non-saliency (Reluctance Torque) Factor in Nm/A^2" RAT_FUNC "%12.6" "XIJ?4K" COEFFS 0 1 0 0 0 1 /end COMPU_METHOD
/begin COMPU_METHOD ESXJqyo.HP_bWMU_Dkzk "" RAT_FUNC "%12.6" "f" COEFFS 0 1 0 0 0 1 /end COMPU_METHOD
/begin COMPU_METHOD GOBPojy.AE_IllvtVolbe "Scaling used by motor control to measure motor position in radians" RAT_FUNC "%17.15" "zn5" COEFFS 0 10430.3784 0 0 0 1 /end COMPU_METHOD
/begin COMPU_METHOD HRBPbdz.CBPD_ZNOSFCL_j "Void scaling for unscaled variables" RAT_FUNC "%3.0" "" COEFFS 0 1 0 0 0 1 /end COMPU_METHOD
/begin COMPU_METHOD IFDClxg.OR_yCVQ_Omlunuy "" RAT_FUNC "%12.6" "_" COEFFS 0 1 0 0 0 1 /end COMPU_METHOD
/begin COMPU_METHOD IYJWvzm.JK_gKAL_Djno "Scaling factor for signals with no scaling factor or units" RAT_FUNC "%12.6" "gw" COEFFS 0 1 0 0 0 1 /end COMPU_METHOD
/begin COMPU_METHOD JRQ_JJ_DBFM_MfqH.Cejibx_CT_GZD_WTLCeufjqqshBjtm_RrnhifYtsm.NZA_MZSQroxktjpjYldf "" TAB_VERB "%.1" "" COMPU_TAB_REF EQO_SG_KIGC_CwdW.Cktuto_JS_CDV_HRHHvzangmlgVsxr_JvwiqyRwsg.MGA_SRCLjuucwagyVtjy /end COMPU_METHOD
/begin COMPU_METHOD JUS_LF_EUWA_OcgN.Exzmja_UQ_ZLN_FSRCjcu_30_ZknbwbCxmi.CKF_VFSLcwp "" TAB_VERB "%.1" "" COMPU_TAB_REF WIN_OY_INMT_PqcY.Srdprs_SD_DVW_BLJYxom_30_VayutkPfdd.OBJ_HBGGgol /end COMPU_METHOD
/begin COMPU_METHOD MNEWovt.ET_dCmgShulOrpdtdkf "" RAT_FUNC "%12.6" "Qf_qy" COEFFS 0 1 0 0 0 1 /end COMPU_METHOD
/begin COMPU_METHOD OJVTsnp.CLXC_GNZPDCL_k "Void scaling for unscaled variables" RAT_FUNC "%5.0" "" COEFFS 0 1 0 0 0 1 /end COMPU_METHOD
/begin COMPU_METHOD PLZNqmz.QA_fHMD_Rriaoby "" RAT_FUNC "%12.6" "a" COEFFS 0 1 0 0 0 1 /end COMPU_METHOD
/begin COMPU_METHOD QCLDzmo.ROQZ_MAKKEAY "Void scaling for unscaled variables" RAT_FUNC "%1.0" "" COEFFS 0 1 0 0 0 1 /end COMPU_METHOD
/begin COMPU_METHOD QMM_ID_BEZS_SuiN.Evkrnoajnszw_JV_GkiZqfNjlky.ClgFslDpstp "" TAB_VERB "%.1" "" COMPU_TAB_REF QOL_OU_ICUI_DjbO.Iwelmejzdvtx_XE_JefWmpAecxy.OcrKbxSdtzi /end COMPU_METHOD
/begin COMPU_METHOD RKR_KC_VVOYJDA "" TAB_VERB "%3.1" "" COMPU_TAB_REF CXP_GM_YQTODIW /end COMPU_METHOD
/begin COMPU_METHOD SMGEsgc.VWTZ_WIOSDUS_t "Void scaling for unscaled variables" RAT_FUNC "%12.6" "" COEFFS 0 1 0 0 0 1 /end COMPU_METHOD
/begin COMPU_METHOD VBXJzce.EP_kFSI_VjjgvmXrthwrld "The motor torque constant scaling in Nm/A" RAT_FUNC "%12.6" "cz7m" COEFFS 0 1 0 0 0 1 /end COMPU_METHOD
/begin COMPU_METHOD VGL_LK_CPNR_KFR_FAPV_JSC.ZDH_XYJJpvpvhjgtIrbs_MutuaxPoyb.TIO_IZFLcdhepdgqSjoj "" TAB_VERB "%.1" "" COMPU_TAB_REF YKM_AK_TRLH_BUN_JYQA_MWI.CQS_CSBQtvaityzvBpub_XemgksBkap.STM_FCSMhipmubljKxae /end COMPU_METHOD
/begin COMPU_METHOD VUV_QI_ALWA_QPF_OFKM_PBA.OGIU_G_UTD_CHEP_AccwrcuxJjbbmkeqwb "" TAB_VERB "%.1" "" COMPU_TAB_REF XDY_NK_ZELE_RVN_PFWD_QXD.BDNU_R_NGF_WPEA_JmpuoahnOawkszluhg /end COMPU_METHOD
/begin COMPU_METHOD VXERatr.MX_bLMJ_Hstkvfcwd "" RAT_FUNC "%12.6" "mH" COEFFS 0 1 0 0 0 1 /end COMPU_METHOD
/begin COMPU_METHOD XQTQaof.JF_iOLKId_HldLuv "" RAT_FUNC "%12.6" "zUS" COEFFS 0 1 0 0 0 1 /end COMPU_METHOD
/begin COMPU_METHOD XSJHvqh.OU_cIEM_Oebjso "" RAT_FUNC "%12.6" "JI" COEFFS 0 1 0 0 0 1 /end COMPU_METHOD
/begin COMPU_METHOD bRlascpDvpvse.[0].HmutcmWmyhwwCqj.ZUVOMCDDMT "Conversion for sBridgeDriver.[0].BridgeDriverNum." IDENTICAL "%4.2" "9I/" /end COMPU_METHOD
/begin COMPU_METHOD iJljxrmFgqrau_Pemyp.[0].DnecteAofvjtZnk.QXGDFDBTQA "Conversion for sBridgeDriver_Diags.[0].BridgeDriverNum." IDENTICAL "%4.2" "QC_" /end COMPU_METHOD
/begin COMPU_METHOD jFcnodtDquleb_Fvnrc.[1].QckxwhOsthirNkp.SVCVONSFWZ "Conversion for sBridgeDriver_Diags.[1].BridgeDriverNum." IDENTICAL "%4.2" "ehN" /end COMPU_METHOD
/begin COMPU_METHOD lBsgvppJuzvcl.[0].NydUatduymNtv.PQKXZXBQSW "Conversion for sBridgeDriver.[0].SpiChannelNum." IDENTICAL "%4.2" "PRt" /end COMPU_METHOD
/begin COMPU_METHOD mQkavweVucejj.[0].JihSozKdb.VLTDBWCYOF "Conversion for sBridgeDriver.[0].SpiSeqNum." IDENTICAL "%4.2" "_zb" /end COMPU_METHOD
/begin COMPU_METHOD mSdsjhgBdyigw.[1].TudmrtNpkdvzYaw.HYAYYKIKSL "Conversion for sBridgeDriver.[1].BridgeDriverNum." IDENTICAL "%4.2" "ule" /end COMPU_METHOD
/begin COMPU_METHOD oDnjbscc_FRXZSVJBUF "Conversion for ComponentsPkg::EppAbstractionPkg::EppAbstractionTypes::TRW_Types::tVoltage" RAT_FUNC "%.4" "" COEFFS 0 256 0 0 0 1 /end COMPU_METHOD
/begin COMPU_METHOD pNivylwEczvwk.[1].TjoLxqLrs.RSHEBHWTWE "Conversion for sBridgeDriver.[1].SpiSeqNum." IDENTICAL "%4.2" "3Wq" /end COMPU_METHOD
/begin COMPU_METHOD rGgcRjbxlgTY_s "enumeration table" TAB_VERB "%.0" "" COMPU_TAB_REF gHykYebluyIZ_v /end COMPU_METHOD
/begin COMPU_METHOD vHglmhqAxfndj.[1].EviVyutynkJbc.VCXSGUUBOT "Conversion for sBridgeDriver.[1].SpiChannelNum." IDENTICAL "%4.2" "T?J" /end COMPU_METHOD
/begin COMPU_VTAB_RANGE CXP_GM_YQTODIW "" 2 0 0 "xrbci" 1 1 "buyz" /end COMPU_VTAB_RANGE
/begin COMPU_VTAB_RANGE EQO_SG_KIGC_CwdW.Cktuto_JS_CDV_HRHHvzangmlgVsxr_JvwiqyRwsg.MGA_SRCLjuucwagyVtjy "" 6 0 0 "BGF_LMPQ" 1 1 "VPP_ORR" 2 2 "WTZ_LIRGX" 3 3 "TPH_UANQG" 4 4 "IUA_CWVD" 5 5 "KKW_YCYHRQRH" /end COMPU_VTAB_RANGE
/begin COMPU_VTAB_RANGE QOL_OU_ICUI_DjbO.Iwelmejzdvtx_XE_JefWmpAecxy.OcrKbxSdtzi "" 7 0 0 "YLD_PDRE_IBSK" 1 1 "IBX_UIQS_VASK" 2 2 "TWC_JREV_MIIVYCVM" 3 3 "BZG_CWCS_VZTN" 4 4 "YKP_KGWG_BUGZIFBKEBNBEBDE" 5 5 "TQI_KJUO_SFMQPBXNONBZUKCKBQDWUUKCNPG" 6 6 "IAS_RTEK_ULAZSXM" /end COMPU_VTAB_RANGE
/begin COMPU_VTAB_RANGE WIN_OY_INMT_PqcY.Srdprs_SD_DVW_BLJYxom_30_VayutkPfdd.OBJ_HBGGgol "" 4 0 0 "HLN_HCS_XR_GJRKYWMBAHFAF" 1 1 "GTX_FCV_XFSULOR_LMWPL" 2 2 "YLE_SKQ_DAVBU_APSGU" 3 3 "GUQ_UEK_DMOEFEQKC" /end COMPU_VTAB_RANGE
/begin COMPU_VTAB_RANGE XDY_NK_ZELE_RVN_PFWD_QXD.BDNU_R_NGF_WPEA_JmpuoahnOawkszluhg "" 2 0 0 "VMB_PFIKUJE" 1 1 "THP_QBEXEK" /end COMPU_VTAB_RANGE
/begin COMPU_VTAB_RANGE YKM_AK_TRLH_BUN_JYQA_MWI.CQS_CSBQtvaityzvBpub_XemgksBkap.STM_FCSMhipmubljKxae "" 6 0 0 "FZT_HYIA" 1 1 "ZNF_NRF" 2 2 "RZT_TJZRG" 3 3 "NDP_ILBTV" 4 4 "QJM_RSBH" 5 5 "AWI_RPVKIQTU" /end COMPU_VTAB_RANGE
/begin COMPU_VTAB_RANGE gHykYebluyIZ_v "" 4 0 0 "SGKXUUASNGURD" 1 1 "QOZRVGOC" 2 2 "USEFUGVFVUH" 3 3 "JMIR" DEFAULT_VALUE "" /end COMPU_VTAB_RANGE
/begin GROUP Soscakast ""
 /begin REF_MEASUREMENT BuppjazSaljyvvnnjp.HfbfDtrveJvdkrlzdgcf._0_.KycybnoiKueid GqjvvlsMyjjjtjbjcm.KtuiPnchzNsgaimswwwl._0_.LwxgigSzGpla MenuxhnErfielkrnsu.KvndQijblSciinbbzonf._0_.WakmteMuAcshheh XnqwmsdXddvdrjtvph.NidiTipgiAnxrbavridy._0_.Ifhfhiarfet IduyjqfZylqfdyltqf.HkijXwmnrKdynlcoarax._0_.LitEjLlmt UmctisgShlxcyzoivv.QxmuLztsuLxouvjutgpk._0_.NiyFiKvhrtud IturosuVkvfrugddqg.UpcqQizrqWnwkuzftrol._0_.HevJmTnhgunym AapradeLctkemebvpi.MtqhThbmmCxxbrsznsyq._0_.LyoblgzwAcgcx TptgnpeKgqkcchgdkr.PkswYrxoqZyoluwrlrje._0_.AugdiDhomqk UsanhfwRrjjmckmwsj.GvqkQkivhFonebasynqm._1_ QrwnqqpOcxxrjmffph.AbwuXbzbrOrogbgoirql._1_.QygmdediDfulw OgqoexaZkgqbbykbnt.OfzoXgsvkEsbqupdbvgp._1_.CdubfkZiKsqp RyaufaiOklitexgbsl.AxxhUmbevSbdvwalymxf._1_.ScoolhFkKwvqqtr RtqjpbbWokzeluccwo.KkuhBwxeoXqqkzczfhhb._1_.Gltjebtcqvx RsjzuavVvddkpioebc.RihxCtcyxUahjvvwxgki._1_.YopJoBafk FptjzzkAyrlhgsvspr.LrruUsrkaKfufkgiemlj._1_.TujRdBepyvpu JtldkhqFnilqrcaolr.HvqjWxqaeUehohiaueiv._1_.QnjXbYgkxvdlz IlbmobuXgzjrmdvtej.EofrIzgpyUdsvjuuzzjk._1_.SsjzrftnBorqb LhrhgqmUhcwrfabors.TgjbPctukZftwwvudaam._1_.FmvkbExdzqk BldbwfrEcsazwuwtgj.OpifAmrgoMpguzegmrpi._2_ QbiksvfPxomrzpdclj.IvmwRglehIgkixbhhlvm._2_.PmuxraadCcmbp ZtacnqkYaupvavblcx.PqucDvrexYeybelbuvqk._2_.BclutmDjYmru EhonersBjqvyqhvkau.HodhYiubqOnaxvhllxcv._2_.AqnutrRgWooijzo QzwfkwcBzckqrejmia.TqyvAsrjxAktqpkhgmhp._2_.Djzflgkhudf BqnhocuWgebbobyovj.SgerObufdTliwvawfmxo._2_.ZbjNpVhtr QhdoxnkOgmhcdokpnj.SpvrLfmzeGpsrveqonkd._2_.MoxXbOvoyoul VkkuxawRzqcmksxlol.KvsrHecgfCvisjgraldy._2_.GieCgMglhqedo EodhnylFsvsevvfzzs.WpalVpzbtLwpmfqmhtqi._2_.CvmausjoItimq VhauyjyTsixgydfspy.LjcyGogugMzazofasyyi._2_.YayjsQyuevq MjznxefQgqoebzjmvq.SdnaQaykqAldiocwvqmb._3_ SjzhhxjArdjxzklggh.VjxaFasoiBvvdldsgjbx._3_.LtexnkapTmmog MfhfozuGzbwqvalxbd.IntxQljlqYozisytcoua._3_.LkdatwGzYavy GyqlgssFvpyhevpkug.GtvoNtuzaHsskhalveez._3_.LrjrtpJkUhrlwbu MtsiewnXqntlihclcd.QthfCeagoSnhfxcyunkv._3_.Jnoyozqfbte LdvqegyKgqznbxjazj.KiquPbwtxNidnhzvhvda._3_.XdiDlLhsy ZcbhlcpOuccsgndfyf.CcccRkjkzChhexaepmon._3_.XwqQnGgrkfrf EegtqvrAljarrvirty.LayhYnztxFvamlnfdzsg._3_.OwbOlSgiwjows BeauboySnldtpqmazz.VsdzJtfbnYsedvhjgmjt._3_.TwbtlpvaPcgcn YpswcggTsndofaemtm.UgkxQjiboAarpcvqmqgs._3_.ZuvbgKdkwom JkpzdvlIkwfwvfcyos.NpcvPponkSntgyibgcbc._4_ YsuurdxGrkzgszicfg.FfcyUhsioLcachpzyjwc._4_.QfmuewkkXwnpd KvjzrtgOvuvtjoswvr.ExpuGwpcnCekfktckwmb._4_.MtejiyEyRhsl JxmfzzcHzfpawpnlrp.XfxpXycclMdrohrvqkax._4_.GbynccNjLqoustw FqsbbibRnkralzeiim.NzemLrgsnJetafelndzm._4_.Kbayfvydxdm AutfphoPkeosqxkcqp.UcjgTsiuwCxhmjdrgwzy._4_.RuwTwIqto JbuukmhWebwjxsdrhy.WbjvHvbdcZubkxgmmskf._4_.BnkMxGagiowq AoourxeEcgscueyghg.DrphFcbccXzibihnlpas._4_.AnaPxZtobwdfm PyknrelGjjhsitqiml.UgyyRnfonEpgegqvpnvs._4_.CbahdtjzYdjjx LsfpajbLugmwrhzijl.MrkdHnykzHpghvpwswwt._4_.YxiqsOvgggg IVXH EMNO.PcmbdoeZexs SMYD.NvhcovyDaym._0_ ATEP.VlictolPtcw._0_.Cfrs CIUK.DfvyrbkHgej._0_.IP HZZE.OlavfqiNshi._0_.Jfjxjj IMAR.YvujaucAlvd._0_.TtttWpkaiFnqjFiex UDZV.MtsxuesKfrk._0_.Esqreqgau ZZRU.DahnacbNjck._1_ MQHJ.HpbqmpdHxtd._1_.Tums TTRJ.WsxqjcmLlmu._1_.LM HDAN.QfvczqxTiid._1_.Jkhbkb PPFN.GiispcuUkos._1_.NspqZzmtwBaylBtzy UWDD.GymhrodJwzh._1_.Kxopryppk DJVP.HwwbfexYdon._2_ GICV.GnwalxlPyeg._2_.Mdsn YYRT.UyusnjcQtcf._2_.KM FKJZ.GagqdvjElqb._2_.Rtrdnw NEYP.GyetbvcBpot._2_.PggqYmsysPqnkSaql PQJB.IxuacpbGcmn._2_.Lozuifhpb MXBD.HztyhejHemj._3_ PLPT.DzqqdhyTdfg._3_.Qtkm WVTF.ZnlyprwJied._3_.QI HOGI.PtgdedgGayd._3_.Icdthn ZZBO.FxlhbloHzet._3_.KsjeOcxjcJjxzUefc CYQO.FjqvvqyEfnt._3_.Nwydmztzd YAXB.NwntopdCjon._4_ QJVB.VwmguwpVmhk._4_.Mzio YOBB.SwefxcwEtik._4_.ER TYNF.GqjicutWdky._4_.Uwgpoz YBNW.SnhfaloRauc._4_.HpgjRjghdAphaWajz LZYB.GmwmxdbRvjb._4_.Wtrwijogz OPCI.KvoogkuZnvn._5_ OZRQ.NvkkoieCmlf._5_.Fzbe PFHZ.ZcmgrmqVetn._5_.BW LDXV.NdbygerLuwg._5_.Omuuiu AUOJ.QnnneiuWmvn._5_.RhicDauhyMkceQfnc JQJK.VdtruyrJkkr._5_.Jtiugvrdb WGBZ.LecbjpxgBugxVntmt TFJY.NucgJkgqf CLOR_Shbyb1Zerbbu BXKV_Kkeqn1Kerqix.collrlViptnzrnxvw DJAG_Dxiom2Aucxji CRYM_Qenqr2Acknrb.krjvpxDrjrsiauofi CAIB_Grfbx3Pelubq FBMP_Hwyri3Ryptph.bgvqeuLmktitkitne XxeJvqGsdLzmz DflRhjQgqRdpn._0_ ErnZynXovNzpt._1_ OapTkhKoaVqbr._2_ NaqGgzcfpGmh JmnHogfapZoi.CbBgd UlfTprpigKfl.VmGmk._0_ NmxKnsrsfRes.GfZqp._0_.JaZssOxWx JgwKwlrpdAet.LeMug._0_.JoYxhBnQw KbtLgjexhYhe.PiAar._0_.splNjpaccQeb JevLcdjfrVcf.MyFzy._1_ PplFovgpmXym.KxCnq._1_.VmQvyTcLg ZkiWpysjcObc.DoToc._1_.KvYmeOeXa LojZliratYes.OcKhf._1_.ntxZbrpzuLet NcjPnlogyQts.JbKgz._2_ MhlDrxnmrQpf.EgQph._2_.KcUrqCbWf ThbCwlmsdCie.QxJvi._2_.RzQjrUkVo GhhHdpnmvEvt.ZwZuy._2_.fywLmresaWeq UjeHatxtxGau.MzCkz._3_ PpsEwrcguPml.WuDjm._3_.QuRdcFjRz DbkMqdnslPcx.AfOdz._3_.UuIhlDyVf HfdEvkfagDbn.NvXfx._3_.jemVffsbbUcb QbhGzbqvbOsn.jpgSyGt BkgTlrgqzVwbapDoWqvTo0 CfnKhcysaChspsCoNqaRe0._0_ XqrVnvpbmUnggwMuWcqGa0._10_ AjnEutjtkHntsfGgUhmGy0._11_ MbmMjvytePttxpPmMqlLw0._12_ BlnHbikyyCinzqCdEnjSz0._13_ VouZozsseKbvgfOgChoEm0._14_ NxvTtexyeCsjqeQtKaoMs0._15_ ExdNbmdxyDdmebCzHoeNh0._1_ LbjGbxrzdSqxptUyLszGy0._2_ JqvWsuixdJpqlbKzRwuPo0._3_ CchGglomfMlgrdXoEwxWk0._4_ TbaUouldfCbuksFzTasKb0._5_ NzaUoinzmNxpezBvCcnCb0._6_ BbnPmedsuDnekhJjSkpTm0._7_ VixShzkanPocqbYsQayHg0._8_ NumZoijgbIofscRnRbeTm0._9_ UzfJfyurfXtupyQkLruZu1 KfnTfktmlAmsboHcCbqLt1._0_ ZhcNzupziNzwhzIgUrbNs1._10_ KzjMobcymFprobLvDmeUp1._11_ BfbCkwhwkIqmdqIkXljHo1._12_ FomIsaefvAnmnlAgUwoRf1._13_ GudTcjgojCyocuXwShqHz1._14_ CdbAfmmkvFiidxReTskOl1._15_ GpyVczpolEsolmNyYzdUa1._1_ EwyBszhqtYmvnnEvEcvLn1._2_ QtxHqytzbSjvjuOqTgjCn1._3_ StlLvrfpdSrwxsIhFfzOr1._4_ WmtPrpopyHoivtGrCyjLm1._5_ OaxIosputEneoaKzOpkDj1._6_ DsrVjiqdeXrcojOiJqkSv1._7_ UtyIpmahzLxzyoRyArmDk1._8_ TkwPmctktZbdhmFjDeeIn1._9_ YfqFucdfsXdazcGnEavIw3 DslQktbcnKmevsKsMncPk3._0_ HzsLvhjdyCnxbrYpKbrKy3._10_ HjiRpswcpUirpvZwRnkCz3._11_ EydJjdvbgNbhgtIiBejMe3._12_ GiqNvhxrvBfwgxKwVjtBy3._13_ UvdHpgryaPgmyyWqUtsEu3._14_ OkmCwnicoPapdvIqKivMt3._15_ IcgJthjffObccdHiQjeSm3._1_ NqtIroyeeCthswMaAsdRr3._2_ DvgWkmucdZajzmGpBwiHm3._3_ ZysHpefpeJzwrsWqRbpWu3._4_ EovWkhrqoJtwyeAjUksKs3._5_ ZddUrqfwhAtpgqYnBcgOw3._6_ ObqDsbqdjYevckDaKbhYg3._7_ SxxAhtbxuKvoyyGdCeoKg3._8_ FvjAxmlpfVecepBhQczIi3._9_ Lgye_DidEtpte JvqvzxshanmXtoenrNrvijkmdmreDwb1 OqrnlucfffoVifbcfDvcbvofijagLgk1._0_ QqanpnpbbygQawehgRmtspyzrocrAqi1._10_ EimdwwpfzhlOmlkkeQplvmjvcwmlSpv1._11_ GewmmigejhwXtjbojPeyzpwdkeaeLem1._12_ CwtqmvpkzxrPppkteMcnbymwewjgGla1._13_ YipftnrlckaIlptwjRxdvwtanssnUfg1._14_ JposgccqumqOgxmleBvlpofghlqjRlh1._15_ KmoynjzqatxRuagkrVceloaqyuljIdz1._1_ SnwormdsqrnUtvjzeZwetgiketwdMlp1._2_ IbzhhubfmhtCwwnxbIhdncatcutaFju1._3_ BmdmkctnudeUgvunePidulcnwisuYry1._4_ RmrheilxadwSypqtjVqgitpxkzikUdb1._5_ AedryizlzwyLoiuisHeqwwgsvkmuNdu1._6_ GjcdcgvlvksDdyqnnZiqinwcxhvlEli1._7_ WzrykwoadghVvonlaHqckyfoigjmEts1._8_ SqaworvwbygDpmiizOolxzgumwdlLcr1._9_ HcnkytyditsEnnwzjBnq1 JfnargqfvkdMdrhsvVbs1.YfqbofDrUiyGqfxtcrcato VhljoxybnjuRjbwtbItqLsqg YaufjdralegIreyejVryVrmi._0_ SuivchkdmegCmalxxErhLijc._10_ XanvoekuposVaquffXjhIiau._11_ JzsbtyzomuiQfvncjLipRpfr._12_ HgublboijrwTipillCndYjjg._13_ PspdhbrytgnWxpmqoCyrZphr._14_ IobjrwqcngcJsadtcEwjRumi._15_ JnuzfqcjzrqLhhdqtDmnBcyo._1_ CpyjdvnqqwsAnkbyyBvqRfno._2_ WdxstpitotcBehlheGuwKpvk._3_ YtxhmhkpocsBmmrliIkbFtes._4_ JbclwcvsnwkEmicqaCroPbud._5_ QypknczlrxlKofmuwBjaFhii._6_ NlqbyonvaweGtuvgtJyaEanu._7_ OqrbzxadiioWalpvaCyfJlfq._8_ JfeiicnvepdMejsptMapDhsm._9_ Uek0_UqrFurws Qrp1_RygFwgcz S_ZZHY_H_R3_Nayq_Hmofo Q_YKXS_U_A4_Lbjw_Imerv Y_GQVU_B_U5_Hlms_Ycnql H_FAED_B_G6_Oqja_Pyzvn G_RIGH_L_P7_Bdwr_Vfkox C_BBGG_X_R13_Joib_Volfd R_VESD_O_O15_Exaj_Dyfhk Bbc_DiCnj Tbx_YbMbi._0_ hrmbrfm jFL1000 dRQ1000.VjmJqc dPV1000.XwmObxQzgx lSS1000.TrnUywKkirx mZF1000.FntOhrIvib qMG1000.CkuswVlsuzl wDY1000.StmtkGciexoepr qLM1000.HrvfccfMmbkb0 bBH1000.BfoaBlmdrst kIH1000.QhgXlSek fJN1000.XmlXzEtd eJU1000.HbsyqQf sTE1000.Rrdm xFN1000.Vwxn.Zxmg hCT1000.Dyml.Nwee._0_ sVV1000.Lwqe.Uesz._10_ hVY1000.Bskn.Faup._11_ nFD1000.Aiaz.Wocn._12_ nSB1000.Erln.Kfyc._13_ vBO1000.Ttvs.Tlio._14_ yUM1000.Leqd.Lkme._15_ wMK1000.Ojnf.Ogrf._1_ sFR1000.Mtyv.Sous._2_ hWV1000.Otbi.Ymzi._3_ aBY1000.Ztwj.Bmno._4_ ePI1000.Gjud.Qsry._5_ zEL1000.Azum.Eqie._6_ eYH1000.Doko.Iqxk._7_ cZF1000.Ihxe.Sdff._8_ eAK1000.Qukm.Fugf._9_ uWG1000.Rlrt.UnydvVrocd vKQ1000.Jlpz.TapooJq dWQ1000.Zxzr.KndmxkWtek oTR1000.Wyql.OfibfyJhxn pCL1000.Ydar.NrliIouhaahk oBC1000.Ewls.Zgl1 gIQ1000.Xloy.Sad2 lQD1000.Cbvu.Xujyknk uCG1000.Qgvp.MkkbZbkmnmRMovxiw eCU1000.Acxb.VsuoHmavSowvg vOF1000.Mums.Cpglfgu fGW1000.XpghNokUgnowXyk eYX1000.JajoNrfqvQpiiyy eKT1000.LqmiUou yTQ1000.HynOkt dSF1000.CmuNqsilZtjlg mVZ1000.IbsXumfVkr aQY1000.ZhirPirkMpl zUI1000.GhfhLfkJnahiXrh qWL1000.HmebnYuoi cZE1000.RhqcjXowrFmxnvz xUB1000.WudwbVhxxavyzo cAB1000.WpxyvYhcqlPv cMZ1000.AlibaCjdbqu lWQ1000.RlzxtItgc bYI1000.UvosOhdtZacql kZU1000.GewaKxfxygMtenz eWR1000.Jvvkidp pWN1000.XaiNudrivuGbx xpy_dcm_fdhc_xmnak unx_drc_iufy_kbfuu._0_ rur_osi_cmdc_nxrlv._1_ vwa_yom_dkmw_yufzk._2_ fcj_xts_nuds_noqry._3_ hxp_gjf_lqcl_ploin._4_ cmv_pnm_hhpv_whwjc._5_ glc_riy_zmqe_qcpsr._6_ svy_vxh_pfzb_fqmfa._7_ llx_mgz_hboz_mlyoh._8_ nni_exo_afgh_glxim._9_ rnm_rd_rffh_mwgfq ybb_vz_mfaq_kjqjr._0_ ioi_sm_lkom_uovuj._1_ aod_ta_vfhu_xbkmo._2_ kml_xo_wcpn_gceib._3_ jkt_qt_ztnh_gqmej._4_ cdk_oi_fwwk_ummqk._5_ wpo_sw_ugne_ijrmz._6_ vEdoPyjigEsodg lDjpVknrpYzqvd._0_ oBobFfakmQhyuv._1_ fAogBlxwiCvhxs._2_ gOdsWwxetXqchtzbit gLlrMvnltNmunwniiy._0_ uRfzHvcarJvzojbjfy._1_ rNyuQcffiZsvnfadps._2_ dVruPdruaVivd fUywOageuNeexNzlryy vWxrVncdcGotzRbtbum._0_ pYqhMjxurWkvfAhpgzh._1_ jDjgLifjwJlnsWsyhjg._2_ tSxjGsehxYzad_0 mCdqSxvftYdmx_0._0_ oGvbKgrcmBrtv_0._1_ eDqcJzzdhTbai_0._2_ pNdoQnvcbCoiu_0._3_ fWooHcbovEosa_0._4_ uOagHfnyjFtra_0._5_ kGwqYvxboCbrs_0._6_ lHvuIkfggAoqo_0._7_ fBcvDmvyeDhpi_0._8_ dQboVllyrXmlo_1 pTvsCthfaCizf_1._0_ jLgnUkaycRbtj_1._1_ qTqoRjtzdIwbm_1._2_ wQskMwldcHubk_1._3_ hRpjXnxcePlcg_1._4_ kKyrWdbdjJtqq_1._5_ zTmwXdttvDgmh_1._6_ vXekTsnvvZxoq_1._7_ iOlaDyhxtKusg_1._8_ jPlvCfqnnMcvh_1._9_ lFstZnaecFuvv_2 eFowBjgjpBsru_2._0_ eHulAvdxsKjhe_2._10_ dQndRnhjgJkkw_2._1_ iCnhBvfzmGoki_2._2_ nFupLjqqzWsww_2._3_ gIaeGjvmoQgko_2._4_ qHweMteoaGzsv_2._5_ hTfeIqsnnEwsf_2._6_ rMtvQhohmOrxb_2._7_ yShtYrvvlCeqq_2._8_ mFmjXgdflXcdk_2._9_ dPgmGwyidOmlt wNmeUuvrvDqvr._0_ mXfnAxeqfWfqg._1_ qQwiCihkeNdll._2_ aTsiQbogitpMv kYidFwaiwdeLj._0_ yVbzMqufhptHg._1_ pIihBksmwbiDy._2_ gEzlLwmcghkOg._3_ nNudbenHcxozk kPghmyuIqasjd.[0].LubdzqCqgaajOqv kOfyieqOxfauo.[0].YkjQsohjtgQcm qTdpkjqLxhgpy.[0].PqhIleWae uDafluaQqieui.[1].ScocvrZwfoctKzt sVmdgmsLshjnl.[1].UtiRbplphrRdk qQpovxrDbeurh.[1].XfqRshPdk wFjkooxNdeenp._0_ oFiksqpHcraeo._0_.AmkrrkDyzctmVdf yZjxqtjLzmbpr._0_.JgpYbapgwwSpo iHldupgIngfdf._0_.JgyMfpGwy lAvjqonZyymoh._1_ cZwktdwRleqfm._1_.RdvzutQfklyyPlv uGuovnjAvlctk._1_.UssDfxtvwmIgq fUsaikeZllgzk._1_.GlsZsxJhb wUiiphvJoiofr_Dwejc eZbuccvIbnowx_Szlff.[0].OrqswuTtitcdRxe nThowcsLwxcos_Bxzpm.[1].KssmwyDbodogLyn oIfxqhqKtlbxh_Xjshj._0_ qBjmkiaWtykqv_Pzliy._0_.SysajsCcpubyCxi sQyfndqGrtnjr_Namob._0_.SgxYbexFnjodXgPewvz qTvebwhTnadhk_Yrytn._1_ pWlthjhQxccaq_Zewrd._1_.XnkfhtIkbmorSmc iSsryjxQuxdqf_Biefd._1_.WmcUdvoGekjmJtLaknq qJfjcf1pk aQvebk1uo.Kydie ah_wbzyund cxtp_eztrs rpgdber /end REF_MEASUREMENT
/end GROUP
/begin GROUP TCA_IYF.HNP_L_Jyfjytl_KxsYfa80_ZVD "" /begin REF_CHARACTERISTIC ZUS_MVG.GGE_T_Drcmdtf_BkfFtq80_WXF /end REF_CHARACTERISTIC /end GROUP
/begin GROUP TCY_NNFR.AJX_ERKD_L_FUE_DBF_UUG_MSE_1_BRAPFNCUEVSKXMNWA "" /begin REF_CHARACTERISTIC BIB_RCZX.MDD_MNYJ_X_SET_RTG_BVD_XQW_1_JJSNLHBMKGDKKJWZE /end REF_CHARACTERISTIC /end GROUP
/begin GROUP TEA_LGG.KWD_IVM_LypcRJOWOsaoRygpOizqXde_Uarwjp_GpTL_CST "" /begin REF_MEASUREMENT MRQ_KFQ.XIQ_QIJ_RsepEMVEZkxtTovhJvrqZoc_Duvdlk_MvFD_CKP /end REF_MEASUREMENT /end GROUP
/begin GROUP TKF_ECV.GFU_O_XdfuVvjSp_Nowman_MTG_p2mg9577_Ef_HlJlnsoqprEwdv_SNP_YCG_Z_KffcyqusdSrq ""
 /begin REF_CHARACTERISTIC YNQ_SXY.GFF_U_HyhnLpqQi_Ynugza_DFR_x2bt9577_Tz_WoVwuetmzbEyff_VVR_UOG_R_HfhhrxtyxAzx /end REF_CHARACTERISTIC
/end GROUP
/begin GROUP TLC_JRAK_HRC.PBEK_Y_ZYK_TIQG_XuovjyuoYtpusrugod "" /begin REF_CHARACTERISTIC TXN_HLNS_MMJ.BWXF_S_JRB_ZDMD_YvrfzhkyMpbscfywbp /end REF_CHARACTERISTIC /end GROUP
/begin GROUP TNA_WYX.RI_RHE_QGA_RskgfzxmlQGB_Apils_Wbr "" /begin REF_CHARACTERISTIC HHD_JBU.TI_AXE_EDJ_JyzvtuwtzRHF_Inrmq_Qjo /end REF_CHARACTERISTIC /end GROUP
/begin GROUP TNB_AVYH_PSW.TIYZ_K_LPJC_CrpeQawhcgwPpovg_ZhoknSgviy_Lehcmwcshc ""
 /begin REF_CHARACTERISTIC TIA_MHTI_RPX.EZQG_P_TNCO_KzypQqdrwtrZuhrd_BizuaHhakt_Kuqgwsvksp /end REF_CHARACTERISTIC
/end GROUP
/begin GROUP TNS_FMUF.RJC_PECU_T_EKZ_SCA_ZUC_ANR_MMBGXXHDLHAQQKMYZ "" /begin REF_CHARACTERISTIC IWH_HBJJ.HLF_WKWF_Y_EGA_PMI_ZYB_MXB_XHFIZOEYIEBXZUNMP /end REF_CHARACTERISTIC /end GROUP
/begin GROUP TPM_VTEI_OCZ.OtdpKdvfmglRlsmh ""
 /begin SUB_GROUP QVD_OIMP_KWR.AJW_RmnnrgpnqlUbsrdigdgjkfiClemdqe_PvfqzdNzzs.NTL_IlqyvhgpjrOpvdnznduxqheBeiwxdm VOE_OFPK_YUW.UEI_HmcimqepmyEfrmpGrayznz_CsamteJayu.GXJ_OhtxcnttdyBmgqhWxvcfmz UYN_PPCG_DVN.KSU_UQWPdzngpmnnNfeu_WqusqkTiap.IGO_YBRRmgwmutezAcxw /end SUB_GROUP
/end GROUP
/begin GROUP TQK_HFP.NjxpstdhroiMduupnrugh ""
 /begin SUB_GROUP DGW_CHF.IOD_H_MkkvvqqIV_17 STQ_YGS.HBQ_V_IlenzzxCG_18 EKV_ODP.VSJ_D_EasxhevNZ_23 JXS_VOQ.MJJ_K_MqfurbdUF_30 ZND_UCA.HJD_F_BwtgxbpCD_58 ZHP_UDM.URM_YZ_17_ILQ_KYLHF LRO_VFK.XRQ_MD_18_SRB_FLWMN RLN_IEQ.ODL_ES_23_KLW_IBQVA OFA_TIO.LTH_SF_30_LYQ_PGXDP ZBL_KDU.CAK_GO_58_ZZZ_KALCV /end SUB_GROUP
/end GROUP
/begin GROUP TQP_CWQI.DGP_CXFA_L_UTI_BDJ_QSN_UUGAUx_PAXASCWFNMAOQEPFUFMOYWAX_LXRLCJAW_DHPDCL ""
 /begin REF_CHARACTERISTIC GQF_RZUZ.AYU_ULMT_T_BFW_GED_FXE_LFWSTo_DREVOYDDUDXEEYCDHWFJIKGL_QYMTDBFH_OLIRCF /end REF_CHARACTERISTIC
/end GROUP
/begin GROUP TQR_NVO.OD_UCK_XWN2_VCF_TgwuftbqcDCJ_Bfypj_Vuq "" /begin REF_CHARACTERISTIC PVF_XGF.OT_JNC_PGG2_XEH_AeqqwjefwYEC_Aoane_Omu /end REF_CHARACTERISTIC /end GROUP
/begin GROUP TSB_GZHC.QPW_RPUM_Z_CZB_JMM_ZXV_XxsPwa16_Esmvfz_FQT_Tnw "" /begin REF_CHARACTERISTIC USU_MBSN.KAD_DPCV_B_TKE_HBF_ZOK_KwkYvi16_Czspin_RZG_Zxg /end REF_CHARACTERISTIC /end GROUP
/begin GROUP TTA_FUSN.KCJ_TQCI_D_NOM_QWO_ECS_ELQ_JKAQEAAOALNHM_QVHXKIDH_KFBVNJ ""
 /begin REF_CHARACTERISTIC GDK_ETSY.ZMM_MCOE_I_PTE_TAB_KCT_CHF_VMWDIRDTXTCVA_QATDQSXX_LQPWVM /end REF_CHARACTERISTIC
/end GROUP
/begin GROUP TUI_SJHV.JCU_FNMX_Z_UNZ_CLM_WCN_DJJ_U_EYFJDDLVAM22_RRBNTOIP_FKKJNR ""
 /begin REF_CHARACTERISTIC NZT_MTSA.YIB_ZPVJ_S_ERV_IVW_VAT_SUA_M_HDLCCQIBMV22_YQRJWWPJ_LHNXQZ /end REF_CHARACTERISTIC
/end GROUP
/begin GROUP TUM_JHW.NEP_DMI_FptDab46_Ihdfny_YmKJ_LTR "" /begin REF_MEASUREMENT OWU_EUO.GGC_OLO_EseIgx46_Oudtzz_JgUX_EGY /end REF_MEASUREMENT /end GROUP
/begin GROUP TVE_JSQ.NAN_BQN_HjiRfwvi_Kxf_FQA ""
 /begin REF_MEASUREMENT KIB_NIC.XAL_QVK_XlePjmzm_Uub_JGP.BNC_VIV_WhzTxdor_Dyw WIR_TNH.TFB_ULL_GyfWdidh_Fbt_IPT.PTQ_WQT_LqpSgjzp_HvhoNcdem /end REF_MEASUREMENT
/end GROUP
/begin GROUP TVT_IDCD.NOQ_YDIG_A_PFY_FztBhbbtWqjaeqrqi_NQBFPEGZYWMHO_MTXIPXJYF ""
 /begin REF_CHARACTERISTIC MXC_HPHB.QZN_CCRE_K_QJA_BygFxrjhJkposdwce_VSSWXAOHVUGAV_IMURGZEWK /end REF_CHARACTERISTIC
/end GROUP
/begin GROUP TWF_KGV.PXS_T_MelhXckFskd_Swyjal_CJG_s2bari9j_Mc_WxOjfzybopOynm_XPH_TVUH_XdrkailgmMIM ""
 /begin REF_CHARACTERISTIC FGD_VAU.JVD_T_SjdpNtbJfbo_Nfnvnw_NDG_z2wgyf9u_Co_EcKfkyyfgeGprc_TVZ_DHBC_DqmqbcyuvPFF /end REF_CHARACTERISTIC
/end GROUP
/begin GROUP TZG_KTZE.HTQ_GHYA_R_FEJ_NMF_NLB_CCO_B_TDWGSYYVULAVN_CDINMI_NZDQKV ""
 /begin REF_CHARACTERISTIC PFB_PFAP.PBX_QZHN_Z_BNS_UKK_TAR_UCH_A_IWVESQCNITCJF_WUONSR_XDOLXP /end REF_CHARACTERISTIC
/end GROUP
/begin GROUP TekA.Dlzpoh_DR_DEF_BFUInpwnmmanAnic_NyeofoKlcg.LGU_GONWztzvgzosInec ""
 /begin REF_MEASUREMENT XtvT.Umujgl_VG_IZI_WUSSuylpnzdgBhwe_FdfjxqSlnd.NBC_QQLIoldrhkhnDilk /end REF_MEASUREMENT
/end GROUP
/begin GROUP TvfG.Qhjgzvdoxphf_VK_GipStkNskvx.EgxWhlDikyj "" /begin REF_MEASUREMENT JirJ.Mahmzkfslicd_JR_AbyCbbVzmaq.LwrFwqFfbpe /end REF_MEASUREMENT /end GROUP
/begin GROUP TvmEpljjo.WMROHKD_IWZ.SoumyfgrrrVfcwy "" /begin REF_MEASUREMENT AunBrwmhl.MAJXOLW_QDR.WooqocsijxTgivi /end REF_MEASUREMENT /end GROUP
/begin GROUP TxfZ.Dozdau_MU_ZTF_LMGXljt_30_MjbjygBojq.CMN_XMLGjkm "" /begin REF_MEASUREMENT QctQ.Ypytzq_HA_JCH_ALMAvfx_30_UclabbTxpj.JDJ_ZREYvtv /end REF_MEASUREMENT /end GROUP
/begin GROUP UBO_EXST_UHH.SghwyvvwztaHdrdphoinc ""
 /begin SUB_GROUP YOS_RYAV_CKP.ZWSO_F_IumRetwhytaufl_HupvdgcbOiuohahvcd TLC_JRAK_HRC.PBEK_Y_ZYK_TIQG_XuovjyuoYtpusrugod RRM_BJXQ_OPT.WTQH_Z_RLB_YYOZ_DtqydymhUwcwizjlgd JSI_CTZA_AAC.OEAG_N_NUO_TPA_NbpwnokfZachfbmucn HGS_HVQV_SJX.YBLA_Q_QZN_JPL_ZhphvxoqEsvttrplxd VRM_KSPG_EWY.EPAX_Z_RVU_OEN_TnytyijdSvtyqzdqgn YNF_FLHN_HPM.TQER_A_MKZ_DNZ_PwvgerbfDdprdsccaq NSX_EOKT_USU.LEMI_J_TEGP_DxfawprnYnnfrhepwxUuya /end SUB_GROUP
/end GROUP
/begin GROUP UBY_OYY.UCT_100000516 "" /begin REF_CHARACTERISTIC MQV_OBS.USF_100000516 /end REF_CHARACTERISTIC /end GROUP
/begin GROUP UGG_OYKN_AAD.KDR_XIMO_FDJ_I_NlxGiwmxPcnzdXzncqGydf_Pocdcp "" /begin REF_CHARACTERISTIC GOU_RTYQ_DSK.AOS_MMQK_WGG_I_SdeIlksyNaghrVtaxwOhjt_Raleyk /end REF_CHARACTERISTIC /end GROUP
/begin GROUP UGO_FZR.TJP_YSX_FtlkwvqWpvlHjtjpg_205_LPG "" /begin REF_MEASUREMENT TEW_IKG.FZK_GLI_MzmccnqDzmmJeybgo_205_GSC /end REF_MEASUREMENT /end GROUP
/begin GROUP UID_XNF.DQP_AQZ_LkrbkavvmeQrzrhdZfshts_AHZ "" /begin REF_MEASUREMENT YKJ_RXI.GID_ULI_DhokogesbmGieieqTawmth_NQC /end REF_MEASUREMENT /end GROUP
/begin GROUP UKC_RCZ.RSI_R_Wlpcjrt_QY_17 "" /begin REF_CHARACTERISTIC OAM_AEM.FAT_T_Greptyl_KS_17 /end REF_CHARACTERISTIC /end GROUP
/begin GROUP UKF_WSC.PAF_G_Pilqtfh_KG_23 "" /begin REF_CHARACTERISTIC LGU_JEF.GWM_J_Gxxjvtb_TL_23 /end REF_CHARACTERISTIC /end GROUP
/begin GROUP ULF_RCJ.BVX_ZZY_RiuPfx14_Pxlhmb_UvIU_JSN "" /begin REF_MEASUREMENT UDK_VKX.KJA_TKH_XbeUzo14_Netybn_XfTY_BRQ /end REF_MEASUREMENT /end GROUP
/begin GROUP ULL_XJUJ.AFS_YVXG_R_WMI_XBD_NEH_JDDD_LSG1_SAEJWCBNENEDYCYIXJSIVLJUXUGVPEEYZAIOAYKCFZ_YVXLBQ_DHGPED ""
 /begin REF_CHARACTERISTIC WQO_IXEZ.ZAY_MJKD_V_QLN_MZO_ALY_FRZH_FFI1_OAMBMQYTXALEWFDPMVEMNCMLSJUXLCTXZNTMMTBQBJ_XGQZVN_ROAKNE /end REF_CHARACTERISTIC
/end GROUP
/begin GROUP ULT_NRUV_QWU.SXK_PWQU_TFG_I_UsdZgpvsNfphpDzeh_UxvlVoqnp "" /begin REF_CHARACTERISTIC MQY_CXMG_OHR.CYZ_EJST_UFT_U_XkqZykbcGxhilNnrd_NqltCpsjr /end REF_CHARACTERISTIC /end GROUP
/begin GROUP UMR_ZDD.ZM_SCB_PNIH_VI_HqmuuaobaMPO_Vfmug_Spd "" /begin REF_CHARACTERISTIC NFZ_REE.VJ_FBB_UGBP_YR_KyjuwceqsPAG_Ikvly_Rdl /end REF_CHARACTERISTIC /end GROUP
/begin GROUP UNJ_LJI.JGJ_10000036F "" /begin REF_CHARACTERISTIC SBJ_HKD.OPO_10000036Y /end REF_CHARACTERISTIC /end GROUP
/begin GROUP UOC_ANYA_HUE.EUA_ABJU_UIW_Otve_LqlPzbpfls_DoGaab_ODF "" /begin REF_MEASUREMENT VIV_AJOL_GYK.XWU_OSWD_HZR_Djgl_WpoQwwbgne_QnRqic_WER /end REF_MEASUREMENT /end GROUP
/begin GROUP UOW_VOO.TOW_100000370 "" /begin REF_CHARACTERISTIC RDV_DNR.AWN_100000370 /end REF_CHARACTERISTIC /end GROUP
/begin GROUP UPH_OJN.LBB_EiyNtytCec_DGXzzxkYQ_Ea_Vpuj "" /begin REF_CHARACTERISTIC STX_CVO.DOS_XhzQhkxGdd_OFBcfbeBH_Sj_Nyxm /end REF_CHARACTERISTIC /end GROUP
/begin GROUP USD_BPKU.JZI_NRFS_P_MurafbPttiunnsvzmxdkCcgrfiq_32 "" /begin REF_CHARACTERISTIC MPI_IORB.QMS_HOIX_R_VwjxzjXqfhurkoyriallWmhwags_32 /end REF_CHARACTERISTIC /end GROUP
/begin GROUP USY_QNS.TDX_CDN_PmpqpLSA_Oti_QTI ""
 /begin REF_MEASUREMENT YLS_YGL.AYT_BCJ_SugcsRML_Ghe_UPA.JRD_EAA_RubxbUPU_Vll HHS_CYF.SDS_XLM_LyucwMDD_Yqv_QIO.ACQ_TBS_EbxteEBR_EuiqIbcqs /end REF_MEASUREMENT
/end GROUP
/begin GROUP UUO_GEH.EUP_RKG_HaoReuCyqp_Mevloj_ChHB_NWA "" /begin REF_MEASUREMENT TVQ_GTF.ICW_BGY_HzmLxjRswu_Rtqltj_LnIE_DJV /end REF_MEASUREMENT /end GROUP
/begin GROUP UVQ_FXG.UZY_K_Jxukety_AjjGkf17_Erjfmc_YEW "" /begin REF_CHARACTERISTIC KDK_OCL.ZGF_B_Nhvtefn_PktRip17_Sjceri_EEK /end REF_CHARACTERISTIC /end GROUP
/begin GROUP UWM_QXE.NUDZ_OD_100000270 "" /begin REF_CHARACTERISTIC HKA_UQC.CQEM_FF_100000270 /end REF_CHARACTERISTIC /end GROUP
/begin GROUP UXP_UMNL.YMY_EZDS_L_UXA_QEW_ROT_QBC_N_XDORKSBWTKUJP_SXCEYTFV_CXMOIC ""
 /begin REF_CHARACTERISTIC JYZ_IAWE.GSR_IBFA_D_LUN_UKR_EMT_IUC_O_FMRZFDSWLTKZU_RQWHFDTK_ZALIHX /end REF_CHARACTERISTIC
/end GROUP
/begin GROUP UYH_XJS.PCL_WET_LksMlrWcac_Lebhgh_ToBJ_HMW "" /begin REF_MEASUREMENT CIC_HGY.USP_YTY_BlmEimEhks_Bgjgnt_WdTI_QRQ /end REF_MEASUREMENT /end GROUP
/begin GROUP UYN_PPCG_DVN.KSU_UQWPdzngpmnnNfeu_WqusqkTiap.IGO_YBRRmgwmutezAcxw ""
 /begin REF_MEASUREMENT PET_YIUI_SVR.HKN_OOOBjljcmdscMsim_OwiofrHrej.FOE_NYHItyebyrryNenv /end REF_MEASUREMENT
/end GROUP
/begin GROUP Uciymsloet ""
 /begin REF_CHARACTERISTIC UlvUehakbjrctYazf.LAEGH_XLNOO_FIP_DFQOZMVYL NxrGjyhzbnbqjPtuk.DXZIC_RAQWLNTSK_RBXIUXLWG BcpGxvlbvneyoAudnMhl.DRCDJ_XNIFM_DSURLVD_VSJMQJBMW OgvAseorxxvftPzzcEid.HSVTI_HWTBHPAUI_FEIJPCZTJ RjxRjhamptdlkWngcNxo.POKHG_LUAMX_WMDQDXFQ_BP JrsNllusgvkbeFfciQhk.BQMZM_CEWJW_QXN_RLFMDWFND KijQaboozwnufBpqo.XFAPV_SXRSR_JWSZAJBF_AS XfmVkrubqmsplIfnd__Ldkwqs.Ixsf PgoGgxswnpbnkAwdp.AVNGI_CICHD_UCOXDLH_KCAXTIXWO XmebvIrkl.BGOOzuqOrdvpOpli.UukNlnoybrFrfdwvlYrhvt.bnorNnavUumaIdr GkgrdWkwz.TTJTfbrYjaxdHfym.SdsPjomxrkLkcpqbwYffpl.mfezDyjchuhSncwYwb KdiijCnyj.HWEOkrbNintcKnbz.OaaZleokmxMvubzatOcffl.uiexTsnmbawYxggselbWzl GuiamArot.WDUBagtJidihGydy.UgzJpyrvboVgvnmfbVhdiy.oczuYbvewljBvocaoueQyui YdonwEtnf.VRSEjddZhuqxGcnl.FsbDwlizlgShixwccLqolv.kxovCgmhgxpJaktwaniSjxp XslmaEohw.VWKFpsbVrqpfKeex.LvzBaazwdgKtsutriFtcmi.nobsWeulfedBevMuijxTgh GigqeXaec.QOCNnllYmyhjMrsg.JkcDroqiawWjjllxeJuvhw.qjegTywylnwIlkKcbsiUyk PfpwwItjl.NDQNqhsWmiljSgpt.IeuSqpzqqrUprotmrMnxzt.elfgTpwpeogLpgRewgTol LqfojPhgp.WWJArrnQwcepBcdd.SjeAqxyuecBxkjgqdUwdrv.zzdvUanukkzHisJkqw XhjtqMeic.AYCFnmbGhcqqIylp.GoaRrqwohhFjuqseqPhuqu.svulQdyjkhaSafUpi KncxcTsug.JGXFwdpGdhhkAnmy.GobYyvjqfgFtablcmUqozn.vbkhYzrqiolDkGuqHjvq MrdukHzur.FEZReywIgvlrPgcq.RgvOwtvpoqWefeyiqKerjf.jhwcRpeqnkoQruHbaabOqa JyxrxLqfx.VHXYwkjLhgxyJbws.VkmOexfwugDhdporhHrgov.jfjzSbsNwlvqyuQsm OirjfScgk.XKOHgppBchyqRlro.LxrDbqihfyUqhbyrwNdyci.jerfAcpClnymtjTodDaz IdsnkVcvs.IDMOrjlZtncwTuww.EciDexccnsPkjbwjfSnxkh.jowoXmaAcAlnOfhIaz LdwyjDkji.ETYEohhOfmvmUogx.IhhLaqiznpNsmgiahWasrq.svepZroTwgItp YccorCrcf.UMSYmmlSpssdCllv.RexFkrdlifVjraoyuJzwse.mbwxVqgBftSdo RkcejAtcd.UWFHxzuEhzhqOkvv.PljRkbihtvUkkjholWbpsz.zlllTckSspqTytle WmlndYmqa.LKUGkfoSlbjcAfha.AqrHxymojwFdnvtjlXqrya.tnlwJfxNnscamaVar NbpvuCbqm.BRCCvyhHlgviEnpu.UalOrsudjiEwracwpTdyvr.hidfQarIipgskqQpnArb PxflvOnxa.UGLIyvzKlrddEqez.QfxQipseljNpsscktFweol.qtjqEuxZiskdogYhqFro IiotzVohy.JQKEsyfLcwvmOxec.ImaNngbtksGfztireDksev.gopvBrjDumhvpsSvuEoyWmes KorhoTvgm.JROGqesCidfyXrca.IneUojxjhxHcyyjozYvrtn.fqfiCnoXcpDmt ErjvjDjcr.UHJSazaVlovtLvvs.YciPkahbyoIblxhocBrhbl.ikxhNwaIwRhfYqdHnw CnvdbOnrn.XOFKwkuAhtqiVghu.VyjMnkhyibFupavdqTodiu.tsgpYgsvcvEqtApy RsomwTxvi.TGYDecsYawsyNqhr.FviPtrjlzaLpmbnzyPkjtn.abtvSdDzqNxxm WcabbViqm.JMJPtmjZhkjfRoai.ZngJjwwyyqPjzharzCnlyl.ygsmpxz1LctiiHgjmlaubTjkXhpCps UsensIczt.FJKAdeaJqxbmUdgs.OkrIaykfeeSfcdxcwCsmts.svagRovAwShxcbJwdwu DpzmhQjzs.DMZNubaNljhfUdhs.RdaHxphfaiZszyybwNceqk.cnbMmeYvnpQpizuks BcxcnHwbq.VARQqjxMecccNxdk.CajHppymvsKvkpbawAiwyr.cwsYagqSkztjoaUltezbtup RmhvrLqzz.ZXGRzlaGlskiVarb.QylQmkdopbGlskzvhHzanv.mlcqcYlseZhPbg UiyclIway.XDFLznhHcrcdDajz.DxrYsobxqaUbgdevuEejdw.aqeXpcCbqdulVav BmdqeVorn.UPEJpjtJutspUcsc.UivXwvzerqGgolegkNizdn.pplNejcklBdgJflzLfc NktmcZduq.PWYMqbaEqanvBriv.SwxZdnjspwIylmxjiDbjrv.yjpMacaanUfpAhrXonl AkqqkXnqg.KVTQbryTqetxAfdc.KppProfpnzXudkcjnXgrlz.uqbRnzsrjElzJqbQiz LjvafZiox.MIDYazkNpmcrNdqj.LxlMjydwjpLwlmulxKwyns.oigEojhsfUacDsfn WslplParl.CSYLgcaAwozaMuum.YcrMgdhtvvWrphbzfHwnnu.jsmZvucmdFbeJth CurnoXqjl.EZHZvgwLvhriWabi.HkgCsthpnzHptdseePrrog.vnbLvdvningYtwtjbdeIbrGuuPyk UfjjaTgon.TEOHgjfZbwlxWpbb.GjjZnsevmvZzaqntbXtvmo.sslhoLFVwah LchngJaid.SVGEjbcUsprgNsgw.DuvSeuxheqZslwdrfMgbjx.latfwzDwcxtegQrshUhxMhxFpeXar VhxfyAbss.SRAGpltNljjnYpbz.UytDrerxavHejvpbvOvzee.tmlqigCoitxAgw ZtgomHcus.XASBvhwEoogzEgmh.KgvZuwkfamYdtmyllIaaqo.eqyvfsAYmWbwIzpg VrcqzWuok.RBYBvyhIeeuoVloo.EwgAxhtrdfMvqbcxfPkofo.gznpbpEENhh SnxkyEwif.SPTGgplNbdzvAlls.BylRulgsruKujyvoeXfvgw.wrbUqtAhvumoKht AvhgbWstv.CKVSncmCmviyJana.AodStoihvgScthvosHdgrb.belqjlMrjUBqn WgvrgJsam.VAQEkpnVudvpMdke.UkdOaaaynuBgnmvirIgfjv.todcbYkc YjbzkDkzw.MWFJnjiHcfynOdue.XenLowemqkIksovpjXlloj.giatPdpAsa PtuqqRltb.CWRMtviBrovxBigp.LgsXxcsgxmSqzloofGxllu.ugtfAhzBqtQdrospbdObgJcb HwpwxQmgk.QLNVfbyBygxuHxsq.XbnWdenmnhMwayqmfRuwuz.sixbTnDspbZuxszdpLtb VshllWlcm.EFDPebfJxnvoHdli.EhlLyeniydLthyjkgGfoqh.yrpxSpUonLvaZdnfpktoFil VfodgSvvh.ADDIvbgIggnkTicz.IvyCmfLis.ivgztnoZzwsQbdcoenvdOquwtu HmbwrCunq.APPRzedRqlenKfba.TodZhjCfb.mmbPfdmwbWbwyYxzDgezdvph NzkojXghz.JKMZvffPfosrUham.EpsKplRmf.xooCxwllyVdfmtkx AclhyNyza.QVHXimdXfmxtMjqc.HwtZzcCvb.lscSbijczFxrljDnrgmjee LylfhLssw.DJGMjspZjnfwHtej.YsfLxeLqw.kwbXpqlstQoirzifxjyw AvlglUnqo.XXNBlfsEiqqgAdag.JcqEkdMmg.tbbGzitvpMarbqt GgdwsDxch.COHGlpjUhogqLqtu.EedJcfQou.fgiNhzlezJochjcUjgiktbp TawwhRlfo.UHCZhteWnintYsxf.CosSwrVet.mqiUkwnoyWuffiyz LtyvzTpdq.TKRMmurLnnwrVmql.PfwEztWt.nhlVt RogruGddc.SZPTiyfKodcfYaed.LxcNjreKrfIwce.befynumYsdcEmfizlzScsbIew FqgteYmuh.XHLCahrErksiSccu.YurGjbbCwmUrpc.hbbzvivNwfbvojAnltIze HrsokMnla.HTKGzpxRhoskVvgk.QfsIcpaFqmSvyk.rsgdgjnExdyhiwcrpHwxbrt QypzqUvje.VOSJongXtpzfXwug.FryDpbzMvxNmeu.bxudbktBperucensuInxsGjh WhvknQabv.WGIYhkoStsgxElhf.AyoIjiuTfdAqyw.lfkkfjjYpcwqhuYausIlh DgfijQdqf.VGPLhjxMxbvuWpbg.AprNzjiAfnXahf.ryceRsciPaxNuqnweKwrtgIri KuckpEqou.RLHGtkmLyhpqToye.SquWugrXvaWiic.nvrwEfsdPrwVen OcvfiIrdi.GKNNoogQzuxxNwmq.RapFhpnIewWscm.ssmiliwgmwAfhsKbnGleg EzuqyVden.VPWSujtQmnfoNwmh.HocMptiJwzAsxw.ngnihavdrhIvnGdajhckrlif VketeCfth.FGALmsyZhkboPjxm.FrrCjlzCrmPagm.sjneayzgfmDabgXgaaMezrbaNlczg HqeqjJuwe.FOOYcyaDluamKebt.QrzZtnyVehYaie.jzxmurwhggKlnpExmfHxjm AkwgpUucu.UFWObnaUndhhPvsp.TqlCggcCwrSeyw.inptakkuoeNgabIgtcAogrveUqsne MqcnkNgdj.GYEXtiqJaeakJcjp.SnlHdggVgwFvny.ccdlsiosbiEgklRlxvJgon UuilkPvuh.VGVNsurQuocoFnga.DnkXzlhNdgTvoc.tgqkzSxgnjFqzvYlnbLidkRxeh01 GqvnxOmpw.XIMVhniEvybyVhoa.BnuMxdvGtvDlvu.tzldzYkzwrWnboDkfyDgneEwgb02 MvbufAsxy.EEXWkibZmholKcjw.JsoMxuvIyhYhdg.pdpxuCtsdpGmitAqpxIodqXrcp03 NtpniQulc.PTOIzqoUfeouWdsi.EvxHdkdPzfHnre.doryqJbznrTkvkVcxtCpeuQfbw04 HmvaoSkbo.VGXBlcoWxohbOrfm.FarDfouIaiHiwt.dlyiqFqddkXsazPqcvComcSwfe05 PnkwpJssr.VFNQgqyZrgndKwqs.AckBwinDkdMepy.qwcojHtpwsHlsqXwnmJyhjOvqe06 BnmstGvws.CGRYkisFzgevJett.ChhMsekHllDwdx.kevudUqisvHzpnJdkkMcftWzwy07 AhlbhBfcs.LUTRyueRuxgsAsec.WevMxraRfqTfts.bzgjjItljrWfloMcagZpjrYxqd08 JhergMthc.FYTTnuuBfmjhJicc.SwgQbtqJwzVfuf.eublkWaratWxpxLlbwGjjhSkfc09 YczdaBnut.URUAiaqXcjumFhxl.NqwKmlmPlkWbrq.ainriXbuppYbmdJiwhYewlZwqx10 CcyvsMigj.DOJNffuGovosItbx.BdoNmyxTuvZpwr.bmlgoDgsqbCsquMqvoFxmxEayq11 VepneTrsf.XTQHmmbAcchdFhnx.UtrYpbpXttGjun.gauhsKsxluWxqnQslpZxwnZceo12 HsrkeIsfe.HFITwqbVmsisPzti.RugRbbbErqQvdz.lxnazQoemvVgjfLduhIpjbXisn13 TkoddPhpb.PGXNenoDatleCgdf.WavSqsmFwsIcoe.keklyEpzujPyeglum XkjtjXejo.XIHQhsqSntpaIuxm.NlhTuzuBiuPrlj.vporvNtmilCwnkZjcqKjqmNggs01 LtmnlHugq.BIYEaetEatvrCily.JfnIphrAihIyta.clvuxSftjjKqfiWctdPliqKalv02 LiihkQcuq.AEBAdarNpbnbGxsz.GrmIbsuLmhByqo.jhxrzIihlnYixaLospKqtpPoei03 RauysAmfd.XAWApveZrtjlZxyv.DnpBrctEgyOada.gbiqzAlpfkZrdjGtplXcqlHkkk04 UgqjiUdld.BDUWomnIfzncEpug.SmxPoxkOynNzim.rolsvIvqfrPcteDzccFzlgEgfj05 YhhivSvlu.NIMYpptOkxqqZhfw.MwzAapmOakGasi.dayrhXjlevZpfpXettJatcMzes06 XnbteTdoe.VSSIwjoRnymfCxkd.EwrRqfmAehBegz.vuhyeXtppdWntsZpuaDckeWdbv07 CjfwpAhyv.YUDSkeqOeqarWvra.HpnBxrkZsmHsde.nwyjpKfxbsLwjqBgegNpfeCfhu08 RhcooWtof.VRSCpboGocntIvmi.EglYljgNeqSxwb.ocsghJsgsuZoryRcbaXxurHqhd09 XjvpiGndj.PCAZfdmUjrfjQuxu.XmzBlikGhjFtkm.uvozyMzrejDoidUjtkHreaVwfj10 SuizkOcfl.HRUCrgaYhymyJzlf.DmoXcmuWquDqya.kzbomJqfqjAecbNerlKmobFtae11 MdwdaXzyp.KLCHhznOfequHcwl.RnvTpzfYveLejp.etrigQdbmmTuptYazqPjlhAozj12 IlmndPldb.TVUUnkuQxpuyFmnm.KzbRugwXzqZbou.ibzpnGfmtsAtewKxhoNgllKpyj13 LlazqQtzc.UUWZrxaRjerhJqze.ZozHukdXtuJnhp.xyEokpkCGphFcnejVvvRmh NpkbrPfwq.BZGTcbuOojbtGukf.VdfZkcfEzmTnpb.kgLfycaWQltNhzfvPgfKtd EyvtkJeci.FCNJfebPyydmDhwm.VtpPjfbEwqFgsm.mfUhqnhJOxqMqhkSbiHii MszpjCvtp.UAEXztpOpqxsMjbi.NrmUdrdFhvVoia.jaZvtbkOFdgPzdvXevQpd TbcpvSyga.LXYJpgwRfufcUoap.XmlMlskBtjLuub.npYfmmrZJmmLrlcjkhvMffvZnl HgalaPtcp.UHUZslfXrfkhOkqn.VwqAgedRrqYggg.mpUuirmGGdaXkqwmypgKldq SwcfbOpia.XLQQgqdDaxjuHuay.UjsLfvoYmeHnte.ztEvjytNGbvLofoktwvckdtTblw JbcvlHapu.FEWUopwWrvjvSvej.IhfRiojAlmSjnk.dfDlgjpDXvvPcvwjbhfvYxafRlu KvoaqYjbd.SMKMqgaDzvoaUlyc.WrwKksyXleVidy.thTizdeRCiqVclSqivyicBeych UremwXmqn.GXBMwlbRhjraUgqh.ZxvJcivUmeHslc.skWnrgkQQtmJijlpovRnewrQozzax BthvxRmhk.NEBQqarWozsvHtsr.UziPrvqOiyCxla.boTbbgdIXoeGtfigedQujtcDxd SbhckVenv.PRAAruhIjcalJhoz.JclOrfcCooNgfy.giFxjreDDkiEqikznlvHjtaFhtyyo ZaovmOhbj.EJMMuhqHppscHjlb.MckNgrqXqiKrbj.vsMoxhcZRbaQahutibfPjzyDao ZqtegLpzb.NPYRyppRyjguSvpk.XddCpprQiwToet.mgZgtjdXJknMyhffjtlSnicPifjfc IxyccAmqa.DGKJwsvSjywgRbqq.AknMmnqJxgWlvr.zjEzkbnTYhyHpbjcybjGyokVzj ZzffpIvgy.IAAZymrFnuggRfmo.XdzKnnjUznLoma.vPfariUwmnNngeIajcvFbxoPly LthnkTbgq.SUWFrbfQuheoThkh.GibDakjKmeHxsq.mKjxsdUzzsRietVygpSbhtMyv XbpipKqie.QDVFibcXcvzdRpup.SwjBdbvIssVlpy.tCspjkEmytRyuuRjhhtXzcvVbw QwtgsEypj.OJDDzokLbaccNpoj.HxpCbxgMbcKlfh.jOzfbuNbwnHmlsGcyuGajzTsc YifuzFdaq.EWHPfjdPdolyVaps.EfuUazaRmvMwoa.yPnglmTnssuRnyy HlumvDfpv.GXXCfxlQthwdMyck.PtrWovgKfcMnfq.cqejyGdsvuPyoanKvsquIxv GfcpwLlce.ZIJSheuMckycEitc.SpbYvjcKykCju.ttrgqiwgFvdwKmlEyasSej LyuytChyy.YLKFbrxBcjpuWbxz.QgnIpkrTbpCfe.drmxxrwyTteeMsvsjsafZdv WhvwgLnyo.RQONwtrGklmwNtqp.UvfXfjrTutOpg.ohlDikvLbsuIamsepzPbqWvg WxphyGuvf.HNBDojmRfgkoNabn.JqlEbucWceIqr.lwKfjjrFOraRfzpzNgvSkf FkbkbMqev.ITNBendDpjarNybd.AnrScicHrqGdu.jyJyvixMKvfLolpkEzbPvb VfcciKbmb.JDMWlhlLhsiyOpjz.KwqUnjyWhtAyg.emQekbfGXiwVvrrGohFui HchejRelm.BWIXdpaZqojtTtnv.YevFzsbCslZxh.qpWrjooECttQgwxQicLcw MheexHedt.WGVYmnkZtlltLcog.PkeVvgaMgyKec.wmRsfgfWOgtMkrogcrxIgiaaaf BdbcnIxlt.UQADezkUftxnSgvn.LhgVbyhHbjSwy.hhEtswgNRklDblgcticKcggjl SquyuQklt.LKMHxwrEpbfuYnex.KghVmjhLqsKwn.nyyPqmbjEotatUetbyppPqf NfmlsJgts.HEXXiejCgigiHhha.QyiCgzuDmiCcz.kctNxediBplnlBpimbydDsnVtwnOsf NmgyfUzej.XCZTekhOkbqbCxgy.OkoIhluXjkAgq.mohPjtaDusqWauzmpmXfq OpscbJbin.HZQOuapKhehrMmtb.XpbLxrfQucJce.twmPdneNnstArjijtqMnguvp IsmuwEmpn.PYYWmrkMobtwAmln.XirAlbeHbzZrq.ypvkmUhkPeegzbiUjwfx KkyvuLdgj.LWMPslgVfanfJufx.ZzeEjeiPjyZlb.toersEprlzyRclbaulx DyyzhIppj.VAQQpirVcsdlTczv.LgzNsouKicOfj.rtydxHxakckWvgkwuluGrlEhk DccamMbkb.RKTKjnjItuofNrln.UxiBvcxPgeLzt.jemzFbmyzzvvjKwnLhya EplkdUlnr.WOHMimuVcyldNoeo.GuqUldqFetOba.pfxtWopnqZrrLwazObm MyxmnEhur.SCFCfkyRvhbvHrbl.FdwGemqUwmWkx.wzwaGmjnzEuoiavmwUzu EhzhyRron.LERBwfrCpwnpAemr.UisJesiRafMcq.vnnEfmCvi KpxtjNfww.ALTSuluBeodnBxhe.AifIgptSuePvr.eepHnyMdoOhtoCahqgzyiArr JpuizErcv.KQXEtkoKvrsjVyiv.PjcTfkmXmdQtr.vboFivGeuZwmiKxj DxmgtRspl.HBWQwmvJxberAbys.HwlPciwHpjLzf.jaxChoXlqXophtrVbt IvmnuGpep.SAXXqirZbtypRhqv.OsbQzveMfpNuy.wexRxmxEmjHpaPlzcDbi IqkxfBkzm.QCVRtezRraarGnvy.WxmNbdvEaiTpn.bnyMljpKoqAvruxgCvjvznhpDgr BcvnoAeuh.QNGTjbsDyekkDbed.RvpPseoHfcEfm.jfjWewzUdqTksjyqVmntchxlEsk JkthlVcgc.LDVJialAupptTlpm.FbzTlmuJwhAat.xnxhCorireFhrv OznuaMsxq.VCDXhmtJtvnhPknf.ZkvLvjiZucEwn.cinmJnieHsgobyxMxkhbl EsazhXcoj.QJIPlqeDwburAxwj.LpcXwwjOjiFed.ydjkUxqixdzVtztsixmf CydkyIkbt.LGKXcpqOvxqyCpgv.GtcGvkuRejGwm.dcaozTiCemxXBGgpcx XmdjgEhah.UXWOrgxXsxypPiqq.JefHbrhDmpmqWsgq.sisgqAhArtokqxAtdwkodrs ChmgcWwwm.ASTQgblNagdyQhdq.VayRdiwKdijfRggm.tjbtoBfEvq BsnfgZbcx.LCKMrzlMtqmcDaxe.NriFlvudogPldbltgXesee.rlbnDviobctSxwcAwjJdbyx JiesyKrrb.VCESwktFrukeHuew.MquPtwwygsSkoosdmKgein.joqbTdiakgfSbhbIcoYeeum GczreOutl.UBUYeybAsloiPycj.WskXuychosRcuidtzTwbkh.nbbqGacexfxQbkdmgouYkjUcnrq ClwarGipj.NSKJmhkMyvxxKghs.JvcOtaeukwXhgtywpBfeqe.tqoHltEvPemnkDytwa YaxsdLxhk.COAXnjbTzrjkCbbu.GxoGnwiqmjHdkzyuwXkphn.htkldnd1NuswpEajxyiioGueIimvj UaoukIqif.FCITkgjHiigdKsjg.ElzPrxwzxfVffjqcpQzxeu.njrWnuBwnmJhecwLou QooilZxah.UBQYafaRgnyhAdmz.JrnBeldvlsPwhfnnoYwini.ahdPotQhnsVrsmfTdh BehobPdvg.FLJAifzRjiwoZcgb.GrxEbehkajCzdgxvdTaqnb.mmeNcfmkvkuStrqodvvNqoDbtmf RqpudPkyp.FSTKsdpDbrdtOaes.ExsMdmtebhWflbabxRhgut.udpjwsIczyxbbZzyoVnmEpvXmnkc HkjmsVecx.IHDNnitEqrotXrxe.HerIbxbBttAakv.lgamPmymUgtCudsqosOfbaa LwbhrDibt.CEOOurvEjxouWyfp.XxoKwpmRerMwrd.tlzxGenvOkvQnoicjEilogFetzb LojhjPnzf.BFZImtwYcgbiIkgm.VqoOdqpUshKpia.xdVakzjCJvqWopnsxwZxlvd LgnkrGfax.HOWXaorKoknoHtdq.NlqMbnnLkcIzwl.tsHpcglRZefVnqgxhxgRtewm NnhzuGewb.DOKUcryWnyueNesz.UprJrgnUhgSziu.bGeexxOzgkSyePvxKdcqe IduooErje.QQUQojmZglbcSqzh.DedIgnwHyxLjwy.cgzfqRzllrWbhdqBjppsCrvza ZlelwXdct.EFGFomjSfxzsNrag.DcfWbnbJtkIzc.yodxcbejLgamGyvNvbUaqbh OejasXefu.OAAVuimMeoqyOdgt.CqyYdonZfrBds.ukuggpjzVbibUhqfMgllhnouTwent PlddyZtgv.OWAZvqvMnlbhRfew.JleRgfhFhtNjk.wpNukivDBjmBrummusCouyq BqpurBqvl.BBHOmvbOppndBmyw.UrdVxyaSqoCte.lqtmgRlktdlRcdapagjZzbMyfue GisqjBmgb.EJVNljeNcntxClxk.TxvCbidBafGbe.kjhnTbihlGbcGlsShdvj YmvdlAodc.GEJMqpwNkamyPoac.IohCmrxJsyEqc.eaacPzxvdXielFlfdkbsfQdmbl SnuxnTieb.RMVKtpeIlfifVlfy.DhjIeveQriYig.yogCbeXgvRknkgghsZecci CuzgxRvmj.HNHGjtmIytpbDovt.PuiDqduNjzTlb.tpaMefWssCdnwkeuOlfpu MkqulTjmp.YBGZfjvNgclvCcdf.DvbXschJaxPnh.vwaKhwTbxHbbyZfpQbceevoEzfje GyuihSvip.CIHAmwuUzxtmQnfs.QipImboVysTju.zypYktzJknRfqvSbhnawafBkgln KvjukHvpa.OWNKeirAcycuDnpg.DlvXzafZolLnh.hwaFohhQegZlknwjUgiNnbYlzcb DkstmExei.FAMKyitDsfchKtjz.DeeOecjAallzBqiu.usuxhJeWdaWljYkqBtmlr XnfrtXhpq.GQJDikbCnrwqQmqm.HrjCfojGaoqtUstl.uaxcdKbYqpKjvOwaYitac MzepflgyBrvolXjfYqba.ZESDB_ABTDHMJ_EBYN_PLKACA BjzycXppf.INNWoriotmDjr_DiyKbhRvlido AdqabEwby.IlzGrcBslvQkc_XahLayLmktvz StcsnKofm.MdekgjjZhhGilnIlzuInvXxujmi JvvoxHtqv.CjyaMpelnVezzhkpHoa_NfbRdgJfosyd GvxslPvqi.BhdgeZzjhfrvWck_OipXdoQezmjp AdrzqiltYkgsgPgyCmee.XjzinOfytHmelcafObrcxyIikas CgujzEyka.KzidwLhnxezhHya_RdoDcwHirbkm GnlikQmxfjFraf.AT_WQ_HT_NX_VE_GRXPW_UKSUWFZ EwjruVauqpRnjm.SR_RE_EAVCG_HWDOTSZ MinmjEtsnzBsbl.KU_DF_BGPIS_SGT_DXUYA_MMSI_LFDD LekpuCcybzAxtr.LJ_RHEH_SA_KRSRYC_MVATTPLGP RhoppAmrybFujs.AQ_AHG_RO0_SKCLYOK_SFHSV AsbqjXwcdiYkgs.NGDLLT_KRF_BWO_ZCGTXUK_MKUQCRL DogizOgzqtMnoo.QWAWMH_XUE_JYQ_UMHF_POSLTUEB_DWY TawuuPcxzmJqcx.YI_JJB_CU_DYIJNR_GIBIQMNBH HuqpyKwhdhVbja.KO_LDKX_AG_JNJDUA_TUIPGERNL UbvdoYdlfgFddk.NG_NZZ_NMWRG_IZO_XTAE_TWFDY_K SpfvsZnvayRjxb.GT_IAB_RM_QEXAQY_HJQQYEPCD TledaIszqcSorv.CNYZXN_XCH_NIGY_YDOV_YZYYRXZ UqxneDrtapYwup.FSZPNB_PTY_QD_QBHAXVJL_BRYRDGSVG MxwwcQnuqyXwuh.EMJL_JIT_FSO_HEN_CDQREIXNK_ZSSW OivodHseayXnzi.ID_BUA_FBHTC_VPL_YDV_JTUQ_Z WzfbkKssffDgii.FQ_UVI_SXMEG_HDL_HELD MaetcZhqxaPyil.GL_CA_MRX_SS_TC_JGP_ERN_AWMYP DtwojLfeddSgdm.SQ_HI_RGI_DQV_KPMLK_ZAMAOUSF_TKY JxubpFlzxrUpax.ZYGM_XMXG_ZPICP_JAD_UYSB_XCSC GdmswMasdrSpng.NQED_GJLP_CSBOD_ZRS_HJHI_JHIFZ TvuqdPdrbtTvot.EW_LCB_YR0_HHVSRXN_WTNNF YipwgDwauqAcdg.LI_MNZ_UAAGQ_UXW_MVYN_ECIFU_A GttwqGaqtcGhuk.ZT_BYA_ZKBAB_YOT_CCJ_IANYJ_U ZofghUobmrLzmn.DH_ZJW_APXDK_HXS_WHMJZAMX_ZZCW GqyksBsfpaQodu.OG_KPP_BEI_AYGGQ_SAYYUX ZglczJvzvfOnri.KYRR_KFV_CPGL_JWE_JNRC NarrdSwlfvDzdl.EDTF_XCD_UHAZ_TUOQRMV_NFI_JIHE JwftyVoyvgMcnf.CF_EEP_CPS_WWATN_YFPJCZDJ_EGSF JgzdmKreliSuxu.UXVJMP_KPY_ZJXGKGBW_RLOOABS AvuouPjgcnWfqv.OK_YL_CLRSN_LRPA_SBRV BupfrFmnfcTbhh.OL_WGZ_WDKHS_TLI_KZWEDTO UutslEyqxbClsf.PS_KO_SARC_VBEE_JWUVO_TZV_XFLF VptriAffzyIdeo.DW_SVO_KFK_LODSZCUDQ_ODQEVVW EtoefNfdakGoel.ZYILSY_LXY_CHQ_UB_YCB_NYIL NswvgHghqcHvba.QU_IO_SGRBNUES_OKF_IRVI_HKWJ TMQQ_Owav.QDXH_KGNHY_KBJKJ_SHKBOS_OGKV IKJU_Djqv.NRWV_FNPQX_YAKY_LCI_YRZXE_JLBS UWXK_Vrki.BMBX_WDQTOF_AMDXPG_KHH_KEUBX FRGO_Mujn.FGQG_XGNEL_Y2_AUPFW_GDIK_SQIF AUCC_Axhm.MUVH_HRTDOR_ELU_BUI_VHLIUN FTWZ_Kvcq.ZRHQ_VKKIF_VIAO_YPXQQGS_KYXM OVGQ_Ymtr.VTQV_OSNPL_VCPVD_NWIYGIZ_TKOD SBVC_Yhck.FSVV_UDZQJD_PWV_TEK_OUHHVC VOCJ_Bpjk.MDQF_ITUUQ_BHGOZCO_PFYJ_LRF_QIVS PHNE_Ovoj.ZHBL_XQKQH_BMJHNCC_RMTA_TDN_LCDC LIRR_Bjmt.ZQSK_HHI_TKG_JTBZHVN_FLO_QGHO UWEG_Qokt.LNRL_NMCMF_IM_GFMJP_KXSI_DTNYFA MFMK_Ljdf.XKCS_IKFRU_DKUSZ_AFYIEKLWC_BTIB HMRV_Mlhw.MRCC_UTBOS_DK_DQ_DGG_PXZ_O LMMF_Neyi.DVKZ_GUREFN_JQNC_WKHLIDF_QNNMZ THMH_Khlw.ZBNU_FCPL_AXV_PHZ_DWNBA_WJE_Z UAOP_Gfya.CATB_WRQFL_GODFI_IKSQHX_WNG_DLPF LCNY_Ulsi.SHWT_KFAQ_AKF_ZCWYO_ERIWTIT_VGXT GTTQ_Yywe.VRUZ_HWIGGO_XQH_TTT_DOCBYO OPYI_Zxdp.GUSH_TCVHR_YKRLSHL_CJBUB_ZROJ ZQFN_Nzjs.BMVW_CQGKR_N4_APPFPG_KXZT_BDWA FWBN_Dlle.WDHA_VQSOU_IEXS_FMQOC_GUHXWJ QJLD_Hgbv.NXDA_PPWQE_EDRYRWM_TSUV_TVW_EXOV KBPH_Nxvi.SMDQ_TPNC_SYN_XC_IVJ_E_BWYR MECI_Honb.KTUS_MMZTB_K9_GUHY_YHBJJQ_JYMR EAZR_Iolx.DNOO_GAHIS_IS_RKAKX_DVBZ_VUGN IZMA_Xlty.ZXOK_OFAZJV_PUB_IZIW_ULTAD UVRN_Avxk.VWFK_JQOBANW_IPVU_DSUMKPW_GVYYX LOIR_Xegc.HUYA_TXPDLA_QIRD_TSSN_PPBXH IFTS_Xchs.DJBI_POAII_N6_ETXW_IPXP_VSYV ZWAN_Cdgs.PNZE_WZGD_ZJL_QBJ_MDEHBVV_XNWG WRBV_Ckva.JKYT_AIXUN_TMJKG_TTVEYHJ_ZUDH KEQB_Nwkv.UEPV_PGXP_BOI_VDMOK_CE_GIAA LWGR_Fstg.KONG_XBRKV_GR_FP_VDUMOOK_HCPN KIHQ_Nryn.YZWC_LRXH_PFCSA_ODP_KTXBQN_WUIQ NERQ_Faav.YCEW_CFTPNSM_NZK_LMKH_YOLZD CNTV_Gsha.WHQN_DYQLQY_AYQ_CU_OJDSGP CNAW_Momh.LTFW_IVPUAVA_USI_MIMBERS_SISII XMAI_Tzej.CVLG_GWFLS_YWGU_RWUCBEYAEJZZ DUHJ_Snsr.MAWN_RLE_CTYMDA_HMZPGH_DMOG BHZH_Uflr.ZHZP_HLKYU_NHBT_MXYDXFIF_VCSI TKOL_Rrhp.KEJQ_OMSXEWGSEE_VMJSLJL_UZSXYY NZKH_Ybdu.WKBU_YEHMR_PJEG_HLATXNXVTZKN WBHR_Gwfp.MGEC_YWLWMGVTV_100MG_QMFCF BKCE_Bbhi.NOSD_CWNUXT_OVE_EPRHMJB_JOQJI OABZ_Ddzu.LOQX_DQNDC_G1_DS_EEDQAI_ZJNX PJIX_Upgp.EWVG_INHHV_AE_WF_NM_TJJ_KYJVU_I XBSR_Fkuw.ISKI_OIBGK_D7_YRI_AB_IKHC MBLT_Cnwy.ZQKA_OZVG_LKS_TA_YQE_O_THAS WCXA_Bbtb.YXVK_HDD_BFUO_XCH_TOKRHE_FLMA SVXT_Ejqc.ZYYQ_SHX_LCKR_NR_SKL_IMWK PZXO_Rlaz.ATUI_PQKVS_KQ_YB_ZT_ZJL_Q EUGU_Jurb.YQGJ_ODDHE_NR_OU_SX_MPR_HUSA SPQD_Ulqe.LTLC_OCM_KX_HATRN_LL_IWBT TVGZ_Fqsf.JTZX_KRMKT_LJCCXSF_XCL_RPCT BJAD_Yjah.LCYK_DISPY_CXHFQ_INZJHZ_AHEO IOZF_Xjsy.DUJK_YDI_NWOY_VT_UIW_KMYV GCFC_Wwlq.ENPA_WJIVT_J8_IAFHPYO_FHCI_ARNZ LJLR_Oynq.PNFR_SCWPO_FOTZ_NWLG_ZKSQHGU AHIP_Zfaz.PDJF_YKOAH_KUADV_BWKI_UZLT VXZX_Pfdo.ESGP_XOBPZMU_EVAOM_GVJV_CGWRPGKR PIQZ_Vpec.UNSZ_OIBRI_ZESDU_RAQWBB_UPWZQ MVXK_Arra.HYAH_VKQOMLI_PKDI_GSIM_GQYUB KZYG_Dcpb.JTMJ_DHMMF_H5_MQK_ZFRIKUZUT_JAPL PVTW_Mwep.XDGS_EYYJA_TFQC_HUQT_OZVQV_GOIA VQRT_Yfez.IIWF_IQLHG_E3_IZD_XYXQHU_MYVS GVEB_Duyg.AQGH_XTMWW_NO_UN_KHC_LVP_EAII WVVU_Tusq.QZDC_JKOII_XOMN_UDRPGXM_GQHE VAAT_Inwv.TUQN_UCECBX_MXK_SKC_MNRLND FEUM_Vzbb.TBHM_CRGPK_ZHGI_FMRJLM_IPN_UAEK BNUP_Qlyi.OWPN_FGZCHS_RFPJP_WLPK_ADLBVXZB KIKT_Pfyz.LJIL_JUEQX_MNGEM_NGXKRN_MWRP XDEC_Uvcj.NHMC_KUQDW_FMNO_TSK_KMFKE_NNMS TUKY_Prvn.XQAU_IROQTN_QAILRC_ULB_MZUVR KNFZ_Jthk.AHVA_OEPBU_V2_UTTKV_PIXH_NGLN ZURO_Rnze.JYKS_YMDPBP_WFL_AKN_GTIGNO JPYR_Eqqj.CLQN_EXIIA_NKMX_SIUGRZQ_ZMOY PGQD_Vklu.VQEI_PZHPO_QHIKU_RBLCOME_IROP ZPLW_Oulz.HKEM_VHWXKK_RUZ_JPN_SKMRPF XZTW_Gfhr.IZTR_SOGAJ_JXEFBCH_ZRZW_VHH_XFXH OJNW_Vftr.WPGD_GFTPD_GDLAFYZ_NAQH_ZVM_ONRP FJBT_Ziok.DNZT_FRE_VAN_UVLWVRQ_NLW_VLAO LVPL_Rlwp.SLAP_PQZAM_ME_JYBMA_LRMD_VIIXAQ WTXO_Ntex.ZVAL_ZBTBZ_DCTJX_IPQKXBKLX_CQZJ BLTW_Aafc.GVQL_RJJIC_JG_HZ_GMF_DQE_N HVPM_Vcfw.UEFD_YCOFEN_BPYR_BHUTMEO_BBVVW CCPQ_Lurg.GXWF_GIGQ_ZDY_JSY_FANSI_UVK_E PZIP_Fimt.VYYQ_PPUQW_BFRRA_EUKDKR_FDH_QYSJ ONKZ_Qdxd.SZVT_ZFDA_RYZ_BICTS_IZZLWXQ_DYBQ NZQT_Zjwf.STPZ_ZOTBCA_UPT_MOQ_VQITFY AJIH_Zobb.LJVP_JHAQI_ZJCZHWM_ZYFEO_CSXX AMLS_Aedr.ZCSG_KDOVE_W4_LVLRGS_NBUX_VZYN CKXW_Cftu.ADCQ_HKSWM_IIOV_PQNTJ_DAAZUX GVAD_Uhcy.TGOL_MURKH_SYZKDBL_BMLH_ADE_CKTO WKQJ_Fgsh.KZSK_ICKF_TBI_YK_KLS_X_HRDZ RHKE_Lwzg.WKQL_PEUBQ_Y9_SCAS_UNKGRG_KYVT GFXE_Mgxh.DXEC_LTDEF_SE_JQDYO_VEGN_JMIL URRH_Mmvf.OHPQ_BOKBEU_WEE_CLYX_WIETW GRXY_Gjtp.VFNT_MSZXBZZ_SFIC_WDEONHL_HZKZL YXKF_Cecu.GENX_ZJDSSM_FXGB_UANN_GKSOL LYWP_Lcjp.OLCJ_UKBCT_K6_VAPX_DYWM_JKTQ RTEO_Xdjo.DVNN_CUTK_VCK_GIF_IZVBYIQ_AZDY FWCF_Xbru.WQEH_QPSJV_UDUKT_TVMCTPU_GHYN QVYY_Strn.HSPO_YWFN_MOX_VIREM_LF_GRNC XBCJ_Vayx.TUDK_PQGBR_TP_VY_TGXMEPP_VVIJ ZHDF_Whjo.KTJM_ETYK_PLDTL_VEB_QJJGAQ_XMZO PIDZ_Vodr.TSEK_BOZWYSY_KTK_QMDI_DBZNH XTHC_Tsml.EULL_QBHDQE_GKW_WM_YOUUBH WULQ_Izcp.LXAK_LTXAYNQ_RCS_PUSOYSC_DLAHP MDBC_Rhsd.YTWW_WMXDI_RWPI_MOHMQALWIRAL QWHZ_Wfkg.KVYQ_DTI_KFXWLR_XCAXCW_CWLN HBFU_Aihv.GNXX_FXEQU_GQGR_RDIEJCLI_YTXR DVSN_Vffy.YOMT_QSBQDUULGU_LWYIBNW_JFAESG UGUJ_Csqd.BACC_ZXHJF_MLRS_RFHUIESDPIXQ MHDT_Ovuw.THAA_CFFXRFCTH_100TK_ZBIEF ZKKF_Syet.GKNG_MWFAPW_GFO_CSPSRKU_WHTFW DVYR_Uhyw.TNHL_WHFES_Q1_AW_WEUGDR_XULL WRRD_Trmh.ENXI_NHAEC_NN_SG_ZI_GLL_MXRRR_V EZDH_Wxuc.TNKW_RYIBV_N7_JWX_SE_OFCH OZHH_Tbqr.BUEI_VEYI_DWZ_GS_MZC_B_JOWJ BDNQ_Tgck.HNKO_AZG_RJVZ_EYV_CDZAEK_LOSL ADCU_Cicv.PQQO_DVD_LORG_UI_BWA_OFFA JKMF_Zlnv.PZXG_GVTKZ_RN_JG_PQ_TFB_N HUTQ_Etcw.WNFH_PNHSW_YT_SP_DP_BLS_KOOY JPUR_Gdgr.FNOL_LPI_GY_OXCIK_FI_WVRX UUUE_Pagl.GDRL_IQKSR_DHLNSTJ_AEL_HURE CHQQ_Oahk.USYU_EYTPO_VXNZT_ZIDKMK_RCVV MICV_Xvhs.AXWN_CQI_BGEL_NH_YJS_UDHM VLVK_Whnw.YBXU_MJYPL_E8_AJPMNAT_OAYX_YHJJ EMTV_Pfly.BERL_KFPLU_GJJQ_PERQ_WJTKCGM HFLP_Pghw.DAMD_PUIHE_LVPJQ_GKHS_RXQJ NESS_Rxxt.OASQ_HXYVLQJ_HWBHG_GWHF_QKEJFBBS ZPDR_Cgcu.AIPT_PEVGY_CVFPO_LEMRHK_DHBLC UDGY_Zdvq.TOMY_DSNBISB_MUDI_PAZK_IJEWE XXJG_Xtbs.LLFL_PAXGL_K5_VFT_VCODAPEYE_XAPV FKLC_Dxmp.JBBL_WKZCF_NPYK_VTAT_WKQRI_CWDF XVNP_Jlsp.ETZT_RBTSE_Z3_QDQ_TFHDYG_PVAB HMGF_Hcng.KIAO_MIOOI_SV_BZ_MRC_AIT_CRGP GJRN_Dnyq.DSKZ_ULDAA_CAVL_NKKRJHE_NZKK DOFV_Ikkd.BDJA_IMKSWW_YKW_VBJ_WMXFOM BKZV_Xhsn.ZPNE_QVHME_DAMQ_BLDKSV_NBS_YRGU DZYA_Wyha.OYPE_WJCPSF_ZANFW_CRIS_KSKBTOSG QtaixRdqmgNwwj.KO_HFV_QE0_ORLNBKM_BMGUN FksknKspcmWqdg.CN_EWZ_PM0_MJWFVSD_OMQDF /end REF_CHARACTERISTIC
 /begin REF_MEASUREMENT oFiksqpHcraeo._0_.AmkrrkDyzctmVdf iHldupgIngfdf._0_.JgyMfpGwy fUsaikeZllgzk._1_.GlsZsxJhb qBjmkiaWtykqv_Pzliy._0_.SysajsCcpubyCxi sQyfndqGrtnjr_Namob._0_.SgxYbexFnjodXgPewvz yZjxqtjLzmbpr._0_.JgpYbapgwwSpo iSsryjxQuxdqf_Biefd._1_.WmcUdvoGekjmJtLaknq uGuovnjAvlctk._1_.UssDfxtvwmIgq pWlthjhQxccaq_Zewrd._1_.XnkfhtIkbmorSmc cZwktdwRleqfm._1_.RdvzutQfklyyPlv ImWtJh.OexnxdgtCjawbVzuzvf JyRtKd.QjtwmpkiQmtpaOskp EtmFodhn.HiwbtQgmizuugmbPbxhiprtMorlgj FBMP_Hwyri3Ryptph.bgvqeuLmktitkitne CRYM_Qenqr2Acknrb.krjvpxDrjrsiauofi BXKV_Kkeqn1Kerqix.collrlViptnzrnxvw HOGI.PtgdedgGayd._3_.Icdthn TYNF.GqjicutWdky._4_.Uwgpoz LDXV.NdbygerLuwg._5_.Omuuiu FKJZ.GagqdvjElqb._2_.Rtrdnw CYQO.FjqvvqyEfnt._3_.Nwydmztzd UWDD.GymhrodJwzh._1_.Kxopryppk WVTF.ZnlyprwJied._3_.QI YBNW.SnhfaloRauc._4_.HpgjRjghdAphaWajz MQHJ.HpbqmpdHxtd._1_.Tums TFJY.NucgJkgqf OZRQ.NvkkoieCmlf._5_.Fzbe PQJB.IxuacpbGcmn._2_.Lozuifhpb TTRJ.WsxqjcmLlmu._1_.LM PLPT.DzqqdhyTdfg._3_.Qtkm JQJK.VdtruyrJkkr._5_.Jtiugvrdb PFHZ.ZcmgrmqVetn._5_.BW ATEP.VlictolPtcw._0_.Cfrs AUOJ.QnnneiuWmvn._5_.RhicDauhyMkceQfnc CIUK.DfvyrbkHgej._0_.IP NEYP.GyetbvcBpot._2_.PggqYmsysPqnkSaql QJVB.VwmguwpVmhk._4_.Mzio YYRT.UyusnjcQtcf._2_.KM GICV.GnwalxlPyeg._2_.Mdsn PPFN.GiispcuUkos._1_.NspqZzmtwBaylBtzy IMAR.YvujaucAlvd._0_.TtttWpkaiFnqjFiex ZZBO.FxlhbloHzet._3_.KsjeOcxjcJjxzUefc WGBZ.LecbjpxgBugxVntmt LZYB.GmwmxdbRvjb._4_.Wtrwijogz HDAN.QfvczqxTiid._1_.Jkhbkb UDZV.MtsxuesKfrk._0_.Esqreqgau YOBB.SwefxcwEtik._4_.ER HZZE.OlavfqiNshi._0_.Jfjxjj oFiksqpHcraeo._0_.AmkrrkDyzctmVdf cZwktdwRleqfm._1_.RdvzutQfklyyPlv /end REF_MEASUREMENT
/end GROUP
/begin RECORD_LAYOUT AGE_IP_KZYLY FNC_VALUES 1 ULONG COLUMN_DIR DIRECT /end RECORD_LAYOUT
/begin RECORD_LAYOUT CJG_GW_PYLDRAF FNC_VALUES 1 UBYTE COLUMN_DIR DIRECT /end RECORD_LAYOUT
/begin RECORD_LAYOUT GYKYuwe.ICQOC_ULX_AOQJVC FNC_VALUES 1 UBYTE COLUMN_DIR DIRECT /end RECORD_LAYOUT
/begin RECORD_LAYOUT IKA_HL_ALYON FNC_VALUES 1 UWORD COLUMN_DIR DIRECT /end RECORD_LAYOUT
/begin RECORD_LAYOUT OYPEbqx.IKZBB32_YVPZ_E_RIYW_AWPUEO AXIS_PTS_X 1 FLOAT32_IEEE INDEX_INCR DIRECT /end RECORD_LAYOUT
/begin RECORD_LAYOUT PTXXfgw.PRBSR_CUR_SBKDNF FNC_VALUES 1 SWORD COLUMN_DIR DIRECT /end RECORD_LAYOUT
/begin RECORD_LAYOUT PtkkRnpqrkbvXmkqs.QLPDW_FK FNC_VALUES 0 UBYTE ROW_DIR DIRECT /end RECORD_LAYOUT
/begin RECORD_LAYOUT QpgkGudaddleZooxs.GSAXV_TJ FNC_VALUES 0 UWORD ROW_DIR DIRECT /end RECORD_LAYOUT
/begin RECORD_LAYOUT SkcqPrebycvuEyxcs.XPDJR_XR FNC_VALUES 0 SWORD ROW_DIR DIRECT /end RECORD_LAYOUT
/begin RECORD_LAYOUT TRCZnfb.VAVEX_QWK_MOQPON FNC_VALUES 1 UWORD COLUMN_DIR DIRECT /end RECORD_LAYOUT
/begin RECORD_LAYOUT VEZHeno.VDYMW32_ZXGU_UIJ_SUONKF FNC_VALUES 1 FLOAT32_IEEE COLUMN_DIR DIRECT /end RECORD_LAYOUT
/begin RECORD_LAYOUT ZVW_DK_VVCKV FNC_VALUES 1 UBYTE COLUMN_DIR DIRECT /end RECORD_LAYOUT
/end MODULE
/end PROJECT
